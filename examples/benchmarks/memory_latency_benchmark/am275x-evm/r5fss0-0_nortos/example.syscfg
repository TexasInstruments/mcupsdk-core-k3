/**
 * @cliArgs --device "AM275x" --part "AM2754" --package "ANJ" --context "r5fss0-0" --product "MCU_PLUS_SDK@07.03.01"
 * @versions {"tool":"1.24.2+4234"}
 */

/**
 * Import the modules used in this configuration.
 */
const debug_log   = scripting.addModule("/kernel/dpl/debug_log");
const mpu_armv7   = scripting.addModule("/kernel/dpl/mpu_armv7", {}, false);
const mpu_armv71  = mpu_armv7.addInstance();
const mpu_armv72  = mpu_armv7.addInstance();
const mpu_armv73  = mpu_armv7.addInstance();
const mpu_armv74  = mpu_armv7.addInstance();
const mpu_armv75  = mpu_armv7.addInstance();
const mpu_armv76  = mpu_armv7.addInstance();
const mpu_armv77  = mpu_armv7.addInstance();
const mpu_armv78  = mpu_armv7.addInstance();
const mpu_armv79  = mpu_armv7.addInstance();
const mpu_armv710 = mpu_armv7.addInstance();

/**
 * Write custom configuration values to the imported modules.
 */
debug_log.enableUartLog            = true;
debug_log.uartLog.$name            = "CONFIG_UART0";
debug_log.uartLog.UART.$assign     = "UART0";
debug_log.uartLog.UART.RXD.$assign = "UART0_RXD";
debug_log.uartLog.UART.TXD.$assign = "UART0_TXD";

mpu_armv71.size         = 31;
mpu_armv71.attributes   = "Device";
mpu_armv71.allowExecute = false;
mpu_armv71.$name        = "REGISTERS";

mpu_armv72.size  = 15;
mpu_armv72.$name = "TCMA";

mpu_armv73.baseAddr = 0x41010000;
mpu_armv73.size     = 15;
mpu_armv73.$name    = "TCMB";

mpu_armv74.baseAddr = 0x72000000;
mpu_armv74.$name    = "MSRAM_BANK0";
mpu_armv74.size     = 19;

mpu_armv75.baseAddr   = 0x72400000;
mpu_armv75.size       = 21;
mpu_armv75.$name      = "MSRAM_BANK4_TO_BANK5";
mpu_armv75.attributes = "NonCached";

mpu_armv76.size       = 15;
mpu_armv76.$name      = "NonSelfTCMA0";
mpu_armv76.baseAddr   = 0x5E00000;
mpu_armv76.attributes = "NonCached";

mpu_armv77.attributes = "NonCached";
mpu_armv77.baseAddr   = 0x72080000;
mpu_armv77.size       = 19;
mpu_armv77.$name      = "MSRAM_BANK1_0";

mpu_armv78.attributes = "NonCached";
mpu_armv78.size       = 19;
mpu_armv78.baseAddr   = 0x72100000;
mpu_armv78.$name      = "MSRAM_BANK1_1";

mpu_armv79.baseAddr = 0x72180000;
mpu_armv79.size     = 19;
mpu_armv79.$name    = "MSRAM_BANK2";

mpu_armv710.baseAddr = 0x72200000;
mpu_armv710.size     = 21;
mpu_armv710.$name    = "MSRAM_BANK3";
