/**
 * @cliArgs --device "AM275x" --part "AM2754" --package "ANJ" --context "c75ss0-0" --product "MCU_PLUS_SDK@07.03.01"
 * @versions {"tool":"1.24.2+4234"}
 */

/**
 * Import the modules used in this configuration.
 */
const hyperRam    = scripting.addModule("/board/hyperRam/hyperRam", {}, false);
const hyperRam1   = hyperRam.addInstance();
const udma        = scripting.addModule("/drivers/udma/udma", {}, false);
const udma1       = udma.addInstance();
const debug_log   = scripting.addModule("/kernel/dpl/debug_log");
const mmu_armv8   = scripting.addModule("/kernel/dpl/mmu_armv8", {}, false);
const mmu_armv81  = mmu_armv8.addInstance();
const mmu_armv82  = mmu_armv8.addInstance();
const mmu_armv83  = mmu_armv8.addInstance();
const mmu_armv84  = mmu_armv8.addInstance();
const mmu_armv85  = mmu_armv8.addInstance();
const mmu_armv86  = mmu_armv8.addInstance();
const mmu_armv87  = mmu_armv8.addInstance();
const mmu_armv88  = mmu_armv8.addInstance();
const mmu_armv89  = mmu_armv8.addInstance();
const mmu_armv810 = mmu_armv8.addInstance();
const mmu_armv811 = mmu_armv8.addInstance();
const mmu_armv812 = mmu_armv8.addInstance();
const mmu_armv813 = mmu_armv8.addInstance();

/**
 * Write custom configuration values to the imported modules.
 */
hyperRam1.$name                          = "CONFIG_HYPERRAM0";
hyperRam1.peripheralDriver.$name         = "CONFIG_HYPERBUS0";
hyperRam1.peripheralDriver.eccEnableFlag = true;
hyperRam1.peripheralDriver.eccstart0     = 0x19000;
hyperRam1.peripheralDriver.eccsize0      = 0x19000;

udma1.$name                                     = "CONFIG_UDMA0";
hyperRam1.peripheralDriver.udmaDriver           = udma1;
udma1.udmaBlkCopyChannel.create(1);
udma1.udmaBlkCopyChannel[0].$name               = "CONFIG_UDMA_BLKCOPY_CH0";
udma1.udmaBlkCopyChannel[0].intrEnable          = true;
udma1.udmaBlkCopyChannel[0].transferCallbackFxn = "hyperRam_app_udmaEventCb";

const udma_blkcopy_channel                    = scripting.addModule("/drivers/udma/udma_blkcopy_channel", {}, false);
const udma_blkcopy_channel2                   = udma_blkcopy_channel.addInstance({}, false);
udma_blkcopy_channel2.$name                   = "CONFIG_UDMA_BLKCOPY_CH1";
hyperRam1.peripheralDriver.udmaBlkCopyChannel = udma_blkcopy_channel2;

debug_log.enableUartLog            = true;
debug_log.uartLog.$name            = "CONFIG_UART0";
debug_log.uartLog.UART.$assign     = "UART2";
debug_log.uartLog.UART.TXD.$assign = "SPI1_CS1";

mmu_armv81.size  = 0x20000000;
mmu_armv81.$name = "REGISTERS_REGION0";

mmu_armv82.vAddr = 0x20000000;
mmu_armv82.pAddr = 0x20000000;
mmu_armv82.size  = 0x20000000;
mmu_armv82.$name = "REGISTERS_REGION1";

mmu_armv83.vAddr = 0x40000000;
mmu_armv83.pAddr = 0x40000000;
mmu_armv83.size  = 0x20000000;
mmu_armv83.$name = "REGISTERS_REGION2";

mmu_armv84.vAddr = 0x7C200000;
mmu_armv84.pAddr = 0x7C200000;
mmu_armv84.$name = "CLEC";
mmu_armv84.size  = 0x100000;

mmu_armv85.$name = "DRU";
mmu_armv85.vAddr = 0x7C400000;
mmu_armv85.pAddr = 0x7C400000;
mmu_armv85.size  = 0x300000;

mmu_armv86.$name     = "L2SRAM";
mmu_armv86.vAddr     = 0x7E000000;
mmu_armv86.pAddr     = 0x7E000000;
mmu_armv86.attribute = "MAIR7";
mmu_armv86.size      = 0x200000;

mmu_armv87.$name     = "L2SRAM_AUX";
mmu_armv87.vAddr     = 0x7E200000;
mmu_armv87.pAddr     = 0x7E200000;
mmu_armv87.size      = 0x40000;
mmu_armv87.attribute = "MAIR7";

mmu_armv88.attribute = "MAIR7";
mmu_armv88.$name     = "MSRAM_BANK0_TO_BANK3";
mmu_armv88.vAddr     = 0x80000000;
mmu_armv88.pAddr     = 0x80000000;
mmu_armv88.size      = 0x400000;

mmu_armv89.$name     = "MSRAM_BANK4_TO_BANK5";
mmu_armv89.size      = 0x200000;
mmu_armv89.attribute = "MAIR7";
mmu_armv89.vAddr     = 0x80400000;
mmu_armv89.pAddr     = 0x80400000;

mmu_armv810.size      = 0x1000;
mmu_armv810.attribute = "MAIR4";
mmu_armv810.pAddr     = 0x8027F000;
mmu_armv810.vAddr     = 0x8027F000;
mmu_armv810.$name     = "CCS_DEBUG_LOG_MEM";

mmu_armv811.$name     = "HYPERRAM_REGION";
mmu_armv811.vAddr     = 0x68000000;
mmu_armv811.pAddr     = 0x68000000;
mmu_armv811.size      = 0x4000000;
mmu_armv811.attribute = "MAIR6";

mmu_armv812.vAddr = 0x68000000;
mmu_armv812.pAddr = 0x68000000;
mmu_armv812.$name = "HYPERRAM_ID0";
mmu_armv812.size  = 0x1000;

mmu_armv813.size  = 0x1000;
mmu_armv813.$name = "HYPERRAM_CR0";
mmu_armv813.vAddr = 0x68001000;
mmu_armv813.pAddr = 0x68001000;

/**
 * Pinmux solution for unlocked pins/peripherals. This ensures that minor changes to the automatic solver in a future
 * version of the tool will not impact the pinmux you originally saw.  These lines can be completely deleted in order to
 * re-solve from scratch.
 */
hyperRam1.peripheralDriver.HYPERBUS.$suggestSolution         = "HYPERBUS";
hyperRam1.peripheralDriver.HYPERBUS.CK.$suggestSolution      = "OSPI1_CLK";
hyperRam1.peripheralDriver.HYPERBUS.CKn.$suggestSolution     = "OSPI1_LBCLKO";
hyperRam1.peripheralDriver.HYPERBUS.CSn0.$suggestSolution    = "OSPI1_CSn0";
hyperRam1.peripheralDriver.HYPERBUS.RWDS.$suggestSolution    = "OSPI1_DQS";
hyperRam1.peripheralDriver.HYPERBUS.WPn.$suggestSolution     = "OSPI0_CSn2";
hyperRam1.peripheralDriver.HYPERBUS.RESETn.$suggestSolution  = "OSPI1_CSn1";
hyperRam1.peripheralDriver.HYPERBUS.RESETOn.$suggestSolution = "OSPI0_LBCLKO";
hyperRam1.peripheralDriver.HYPERBUS.INTn.$suggestSolution    = "OSPI0_CSn3";
hyperRam1.peripheralDriver.HYPERBUS.DQ7.$suggestSolution     = "OSPI1_D7";
hyperRam1.peripheralDriver.HYPERBUS.DQ6.$suggestSolution     = "OSPI1_D6";
hyperRam1.peripheralDriver.HYPERBUS.DQ5.$suggestSolution     = "OSPI1_D5";
hyperRam1.peripheralDriver.HYPERBUS.DQ4.$suggestSolution     = "OSPI1_D4";
hyperRam1.peripheralDriver.HYPERBUS.DQ3.$suggestSolution     = "OSPI1_D3";
hyperRam1.peripheralDriver.HYPERBUS.DQ2.$suggestSolution     = "OSPI1_D2";
hyperRam1.peripheralDriver.HYPERBUS.DQ1.$suggestSolution     = "OSPI1_D1";
hyperRam1.peripheralDriver.HYPERBUS.DQ0.$suggestSolution     = "OSPI1_D0";
debug_log.uartLog.UART.RXD.$suggestSolution                  = "MCASP0_AXR6";
