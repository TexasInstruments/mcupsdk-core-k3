/**
 * @cliArgs --device "AM275x" --part "AM2754" --package "ANJ" --context "r5fss0-0" --product "MCU_PLUS_SDK@07.03.01"
 * @versions {"tool":"1.24.0+4150"}
 */

/**
 * Import the modules used in this configuration.
 */
const hyperRam   = scripting.addModule("/board/hyperRam/hyperRam", {}, false);
const hyperRam1  = hyperRam.addInstance();
const udma       = scripting.addModule("/drivers/udma/udma", {}, false);
const udma1      = udma.addInstance();
const debug_log  = scripting.addModule("/kernel/dpl/debug_log");
const mpu_armv7  = scripting.addModule("/kernel/dpl/mpu_armv7", {}, false);
const mpu_armv71 = mpu_armv7.addInstance();
const mpu_armv72 = mpu_armv7.addInstance();
const mpu_armv73 = mpu_armv7.addInstance();
const mpu_armv74 = mpu_armv7.addInstance();
const mpu_armv75 = mpu_armv7.addInstance();
const mpu_armv76 = mpu_armv7.addInstance();
const mpu_armv77 = mpu_armv7.addInstance();
const mpu_armv78 = mpu_armv7.addInstance();

/**
 * Write custom configuration values to the imported modules.
 */
hyperRam1.$name                          = "CONFIG_HYPERRAM0";
hyperRam1.peripheralDriver.$name         = "CONFIG_HYPERBUS0";
hyperRam1.peripheralDriver.eccEnableFlag = true;
hyperRam1.peripheralDriver.eccstart0     = 0x19000;
hyperRam1.peripheralDriver.eccsize0      = 0x19000;
hyperRam1.peripheralDriver.deviceSize    = 0x4000000;

udma1.$name                                     = "CONFIG_UDMA0";
hyperRam1.peripheralDriver.udmaDriver           = udma1;
udma1.udmaBlkCopyChannel.create(1);
udma1.udmaBlkCopyChannel[0].$name               = "CONFIG_UDMA_BLKCOPY_CH0";
udma1.udmaBlkCopyChannel[0].intrEnable          = true;
udma1.udmaBlkCopyChannel[0].transferCallbackFxn = "hyperRam_app_udmaEventCb";

const udma_blkcopy_channel                    = scripting.addModule("/drivers/udma/udma_blkcopy_channel", {}, false);
const udma_blkcopy_channel2                   = udma_blkcopy_channel.addInstance({}, false);
udma_blkcopy_channel2.$name                   = "CONFIG_UDMA_BLKCOPY_CH1";
hyperRam1.peripheralDriver.udmaBlkCopyChannel = udma_blkcopy_channel2;

debug_log.enableUartLog            = true;
debug_log.enableSharedMemLogReader = true;
debug_log.uartLog.$name            = "CONFIG_UART0";
debug_log.uartLog.UART.$assign     = "UART0";
debug_log.uartLog.UART.RXD.$assign = "UART0_RXD";
debug_log.uartLog.UART.TXD.$assign = "UART0_TXD";

mpu_armv71.size         = 31;
mpu_armv71.attributes   = "Device";
mpu_armv71.allowExecute = false;
mpu_armv71.$name        = "REGISTERS";

mpu_armv72.size  = 15;
mpu_armv72.$name = "TCMA";

mpu_armv73.baseAddr = 0x41010000;
mpu_armv73.size     = 15;
mpu_armv73.$name    = "TCMB";

mpu_armv74.size        = 22;
mpu_armv74.baseAddr    = 0x72000000;
mpu_armv74.$name       = "MSRAM_BANK0_TO_BANK3";
mpu_armv74.tex         = 5;
mpu_armv74.isCacheable = false;

mpu_armv75.baseAddr = 0x72400000;
mpu_armv75.size     = 21;
mpu_armv75.$name    = "MSRAM_BANK4_TO_BANK5";

mpu_armv76.$name        = "HYPERBUS_REGISTERS";
mpu_armv76.baseAddr     = 0xFC34000;
mpu_armv76.size         = 8;
mpu_armv76.allowExecute = false;
mpu_armv76.attributes   = "Device";

mpu_armv77.$name      = "HYPERRAM_REGION";
mpu_armv77.baseAddr   = 0x68000000;
mpu_armv77.attributes = "CUSTOM";
mpu_armv77.tex        = 5;
mpu_armv77.size       = 26;

mpu_armv78.$name        = "FSS_FSAS_REGION";
mpu_armv78.baseAddr     = 0xFC9000;
mpu_armv78.size         = 5;
mpu_armv78.allowExecute = false;
mpu_armv78.attributes   = "Device";

/**
 * Pinmux solution for unlocked pins/peripherals. This ensures that minor changes to the automatic solver in a future
 * version of the tool will not impact the pinmux you originally saw.  These lines can be completely deleted in order to
 * re-solve from scratch.
 */
hyperRam1.peripheralDriver.HYPERBUS.$suggestSolution         = "HYPERBUS";
hyperRam1.peripheralDriver.HYPERBUS.CK.$suggestSolution      = "OSPI1_CLK";
hyperRam1.peripheralDriver.HYPERBUS.CKn.$suggestSolution     = "OSPI1_LBCLKO";
hyperRam1.peripheralDriver.HYPERBUS.CSn0.$suggestSolution    = "OSPI1_CSn0";
hyperRam1.peripheralDriver.HYPERBUS.RWDS.$suggestSolution    = "OSPI1_DQS";
hyperRam1.peripheralDriver.HYPERBUS.WPn.$suggestSolution     = "OSPI0_CSn2";
hyperRam1.peripheralDriver.HYPERBUS.RESETn.$suggestSolution  = "OSPI1_CSn1";
hyperRam1.peripheralDriver.HYPERBUS.RESETOn.$suggestSolution = "OSPI0_LBCLKO";
hyperRam1.peripheralDriver.HYPERBUS.INTn.$suggestSolution    = "OSPI0_CSn3";
hyperRam1.peripheralDriver.HYPERBUS.DQ7.$suggestSolution     = "OSPI1_D7";
hyperRam1.peripheralDriver.HYPERBUS.DQ6.$suggestSolution     = "OSPI1_D6";
hyperRam1.peripheralDriver.HYPERBUS.DQ5.$suggestSolution     = "OSPI1_D5";
hyperRam1.peripheralDriver.HYPERBUS.DQ4.$suggestSolution     = "OSPI1_D4";
hyperRam1.peripheralDriver.HYPERBUS.DQ3.$suggestSolution     = "OSPI1_D3";
hyperRam1.peripheralDriver.HYPERBUS.DQ2.$suggestSolution     = "OSPI1_D2";
hyperRam1.peripheralDriver.HYPERBUS.DQ1.$suggestSolution     = "OSPI1_D1";
hyperRam1.peripheralDriver.HYPERBUS.DQ0.$suggestSolution     = "OSPI1_D0";
