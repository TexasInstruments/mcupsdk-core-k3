/**
 * @cliArgs --device "AM275x" --part "AM2754" --package "ANJ" --context "c75ss0-0" --product "MCU_PLUS_SDK@07.03.01"
 * @versions {"tool":"1.24.2+4234"}
 */

/**
 * Import the modules used in this configuration.
 */
const aasrc       = scripting.addModule("/drivers/aasrc/aasrc", {}, false);
const aasrc1      = aasrc.addInstance();
const debug_log   = scripting.addModule("/kernel/dpl/debug_log");
const mmu_armv8   = scripting.addModule("/kernel/dpl/mmu_armv8", {}, false);
const mmu_armv81  = mmu_armv8.addInstance();
const mmu_armv82  = mmu_armv8.addInstance();
const mmu_armv83  = mmu_armv8.addInstance();
const mmu_armv84  = mmu_armv8.addInstance();
const mmu_armv85  = mmu_armv8.addInstance();
const mmu_armv86  = mmu_armv8.addInstance();
const mmu_armv87  = mmu_armv8.addInstance();
const mmu_armv88  = mmu_armv8.addInstance();
const mmu_armv89  = mmu_armv8.addInstance();
const mmu_armv810 = mmu_armv8.addInstance();

/**
 * Write custom configuration values to the imported modules.
 */
aasrc1.$name                                        = "CONFIG_AASRC0";
aasrc1.aasrcChannel.create(3);
aasrc1.aasrcChannel[0].$name                        = "CONFIG_AASRC_CH0";
aasrc1.aasrcChannel[0].txCallbackFxn                = "aasrc_txcb";
aasrc1.aasrcChannel[0].rxCallbackFxn                = "aasrc_rxcb";
aasrc1.aasrcChannel[0].errorCallbackFxn             = "aasrc_ch_error_handler";
aasrc1.aasrcChannel[0].txLoopjobBufLength           = 1024;
aasrc1.aasrcChannel[0].rxLoopjobBufLength           = 1024;
aasrc1.aasrcChannel[1].$name                        = "CONFIG_AASRC_CH1";
aasrc1.aasrcChannel[1].channelType                  = "STEREO";
aasrc1.aasrcChannel[1].outClockZone                 = "1";
aasrc1.aasrcChannel[1].txCallbackFxn                = "aasrc_txcb";
aasrc1.aasrcChannel[1].rxCallbackFxn                = "aasrc_rxcb";
aasrc1.aasrcChannel[1].errorCallbackFxn             = "aasrc_ch_error_handler";
aasrc1.aasrcChannel[1].txLoopjobBufLength           = 4096;
aasrc1.aasrcChannel[1].rxLoopjobBufLength           = 2048;
aasrc1.aasrcChannel[1].txLoopjobBuf                 = "gStereoTxLoopjobBuf0";
aasrc1.aasrcChannel[1].rxLoopjobBuf                 = "gStereoRxLoopjobBuf0";
aasrc1.aasrcChannel[2].$name                        = "CONFIG_AASRC_CH2";
aasrc1.aasrcChannel[2].channelType                  = "GROUP";
aasrc1.aasrcChannel[2].errorCallbackFxn             = "aasrc_ch_error_handler";
aasrc1.aasrcChannel[2].txCallbackFxn                = "aasrc_txcb";
aasrc1.aasrcChannel[2].rxCallbackFxn                = "aasrc_rxcb";
aasrc1.aasrcChannel[2].txLoopjobBuf                 = "gGroupTxLoopjobBuf0";
aasrc1.aasrcChannel[2].rxLoopjobBuf                 = "gGroupRxLoopjobBuf0";
aasrc1.aasrcChannel[2].txLoopjobBufLength           = 5120;
aasrc1.aasrcChannel[2].rxLoopjobBufLength           = 5120;
aasrc1.aasrcChannel[2].channelCount                 = "5";
aasrc1.aasrcReceiveClockZone[0].$name               = "CONFIG_AASRC_CLOCKZONE0";
aasrc1.aasrcReceiveClockZone[0].clkZoneDiv          = 128;
aasrc1.aasrcReceiveClockZone[0].isClkZoneDivEnable  = true;
aasrc1.aasrcTransmitClockZone.create(2);
aasrc1.aasrcTransmitClockZone[0].$name              = "CONFIG_AASRC_CLOCKZONE1";
aasrc1.aasrcTransmitClockZone[0].clkZoneDiv         = 256;
aasrc1.aasrcTransmitClockZone[0].isClkZoneDivEnable = true;
aasrc1.aasrcTransmitClockZone[1].$name              = "CONFIG_AASRC_CLOCKZONE2";
aasrc1.aasrcTransmitClockZone[1].syncPin            = "1";
aasrc1.aasrcTransmitClockZone[1].clkZoneDiv         = 120;
aasrc1.aasrcTransmitClockZone[1].isClkZoneDivEnable = true;
aasrc1.aasrcTransmitClockZone[1].extClkSrc          = "ADC0_CLK";

const udma        = scripting.addModule("/drivers/udma/udma", {}, false);
const udma1       = udma.addInstance({}, false);
udma1.$name       = "CONFIG_UDMA0";
aasrc1.udmaDriver = udma1;

debug_log.enableUartLog            = true;
debug_log.enableCssLog             = false;
debug_log.uartLog.$name            = "CONFIG_UART0";
debug_log.uartLog.intrEnable       = "DISABLE";
debug_log.uartLog.UART.$assign     = "UART2";
debug_log.uartLog.UART.TXD.$assign = "SPI1_CS1";

mmu_armv81.size  = 0x20000000;
mmu_armv81.$name = "REGISTERS_REGION0";

mmu_armv82.vAddr = 0x20000000;
mmu_armv82.pAddr = 0x20000000;
mmu_armv82.size  = 0x20000000;
mmu_armv82.$name = "REGISTERS_REGION1";

mmu_armv83.vAddr = 0x40000000;
mmu_armv83.pAddr = 0x40000000;
mmu_armv83.size  = 0x20000000;
mmu_armv83.$name = "REGISTERS_REGION2";

mmu_armv84.vAddr = 0x7C200000;
mmu_armv84.pAddr = 0x7C200000;
mmu_armv84.$name = "CLEC";
mmu_armv84.size  = 0x100000;

mmu_armv85.$name = "DRU";
mmu_armv85.vAddr = 0x7C400000;
mmu_armv85.pAddr = 0x7C400000;
mmu_armv85.size  = 0x300000;

mmu_armv86.$name     = "L2SRAM";
mmu_armv86.vAddr     = 0x7E000000;
mmu_armv86.pAddr     = 0x7E000000;
mmu_armv86.attribute = "MAIR7";
mmu_armv86.size      = 0x200000;

mmu_armv87.$name     = "L2SRAM_AUX";
mmu_armv87.vAddr     = 0x7E200000;
mmu_armv87.pAddr     = 0x7E200000;
mmu_armv87.size      = 0x40000;
mmu_armv87.attribute = "MAIR7";

mmu_armv88.attribute = "MAIR7";
mmu_armv88.$name     = "MSRAM_BANK0_TO_BANK3";
mmu_armv88.vAddr     = 0x80000000;
mmu_armv88.pAddr     = 0x80000000;
mmu_armv88.size      = 0x400000;

mmu_armv89.$name     = "MSRAM_BANK4_TO_BANK5";
mmu_armv89.size      = 0x200000;
mmu_armv89.attribute = "MAIR7";
mmu_armv89.vAddr     = 0x80400000;
mmu_armv89.pAddr     = 0x80400000;

mmu_armv810.size      = 0x1000;
mmu_armv810.attribute = "MAIR4";
mmu_armv810.pAddr     = 0x8027F000;
mmu_armv810.vAddr     = 0x8027F000;
mmu_armv810.$name     = "CCS_DEBUG_LOG_MEM";

/**
 * Pinmux solution for unlocked pins/peripherals. This ensures that minor changes to the automatic solver in a future
 * version of the tool will not impact the pinmux you originally saw.  These lines can be completely deleted in order to
 * re-solve from scratch.
 */
debug_log.uartLog.UART.RXD.$suggestSolution = "MCASP0_AXR6";
