/**
 * @cliArgs --device "AM275x" --part "AM2754" --package "ANJ" --context "wkup-r5fss0-0" --product "MCU_PLUS_SDK@07.03.01"
 * @versions {"tool":"1.24.2+4234"}
 */

/**
 * Import the modules used in this configuration.
 */
const hyperRam    = scripting.addModule("/board/hyperRam/hyperRam", {}, false);
const hyperRam1   = hyperRam.addInstance();
const bootloader  = scripting.addModule("/drivers/bootloader/bootloader", {}, false);
const bootloader1 = bootloader.addInstance();
const bootloader2 = bootloader.addInstance();
const bootloader3 = bootloader.addInstance();
const bootloader4 = bootloader.addInstance();
const bootloader5 = bootloader.addInstance();
const bootloader6 = bootloader.addInstance();
const mcu_bist    = scripting.addModule("/drivers/mcu_bist/mcu_bist", {}, false);
const mcu_bist1   = mcu_bist.addInstance();
const mmcsd       = scripting.addModule("/drivers/mmcsd/mmcsd", {}, false);
const mmcsd1      = mmcsd.addInstance();
const debug_log   = scripting.addModule("/kernel/dpl/debug_log");
const mpu_armv7   = scripting.addModule("/kernel/dpl/mpu_armv7", {}, false);
const mpu_armv71  = mpu_armv7.addInstance();
const mpu_armv72  = mpu_armv7.addInstance();
const mpu_armv73  = mpu_armv7.addInstance();
const mpu_armv74  = mpu_armv7.addInstance();
const mpu_armv75  = mpu_armv7.addInstance();
const mpu_armv76  = mpu_armv7.addInstance();
const mpu_armv77  = mpu_armv7.addInstance();
const mpu_armv78  = mpu_armv7.addInstance();
const mpu_armv79  = mpu_armv7.addInstance();

/**
 * Write custom configuration values to the imported modules.
 */
hyperRam1.$name                  = "CONFIG_HYPERRAM0";
hyperRam1.addedByBootloader      = true;
hyperRam1.peripheralDriver.$name = "CONFIG_HYPERBUS0";

bootloader1.bootMedia          = "EMMC";
bootloader1.$name              = "CONFIG_BOOTLOADER_R50_0";
bootloader1.EMMCAppImageOffset = "0x400000";

bootloader2.$name              = "CONFIG_BOOTLOADER_R50_1";
bootloader2.bootMedia          = "EMMC";
bootloader2.EMMCAppImageOffset = "0x800000";

bootloader3.$name              = "CONFIG_BOOTLOADER_R51_0";
bootloader3.bootMedia          = "EMMC";
bootloader3.EMMCAppImageOffset = "0xC00000";

bootloader4.$name              = "CONFIG_BOOTLOADER_R51_1";
bootloader4.bootMedia          = "EMMC";
bootloader4.EMMCAppImageOffset = "0x1000000";

bootloader5.$name              = "CONFIG_BOOTLOADER_C750";
bootloader5.bootMedia          = "EMMC";
bootloader5.EMMCAppImageOffset = "0x1400000";

bootloader6.$name              = "CONFIG_BOOTLOADER_C751";
bootloader6.bootMedia          = "EMMC";
bootloader6.EMMCAppImageOffset = "0x1800000";

mcu_bist1.$name                        = "CONFIG_BIST0";
mcu_bist1.SDL_PBIST_INST_MAIN_PULSAR_0 = true;
mcu_bist1.SDL_PBIST_INST_MAIN_PULSAR_1 = true;
mcu_bist1.SDL_PBIST_INST_C7X_0         = true;
mcu_bist1.SDL_PBIST_INST_C7X_1         = true;
mcu_bist1.SDL_PBIST_INST_MAIN_IP       = true;

bootloader1.MMCSDDriver = mmcsd1;
mmcsd1.$name            = "CONFIG_MMCSD_SBL";
bootloader2.MMCSDDriver = mmcsd1;
bootloader3.MMCSDDriver = mmcsd1;
bootloader4.MMCSDDriver = mmcsd1;
bootloader5.MMCSDDriver = mmcsd1;
bootloader6.MMCSDDriver = mmcsd1;

const udma             = scripting.addModule("/drivers/udma/udma", {}, false);
const udma1            = udma.addInstance({}, false);
udma1.$name            = "CONFIG_UDMA0";
bootloader1.udmaDriver = udma1;
bootloader2.udmaDriver = udma1;
bootloader3.udmaDriver = udma1;
bootloader4.udmaDriver = udma1;
bootloader5.udmaDriver = udma1;
bootloader6.udmaDriver = udma1;

const udma_blkcopy_channel     = scripting.addModule("/drivers/udma/udma_blkcopy_channel", {}, false);
const udma_blkcopy_channel1    = udma_blkcopy_channel.addInstance({}, false);
udma_blkcopy_channel1.$name    = "CONFIG_UDMA_BLKCOPY_CH0";
bootloader1.udmaBlkCopyChannel = udma_blkcopy_channel1;
bootloader2.udmaBlkCopyChannel = udma_blkcopy_channel1;
bootloader3.udmaBlkCopyChannel = udma_blkcopy_channel1;
bootloader4.udmaBlkCopyChannel = udma_blkcopy_channel1;
bootloader5.udmaBlkCopyChannel = udma_blkcopy_channel1;
bootloader6.udmaBlkCopyChannel = udma_blkcopy_channel1;

debug_log.enableUartLog                      = true;
debug_log.uartLog.intrEnable                 = "DISABLE";
debug_log.uartLog.$name                      = "CONFIG_UART_SBL";
debug_log.uartLog.addedByBootloader          = true;
debug_log.uartLog.useWakeupDomainPeripherals = true;
debug_log.uartLog.WKUP_UART.$assign          = "WKUP_UART";

mpu_armv71.size         = 31;
mpu_armv71.attributes   = "Device";
mpu_armv71.allowExecute = false;
mpu_armv71.$name        = "REGISTERS";

mpu_armv72.size       = 15;
mpu_armv72.$name      = "TCMA";
mpu_armv72.attributes = "NonCached";

mpu_armv73.baseAddr   = 0x41010000;
mpu_armv73.size       = 15;
mpu_armv73.$name      = "TCMB";
mpu_armv73.attributes = "NonCached";

mpu_armv74.$name    = "MSRAM_BANK0_TO_BANK3";
mpu_armv74.baseAddr = 0x72000000;
mpu_armv74.size     = 22;

mpu_armv75.$name    = "MSRAM_BANK4_TO_BANK5";
mpu_armv75.baseAddr = 0x72400000;
mpu_armv75.size     = 21;

mpu_armv76.$name             = "RESET_VECTORS";
mpu_armv76.size              = 7;
mpu_armv76.accessPermissions = "Supervisor RD+WR, User RD";

mpu_armv77.$name      = "HYPERRAM";
mpu_armv77.baseAddr   = 0x68000000;
mpu_armv77.attributes = "CUSTOM";
mpu_armv77.size       = 26;
mpu_armv77.tex        = 5;

mpu_armv78.$name        = "HYPERRAM_CR0_CR1";
mpu_armv78.baseAddr     = 0x68001000;
mpu_armv78.size         = 5;
mpu_armv78.attributes   = "Device";
mpu_armv78.allowExecute = false;

mpu_armv79.size         = 5;
mpu_armv79.attributes   = "Device";
mpu_armv79.allowExecute = false;
mpu_armv79.$name        = "HYPERRAM_ID0_ID1";
mpu_armv79.baseAddr     = 0x68000000;

/**
 * Pinmux solution for unlocked pins/peripherals. This ensures that minor changes to the automatic solver in a future
 * version of the tool will not impact the pinmux you originally saw.  These lines can be completely deleted in order to
 * re-solve from scratch.
 */
hyperRam1.peripheralDriver.HYPERBUS.$suggestSolution         = "HYPERBUS";
hyperRam1.peripheralDriver.HYPERBUS.CK.$suggestSolution      = "OSPI1_CLK";
hyperRam1.peripheralDriver.HYPERBUS.CKn.$suggestSolution     = "OSPI1_LBCLKO";
hyperRam1.peripheralDriver.HYPERBUS.CSn0.$suggestSolution    = "OSPI1_CSn0";
hyperRam1.peripheralDriver.HYPERBUS.RWDS.$suggestSolution    = "OSPI1_DQS";
hyperRam1.peripheralDriver.HYPERBUS.WPn.$suggestSolution     = "OSPI0_CSn2";
hyperRam1.peripheralDriver.HYPERBUS.RESETn.$suggestSolution  = "OSPI1_CSn1";
hyperRam1.peripheralDriver.HYPERBUS.RESETOn.$suggestSolution = "OSPI0_LBCLKO";
hyperRam1.peripheralDriver.HYPERBUS.INTn.$suggestSolution    = "OSPI0_CSn3";
hyperRam1.peripheralDriver.HYPERBUS.DQ7.$suggestSolution     = "OSPI1_D7";
hyperRam1.peripheralDriver.HYPERBUS.DQ6.$suggestSolution     = "OSPI1_D6";
hyperRam1.peripheralDriver.HYPERBUS.DQ5.$suggestSolution     = "OSPI1_D5";
hyperRam1.peripheralDriver.HYPERBUS.DQ4.$suggestSolution     = "OSPI1_D4";
hyperRam1.peripheralDriver.HYPERBUS.DQ3.$suggestSolution     = "OSPI1_D3";
hyperRam1.peripheralDriver.HYPERBUS.DQ2.$suggestSolution     = "OSPI1_D2";
hyperRam1.peripheralDriver.HYPERBUS.DQ1.$suggestSolution     = "OSPI1_D1";
hyperRam1.peripheralDriver.HYPERBUS.DQ0.$suggestSolution     = "OSPI1_D0";
mmcsd1.MMC.$suggestSolution                                  = "MMC0";
mmcsd1.MMC.MMC_CLK.$suggestSolution                          = "MMC0_CLK";
mmcsd1.MMC.MMC_CMD.$suggestSolution                          = "MMC0_CMD";
mmcsd1.MMC.MMC_DAT0.$suggestSolution                         = "MMC0_DAT0";
mmcsd1.MMC.MMC_DAT1.$suggestSolution                         = "MMC0_DAT1";
mmcsd1.MMC.MMC_DAT2.$suggestSolution                         = "MMC0_DAT2";
mmcsd1.MMC.MMC_DAT3.$suggestSolution                         = "MMC0_DAT3";
mmcsd1.MMC.MMC_DAT4.$suggestSolution                         = "MMC0_DAT4";
mmcsd1.MMC.MMC_DAT5.$suggestSolution                         = "MMC0_DAT5";
mmcsd1.MMC.MMC_DAT6.$suggestSolution                         = "MMC0_DAT6";
mmcsd1.MMC.MMC_DAT7.$suggestSolution                         = "MMC0_DAT7";
debug_log.uartLog.WKUP_UART.RXD.$suggestSolution             = "WKUP_UART0_RXD";
debug_log.uartLog.WKUP_UART.TXD.$suggestSolution             = "WKUP_UART0_TXD";
