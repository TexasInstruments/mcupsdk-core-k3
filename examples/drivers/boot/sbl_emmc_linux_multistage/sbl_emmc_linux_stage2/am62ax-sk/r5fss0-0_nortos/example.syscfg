/**
 * @cliArgs --device "AM62Ax" --package "AMB" --part "Default" --context "r5fss0-0" --product "MCU_PLUS_SDK@07.03.01"
 * @versions {"tool":"1.15.0+2826"}
 */

/**
 * Import the modules used in this configuration.
 */
const bootloader  = scripting.addModule("/drivers/bootloader/bootloader", {}, false);
const bootloader1 = bootloader.addInstance();
const bootloader2 = bootloader.addInstance();
const bootloader3 = bootloader.addInstance();
const gtc         = scripting.addModule("/drivers/gtc/gtc");
const mmcsd       = scripting.addModule("/drivers/mmcsd/mmcsd", {}, false);
const mmcsd1      = mmcsd.addInstance();
const clock       = scripting.addModule("/kernel/dpl/clock");
const debug_log   = scripting.addModule("/kernel/dpl/debug_log");

/**
 * Write custom configuration values to the imported modules.
 */
bootloader1.bootMedia          = "EMMC";
bootloader1.$name              = "CONFIG_BOOTLOADER_EMMC_HSM";
bootloader1.EMMCAppImageOffset = "0x800000";

bootloader2.bootMedia          = "EMMC";
bootloader2.$name              = "CONFIG_BOOTLOADER_EMMC_DM";
bootloader2.EMMCAppImageOffset = "0xA00000";

bootloader3.$name              = "CONFIG_BOOTLOADER_EMMC_LINUX";
bootloader3.appImageOffset     = "0xC00000";
bootloader3.bootMedia          = "EMMC";
bootloader3.EMMCAppImageOffset = "0xC00000";

mmcsd1.$name            = "CONFIG_MMCSD0";
bootloader1.MMCSDDriver = mmcsd1;
bootloader2.MMCSDDriver = mmcsd1;
bootloader3.MMCSDDriver = mmcsd1;
mmcsd1.MMC0.$assign     = "MMC0";

debug_log.enableUartLog                      = true;
debug_log.enableCssLog                       = false;
debug_log.uartLog.$name                      = "CONFIG_UART0";
debug_log.uartLog.useWakeupDomainPeripherals = false;
debug_log.uartLog.intrEnable                 = "DISABLE";

/**
 * Pinmux solution for unlocked pins/peripherals. This ensures that minor changes to the automatic solver in a future
 * version of the tool will not impact the pinmux you originally saw.  These lines can be completely deleted in order to
 * re-solve from scratch.
 */
mmcsd1.MMC0.CLK.$suggestSolution            = "ball.AB7";
mmcsd1.MMC0.CMD.$suggestSolution            = "ball.Y6";
mmcsd1.MMC0.DAT0.$suggestSolution           = "ball.AA6";
mmcsd1.MMC0.DAT1.$suggestSolution           = "ball.AB6";
mmcsd1.MMC0.DAT2.$suggestSolution           = "ball.Y7";
mmcsd1.MMC0.DAT3.$suggestSolution           = "ball.AA7";
mmcsd1.MMC0.DAT4.$suggestSolution           = "ball.Y8";
mmcsd1.MMC0.DAT5.$suggestSolution           = "ball.W7";
mmcsd1.MMC0.DAT6.$suggestSolution           = "ball.W9";
mmcsd1.MMC0.DAT7.$suggestSolution           = "ball.AB8";
debug_log.uartLog.UART.$suggestSolution     = "USART0";
debug_log.uartLog.UART.RXD.$suggestSolution = "ball.E14";
debug_log.uartLog.UART.TXD.$suggestSolution = "ball.D15";
