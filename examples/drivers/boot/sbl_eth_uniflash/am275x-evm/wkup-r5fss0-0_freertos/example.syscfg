/**
 * @cliArgs --device "AM275x" --part "AM2754" --package "ANJ" --context "wkup-r5fss0-0" --product "MCU_PLUS_SDK@07.03.01"
 * @versions {"tool":"1.24.2+4234"}
 */

/**
 * Import the modules used in this configuration.
 */
const flash       = scripting.addModule("/board/flash/flash", {}, false);
const flash1      = flash.addInstance();
const bootloader  = scripting.addModule("/drivers/bootloader/bootloader", {}, false);
const bootloader1 = bootloader.addInstance();
const bootloader2 = bootloader.addInstance();
const bootloader3 = bootloader.addInstance();
const bootloader4 = bootloader.addInstance();
const bootloader5 = bootloader.addInstance();
const bootloader6 = bootloader.addInstance();
const gpio        = scripting.addModule("/drivers/gpio/gpio", {}, false);
const gpio1       = gpio.addInstance();
const gtc         = scripting.addModule("/drivers/gtc/gtc");
const mmcsd       = scripting.addModule("/drivers/mmcsd/mmcsd", {}, false);
const mmcsd1      = mmcsd.addInstance();
const debug_log   = scripting.addModule("/kernel/dpl/debug_log");
const mpu_armv7   = scripting.addModule("/kernel/dpl/mpu_armv7", {}, false);
const mpu_armv71  = mpu_armv7.addInstance();
const mpu_armv72  = mpu_armv7.addInstance();
const mpu_armv73  = mpu_armv7.addInstance();
const mpu_armv74  = mpu_armv7.addInstance();
const mpu_armv75  = mpu_armv7.addInstance();
const mpu_armv76  = mpu_armv7.addInstance();
const mpu_armv77  = mpu_armv7.addInstance();
const mpu_armv78  = mpu_armv7.addInstance();
const enet_cpsw   = scripting.addModule("/networking/enet_cpsw/enet_cpsw", {}, false);
const enet_cpsw1  = enet_cpsw.addInstance();

/**
 * Write custom configuration values to the imported modules.
 */
bootloader1.appImageOffset = "0x400000";
bootloader1.$name          = "CONFIG_BOOTLOADER_R50_0";

bootloader2.$name          = "CONFIG_BOOTLOADER_R50_1";
bootloader2.appImageOffset = "0x800000";

bootloader3.$name          = "CONFIG_BOOTLOADER_R51_0";
bootloader3.appImageOffset = "0xC00000";

bootloader4.$name          = "CONFIG_BOOTLOADER_R51_1";
bootloader4.appImageOffset = "0x1000000";

bootloader5.$name          = "CONFIG_BOOTLOADER_C750";
bootloader5.appImageOffset = "0x1400000";

bootloader6.$name          = "CONFIG_BOOTLOADER_C751";
bootloader6.appImageOffset = "0x1800000";

bootloader1.flashDriver                                = flash1;
flash1.$name                                           = "CONFIG_FLASH_SBL";
bootloader2.flashDriver                                = flash1;
bootloader3.flashDriver                                = flash1;
bootloader4.flashDriver                                = flash1;
bootloader5.flashDriver                                = flash1;
bootloader6.flashDriver                                = flash1;
flash1.serialFlashDriver.$name                         = "board_flash_serialFlash_serialflash0";
flash1.serialFlashDriver.peripheralDriver.$name        = "CONFIG_OSPI_SBL";
flash1.serialFlashDriver.peripheralDriver.OSPI.$assign = "OSPI0";

gpio1.$name        = "ENET_TRANSFER_START_BTN";
gpio1.trigType     = "RISE_EDGE";
gpio1.GPIO.$assign = "GPIO1_47";

mmcsd1.$name = "CONFIG_MMCSD0";

const udma             = scripting.addModule("/drivers/udma/udma", {}, false);
const udma1            = udma.addInstance({}, false);
udma1.$name            = "CONFIG_UDMA0";
bootloader1.udmaDriver = udma1;
bootloader2.udmaDriver = udma1;
bootloader3.udmaDriver = udma1;
bootloader4.udmaDriver = udma1;
bootloader5.udmaDriver = udma1;
bootloader6.udmaDriver = udma1;

const udma_blkcopy_channel     = scripting.addModule("/drivers/udma/udma_blkcopy_channel", {}, false);
const udma_blkcopy_channel1    = udma_blkcopy_channel.addInstance({}, false);
udma_blkcopy_channel1.$name    = "CONFIG_UDMA_BLKCOPY_CH0";
bootloader1.udmaBlkCopyChannel = udma_blkcopy_channel1;
bootloader2.udmaBlkCopyChannel = udma_blkcopy_channel1;
bootloader3.udmaBlkCopyChannel = udma_blkcopy_channel1;
bootloader4.udmaBlkCopyChannel = udma_blkcopy_channel1;
bootloader5.udmaBlkCopyChannel = udma_blkcopy_channel1;
bootloader6.udmaBlkCopyChannel = udma_blkcopy_channel1;

debug_log.enableUartLog            = true;
debug_log.enableCssLog             = false;
debug_log.uartTrace                = true;
debug_log.uartLog.$name            = "CONFIG_UART0";
debug_log.uartLog.intrEnable       = "DISABLE";
debug_log.uartLog.UART.RXD.$assign = "UART0_RXD";
debug_log.uartLog.UART.TXD.$assign = "UART0_TXD";

mpu_armv71.size         = 31;
mpu_armv71.attributes   = "Device";
mpu_armv71.allowExecute = false;
mpu_armv71.$name        = "CONFIG_MPU_REGISTER";

mpu_armv72.size       = 15;
mpu_armv72.$name      = "CONFIG_MPU_TCMA";
mpu_armv72.attributes = "NonCached";

mpu_armv73.baseAddr   = 0x41010000;
mpu_armv73.size       = 15;
mpu_armv73.$name      = "CONFIG_MPU_TCMB";
mpu_armv73.attributes = "NonCached";

mpu_armv74.$name    = "HSRAM";
mpu_armv74.baseAddr = 0x43C00000;
mpu_armv74.size     = 19;

mpu_armv75.$name    = "OCMC_RAM";
mpu_armv75.size     = 20;
mpu_armv75.baseAddr = 0x72000000;

mpu_armv76.$name      = "APP_IMAGE_SPACE";
mpu_armv76.attributes = "NonCached";
mpu_armv76.baseAddr   = 0x72200000;
mpu_armv76.size       = 21;

mpu_armv77.$name      = "APP_IMAGE_SPACE_2";
mpu_armv77.attributes = "NonCached";
mpu_armv77.baseAddr   = 0x72400000;
mpu_armv77.size       = 20;

mpu_armv78.$name    = "APP_IMAGE_SPACE_3";
mpu_armv78.baseAddr = 0x72500000;
mpu_armv78.size     = 20;

enet_cpsw1.$name                        = "CONFIG_ENET_CPSW0";
enet_cpsw1.RtosVariant                  = "NoRTOS";
enet_cpsw1.DisableMacPort2              = true;
enet_cpsw1.LargePoolPktCount            = 16;
enet_cpsw1.customBoardEnable            = true;
enet_cpsw1.RGMII1.$assign               = "RGMII1";
enet_cpsw1.RGMII2.$assign               = "RGMII2";
enet_cpsw1.txDmaChannel[0].$name        = "ENET_DMA_TX_CH0";
enet_cpsw1.txDmaChannel[0].PacketsCount = 8;
enet_cpsw1.rxDmaChannel[0].$name        = "ENET_DMA_RX_CH0";
enet_cpsw1.rxDmaChannel[0].PacketsCount = 8;

const udma2        = udma.addInstance({}, false);
enet_cpsw1.udmaDrv = udma2;

/**
 * Pinmux solution for unlocked pins/peripherals. This ensures that minor changes to the automatic solver in a future
 * version of the tool will not impact the pinmux you originally saw.  These lines can be completely deleted in order to
 * re-solve from scratch.
 */
flash1.serialFlashDriver.peripheralDriver.OSPI.CLK.$suggestSolution  = "OSPI0_CLK";
flash1.serialFlashDriver.peripheralDriver.OSPI.CSn0.$suggestSolution = "OSPI0_CSn0";
flash1.serialFlashDriver.peripheralDriver.OSPI.DQS.$suggestSolution  = "OSPI0_DQS";
flash1.serialFlashDriver.peripheralDriver.OSPI.D7.$suggestSolution   = "OSPI0_D7";
flash1.serialFlashDriver.peripheralDriver.OSPI.D6.$suggestSolution   = "OSPI0_D6";
flash1.serialFlashDriver.peripheralDriver.OSPI.D5.$suggestSolution   = "OSPI0_D5";
flash1.serialFlashDriver.peripheralDriver.OSPI.D4.$suggestSolution   = "OSPI0_D4";
flash1.serialFlashDriver.peripheralDriver.OSPI.D3.$suggestSolution   = "OSPI0_D3";
flash1.serialFlashDriver.peripheralDriver.OSPI.D2.$suggestSolution   = "OSPI0_D2";
flash1.serialFlashDriver.peripheralDriver.OSPI.D1.$suggestSolution   = "OSPI0_D1";
flash1.serialFlashDriver.peripheralDriver.OSPI.D0.$suggestSolution   = "OSPI0_D0";
mmcsd1.MMC.$suggestSolution                                          = "MMC0";
mmcsd1.MMC.MMC_CLK.$suggestSolution                                  = "MMC0_CLK";
mmcsd1.MMC.MMC_CMD.$suggestSolution                                  = "MMC0_CMD";
mmcsd1.MMC.MMC_DAT0.$suggestSolution                                 = "MMC0_DAT0";
mmcsd1.MMC.MMC_DAT1.$suggestSolution                                 = "MMC0_DAT1";
mmcsd1.MMC.MMC_DAT2.$suggestSolution                                 = "MMC0_DAT2";
mmcsd1.MMC.MMC_DAT3.$suggestSolution                                 = "MMC0_DAT3";
mmcsd1.MMC.MMC_DAT4.$suggestSolution                                 = "MMC0_DAT4";
mmcsd1.MMC.MMC_DAT5.$suggestSolution                                 = "MMC0_DAT5";
mmcsd1.MMC.MMC_DAT6.$suggestSolution                                 = "MMC0_DAT6";
mmcsd1.MMC.MMC_DAT7.$suggestSolution                                 = "MMC0_DAT7";
debug_log.uartLog.UART.$suggestSolution                              = "UART0";
enet_cpsw1.MDIO.$suggestSolution                                     = "MDIO0";
enet_cpsw1.MDIO.MDC.$suggestSolution                                 = "MDIO0_MDC";
enet_cpsw1.MDIO.MDIO.$suggestSolution                                = "MDIO0_MDIO";
enet_cpsw1.RGMII1.RD0.$suggestSolution                               = "RGMII1_RD0";
enet_cpsw1.RGMII1.RD1.$suggestSolution                               = "RGMII1_RD1";
enet_cpsw1.RGMII1.RD2.$suggestSolution                               = "RGMII1_RD2";
enet_cpsw1.RGMII1.RD3.$suggestSolution                               = "RGMII1_RD3";
enet_cpsw1.RGMII1.RX_CTL.$suggestSolution                            = "RGMII1_RX_CTL";
enet_cpsw1.RGMII1.RXC.$suggestSolution                               = "RGMII1_RXC";
enet_cpsw1.RGMII1.TD0.$suggestSolution                               = "RGMII1_TD0";
enet_cpsw1.RGMII1.TD1.$suggestSolution                               = "RGMII1_TD1";
enet_cpsw1.RGMII1.TD2.$suggestSolution                               = "RGMII1_TD2";
enet_cpsw1.RGMII1.TD3.$suggestSolution                               = "RGMII1_TD3";
enet_cpsw1.RGMII1.TX_CTL.$suggestSolution                            = "RGMII1_TX_CTL";
enet_cpsw1.RGMII1.TXC.$suggestSolution                               = "RGMII1_TXC";
enet_cpsw1.RGMII2.RD0.$suggestSolution                               = "RGMII2_RD0";
enet_cpsw1.RGMII2.RD1.$suggestSolution                               = "RGMII2_RD1";
enet_cpsw1.RGMII2.RD2.$suggestSolution                               = "RGMII2_RD2";
enet_cpsw1.RGMII2.RD3.$suggestSolution                               = "RGMII2_RD3";
enet_cpsw1.RGMII2.RX_CTL.$suggestSolution                            = "RGMII2_RX_CTL";
enet_cpsw1.RGMII2.RXC.$suggestSolution                               = "RGMII2_RXC";
enet_cpsw1.RGMII2.TD0.$suggestSolution                               = "RGMII2_TD0";
enet_cpsw1.RGMII2.TD1.$suggestSolution                               = "RGMII2_TD1";
enet_cpsw1.RGMII2.TD2.$suggestSolution                               = "RGMII2_TD2";
enet_cpsw1.RGMII2.TD3.$suggestSolution                               = "RGMII2_TD3";
enet_cpsw1.RGMII2.TX_CTL.$suggestSolution                            = "RGMII2_TX_CTL";
enet_cpsw1.RGMII2.TXC.$suggestSolution                               = "RGMII2_TXC";
