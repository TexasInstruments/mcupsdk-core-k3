/**
 * These arguments were used when this file was generated. They will be automatically applied on subsequent loads
 * via the GUI or CLI. Run CLI with '--help' for additional information on how to override these arguments.
 * @cliArgs --device "AM62x" --package "ALW" --part "Default" --context "r5fss0-0" --product "MCU_PLUS_SDK@07.03.01"
 * @versions {"tool":"1.15.0+2826"}
 */

/**
 * Import the modules used in this configuration.
 */
const flash       = scripting.addModule("/board/flash/flash", {}, false);
const flash1      = flash.addInstance();
const bootloader  = scripting.addModule("/drivers/bootloader/bootloader", {}, false);
const bootloader1 = bootloader.addInstance();
const bootloader2 = bootloader.addInstance();
const bootloader3 = bootloader.addInstance();
const gtc         = scripting.addModule("/drivers/gtc/gtc");
const clock       = scripting.addModule("/kernel/dpl/clock");
const debug_log   = scripting.addModule("/kernel/dpl/debug_log");

/**
 * Write custom configuration values to the imported modules.
 */
bootloader1.$name          = "CONFIG_BOOTLOADER_FLASH_HSM";
bootloader1.appImageOffset = "0xB00000";

bootloader2.$name          = "CONFIG_BOOTLOADER_FLASH_LINUX";
bootloader2.appImageOffset = "0xF00000";

bootloader3.$name          = "CONFIG_BOOTLOADER_FLASH_DM";
bootloader3.appImageOffset = "0xD00000";

flash1.$name                                      = "CONFIG_FLASH0";
bootloader1.flashDriver                           = flash1;
bootloader2.flashDriver                           = flash1;
bootloader3.flashDriver                           = flash1;
flash1.flashTopology                              = "parallelFlash";
flash1.parallelFlashDriver.$name                  = "board_flash_parallelFlash_parallelflash0";
flash1.parallelFlashDriver.peripheralDriver.$name = "CONFIG_GPMC0";

const udma                                             = scripting.addModule("/drivers/udma/udma", {}, false);
const udma1                                            = udma.addInstance({}, false);
udma1.$name                                            = "CONFIG_UDMA0";
flash1.parallelFlashDriver.peripheralDriver.udmaDriver = udma1;

clock.instance = "TIMER1";

debug_log.enableUartLog                      = true;
debug_log.enableCssLog                       = false;
debug_log.uartLog.$name                      = "CONFIG_UART0";
debug_log.uartLog.intrEnable                 = "DISABLE";
debug_log.uartLog.useWakeupDomainPeripherals = false;
debug_log.uartLog.UART.$assign               = "USART0";

/**
 * Pinmux solution for unlocked pins/peripherals. This ensures that minor changes to the automatic solver in a future
 * version of the tool will not impact the pinmux you originally saw.  These lines can be completely deleted in order to
 * re-solve from scratch.
 */
flash1.parallelFlashDriver.peripheralDriver.GPMC.$suggestSolution          = "GPMC0";
flash1.parallelFlashDriver.peripheralDriver.GPMC.OEn_REn.$suggestSolution  = "ball.L24";
flash1.parallelFlashDriver.peripheralDriver.GPMC.ADVn_ALE.$suggestSolution = "ball.L23";
flash1.parallelFlashDriver.peripheralDriver.GPMC.WEn.$suggestSolution      = "ball.L25";
flash1.parallelFlashDriver.peripheralDriver.GPMC.BE0n_CLE.$suggestSolution = "ball.M24";
flash1.parallelFlashDriver.peripheralDriver.GPMC.CSn0.$suggestSolution     = "ball.M21";
flash1.parallelFlashDriver.peripheralDriver.GPMC.AD0.$suggestSolution      = "ball.M25";
flash1.parallelFlashDriver.peripheralDriver.GPMC.AD1.$suggestSolution      = "ball.N23";
flash1.parallelFlashDriver.peripheralDriver.GPMC.AD2.$suggestSolution      = "ball.N24";
flash1.parallelFlashDriver.peripheralDriver.GPMC.AD3.$suggestSolution      = "ball.N25";
flash1.parallelFlashDriver.peripheralDriver.GPMC.AD4.$suggestSolution      = "ball.P24";
flash1.parallelFlashDriver.peripheralDriver.GPMC.AD5.$suggestSolution      = "ball.P22";
flash1.parallelFlashDriver.peripheralDriver.GPMC.AD6.$suggestSolution      = "ball.P21";
flash1.parallelFlashDriver.peripheralDriver.GPMC.AD7.$suggestSolution      = "ball.R23";
flash1.parallelFlashDriver.peripheralDriver.GPMC.WAIT0.$suggestSolution    = "ball.U23";
debug_log.uartLog.UART.RXD.$suggestSolution                                = "ball.D14";
debug_log.uartLog.UART.TXD.$suggestSolution                                = "ball.E14";
