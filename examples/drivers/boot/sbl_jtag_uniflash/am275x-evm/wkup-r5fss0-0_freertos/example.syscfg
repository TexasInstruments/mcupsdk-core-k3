/**
 * @cliArgs --device "AM275x" --part "AM2754" --package "ANJ" --context "wkup-r5fss0-0" --product "MCU_PLUS_SDK@07.03.01"
 * @versions {"tool":"1.23.0+4000"}
 */

/**
 * Import the modules used in this configuration.
 */
const flash      = scripting.addModule("/board/flash/flash", {}, false);
const flash1     = flash.addInstance();
const mmcsd      = scripting.addModule("/drivers/mmcsd/mmcsd", {}, false);
const mmcsd1     = mmcsd.addInstance();
const debug_log  = scripting.addModule("/kernel/dpl/debug_log");
const mpu_armv7  = scripting.addModule("/kernel/dpl/mpu_armv7", {}, false);
const mpu_armv71 = mpu_armv7.addInstance();
const mpu_armv72 = mpu_armv7.addInstance();
const mpu_armv73 = mpu_armv7.addInstance();
const mpu_armv74 = mpu_armv7.addInstance();
const mpu_armv75 = mpu_armv7.addInstance();
const mpu_armv76 = mpu_armv7.addInstance();

/**
 * Write custom configuration values to the imported modules.
 */
flash1.$name                                           = "CONFIG_FLASH0";
flash1.serialFlashDriver.$name                         = "board_flash_serialFlash_serialflash0";
flash1.serialFlashDriver.peripheralDriver.$name        = "CONFIG_OSPI0";
flash1.serialFlashDriver.peripheralDriver.inputClkFreq = 133333333;
flash1.serialFlashDriver.peripheralDriver.OSPI.$assign = "OSPI0";

mmcsd1.$name = "CONFIG_MMCSD0";

debug_log.enableUartLog                      = true;
debug_log.uartLog.$name                      = "CONFIG_UART0";
debug_log.uartLog.useWakeupDomainPeripherals = true;
debug_log.uartLog.WKUP_UART.$assign          = "WKUP_UART";

mpu_armv71.size              = 31;
mpu_armv71.attributes        = "Device";
mpu_armv71.accessPermissions = "Supervisor RD+WR, User RD";
mpu_armv71.allowExecute      = false;
mpu_armv71.$name             = "REGISTERS";

mpu_armv72.size              = 15;
mpu_armv72.accessPermissions = "Supervisor RD+WR, User RD";
mpu_armv72.$name             = "TCMA";

mpu_armv73.baseAddr          = 0x41010000;
mpu_armv73.size              = 15;
mpu_armv73.accessPermissions = "Supervisor RD+WR, User RD";
mpu_armv73.$name             = "TCMB";

mpu_armv74.baseAddr   = 0x60000000;
mpu_armv74.$name      = "FLASH";
mpu_armv74.size       = 26;
mpu_armv74.attributes = "Device";

mpu_armv75.$name    = "MSRAM_BANK0_TO_BANK3";
mpu_armv75.size     = 22;
mpu_armv75.baseAddr = 0x72000000;

mpu_armv76.$name    = "MSRAM_BANK4_TO_BANK5";
mpu_armv76.baseAddr = 0x72400000;
mpu_armv76.size     = 21;

/**
 * Pinmux solution for unlocked pins/peripherals. This ensures that minor changes to the automatic solver in a future
 * version of the tool will not impact the pinmux you originally saw.  These lines can be completely deleted in order to
 * re-solve from scratch.
 */
flash1.serialFlashDriver.peripheralDriver.OSPI.CLK.$suggestSolution  = "OSPI0_CLK";
flash1.serialFlashDriver.peripheralDriver.OSPI.CSn0.$suggestSolution = "OSPI0_CSn0";
flash1.serialFlashDriver.peripheralDriver.OSPI.DQS.$suggestSolution  = "OSPI0_DQS";
flash1.serialFlashDriver.peripheralDriver.OSPI.D7.$suggestSolution   = "OSPI0_D7";
flash1.serialFlashDriver.peripheralDriver.OSPI.D6.$suggestSolution   = "OSPI0_D6";
flash1.serialFlashDriver.peripheralDriver.OSPI.D5.$suggestSolution   = "OSPI0_D5";
flash1.serialFlashDriver.peripheralDriver.OSPI.D4.$suggestSolution   = "OSPI0_D4";
flash1.serialFlashDriver.peripheralDriver.OSPI.D3.$suggestSolution   = "OSPI0_D3";
flash1.serialFlashDriver.peripheralDriver.OSPI.D2.$suggestSolution   = "OSPI0_D2";
flash1.serialFlashDriver.peripheralDriver.OSPI.D1.$suggestSolution   = "OSPI0_D1";
flash1.serialFlashDriver.peripheralDriver.OSPI.D0.$suggestSolution   = "OSPI0_D0";
mmcsd1.MMC.$suggestSolution                                          = "MMC0";
mmcsd1.MMC.MMC_CLK.$suggestSolution                                  = "MMC0_CLK";
mmcsd1.MMC.MMC_CMD.$suggestSolution                                  = "MMC0_CMD";
mmcsd1.MMC.MMC_DAT0.$suggestSolution                                 = "MMC0_DAT0";
mmcsd1.MMC.MMC_DAT1.$suggestSolution                                 = "MMC0_DAT1";
mmcsd1.MMC.MMC_DAT2.$suggestSolution                                 = "MMC0_DAT2";
mmcsd1.MMC.MMC_DAT3.$suggestSolution                                 = "MMC0_DAT3";
mmcsd1.MMC.MMC_DAT4.$suggestSolution                                 = "MMC0_DAT4";
mmcsd1.MMC.MMC_DAT5.$suggestSolution                                 = "MMC0_DAT5";
mmcsd1.MMC.MMC_DAT6.$suggestSolution                                 = "MMC0_DAT6";
mmcsd1.MMC.MMC_DAT7.$suggestSolution                                 = "MMC0_DAT7";
debug_log.uartLog.WKUP_UART.RXD.$suggestSolution                     = "WKUP_UART0_RXD";
debug_log.uartLog.WKUP_UART.TXD.$suggestSolution                     = "WKUP_UART0_TXD";
