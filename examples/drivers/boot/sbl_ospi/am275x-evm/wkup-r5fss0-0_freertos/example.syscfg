/**
 * @cliArgs --device "AM275x" --part "AM2754" --package "ANJ" --context "wkup-r5fss0-0" --product "MCU_PLUS_SDK@07.03.01"
 * @versions {"tool":"1.26.2+4477"}
 */

/**
 * Import the modules used in this configuration.
 */
const flash       = scripting.addModule("/board/flash/flash", {}, false);
const flash1      = flash.addInstance();
const hyperRam    = scripting.addModule("/board/hyperRam/hyperRam", {}, false);
const hyperRam1   = hyperRam.addInstance();
const bootloader  = scripting.addModule("/drivers/bootloader/bootloader", {}, false);
const bootloader1 = bootloader.addInstance();
const bootloader2 = bootloader.addInstance();
const bootloader3 = bootloader.addInstance();
const bootloader4 = bootloader.addInstance();
const bootloader5 = bootloader.addInstance();
const bootloader6 = bootloader.addInstance();
const bootloader7 = bootloader.addInstance();
const bootloader8 = bootloader.addInstance();
const gtc         = scripting.addModule("/drivers/gtc/gtc");
const qos         = scripting.addModule("/drivers/qos/qos", {}, false);
const qos1        = qos.addInstance();
const debug_log   = scripting.addModule("/kernel/dpl/debug_log");
const mpu_armv7   = scripting.addModule("/kernel/dpl/mpu_armv7", {}, false);
const mpu_armv71  = mpu_armv7.addInstance();
const mpu_armv72  = mpu_armv7.addInstance();
const mpu_armv73  = mpu_armv7.addInstance();
const mpu_armv74  = mpu_armv7.addInstance();
const mpu_armv75  = mpu_armv7.addInstance();
const mpu_armv76  = mpu_armv7.addInstance();
const mpu_armv77  = mpu_armv7.addInstance();
const mpu_armv78  = mpu_armv7.addInstance();
const mpu_armv79  = mpu_armv7.addInstance();

/**
 * Write custom configuration values to the imported modules.
 */
hyperRam1.$name                  = "CONFIG_HYPERRAM0";
hyperRam1.addedByBootloader      = true;
hyperRam1.peripheralDriver.$name = "CONFIG_HYPERBUS0";

bootloader1.$name          = "CONFIG_BOOTLOADER_SHARED";
bootloader1.appImageOffset = "0x1C00000";

bootloader2.$name          = "CONFIG_BOOTLOADER_R50_0";
bootloader2.appImageOffset = "0x400000";

bootloader3.$name          = "CONFIG_BOOTLOADER_R50_1";
bootloader3.appImageOffset = "0x800000";

bootloader4.$name          = "CONFIG_BOOTLOADER_R51_0";
bootloader4.appImageOffset = "0xC00000";

bootloader5.$name          = "CONFIG_BOOTLOADER_R51_1";
bootloader5.appImageOffset = "0x1000000";

bootloader6.$name          = "CONFIG_BOOTLOADER_C750";
bootloader6.appImageOffset = "0x1400000";

bootloader7.$name          = "CONFIG_BOOTLOADER_C751";
bootloader7.appImageOffset = "0x1800000";

bootloader8.$name          = "CONFIG_BOOTLOADER_HSM";
bootloader8.appImageOffset = "0x1D00000";

bootloader1.flashDriver                                = flash1;
flash1.$name                                           = "CONFIG_FLASH_SBL";
bootloader2.flashDriver                                = flash1;
bootloader3.flashDriver                                = flash1;
bootloader4.flashDriver                                = flash1;
bootloader5.flashDriver                                = flash1;
bootloader6.flashDriver                                = flash1;
bootloader7.flashDriver                                = flash1;
bootloader8.flashDriver                                = flash1;
flash1.serialFlashDriver.$name                         = "board_flash_serialFlash_serialflash0";
flash1.serialFlashDriver.peripheralDriver.$name        = "CONFIG_OSPI_SBL";
flash1.serialFlashDriver.peripheralDriver.dmaEnable    = true;
flash1.serialFlashDriver.peripheralDriver.phyEnable    = true;
flash1.serialFlashDriver.peripheralDriver.OSPI.$assign = "OSPI0";

qos1.$name = "CONFIG_QOS0";

const udma                                           = scripting.addModule("/drivers/udma/udma", {}, false);
const udma1                                          = udma.addInstance({}, false);
udma1.$name                                          = "CONFIG_UDMA0";
flash1.serialFlashDriver.peripheralDriver.udmaDriver = udma1;
bootloader1.udmaDriver                               = udma1;
bootloader2.udmaDriver                               = udma1;
bootloader3.udmaDriver                               = udma1;
bootloader4.udmaDriver                               = udma1;
bootloader5.udmaDriver                               = udma1;
bootloader6.udmaDriver                               = udma1;
bootloader7.udmaDriver                               = udma1;
bootloader8.udmaDriver                               = udma1;

const udma_blkcopy_channel                                   = scripting.addModule("/drivers/udma/udma_blkcopy_channel", {}, false);
const udma_blkcopy_channel1                                  = udma_blkcopy_channel.addInstance({}, false);
udma_blkcopy_channel1.$name                                  = "CONFIG_UDMA_BLKCOPY_CH0";
flash1.serialFlashDriver.peripheralDriver.udmaBlkCopyChannel = udma_blkcopy_channel1;
bootloader1.udmaBlkCopyChannel                               = udma_blkcopy_channel1;
bootloader2.udmaBlkCopyChannel                               = udma_blkcopy_channel1;
bootloader3.udmaBlkCopyChannel                               = udma_blkcopy_channel1;
bootloader4.udmaBlkCopyChannel                               = udma_blkcopy_channel1;
bootloader5.udmaBlkCopyChannel                               = udma_blkcopy_channel1;
bootloader6.udmaBlkCopyChannel                               = udma_blkcopy_channel1;
bootloader7.udmaBlkCopyChannel                               = udma_blkcopy_channel1;
bootloader8.udmaBlkCopyChannel                               = udma_blkcopy_channel1;

debug_log.enableUartLog                      = true;
debug_log.enableCssLog                       = false;
debug_log.uartTrace                          = true;
debug_log.uartLog.$name                      = "CONFIG_UART0";
debug_log.uartLog.intrEnable                 = "DISABLE";
debug_log.uartLog.useWakeupDomainPeripherals = true;

mpu_armv71.size         = 31;
mpu_armv71.attributes   = "Device";
mpu_armv71.allowExecute = false;
mpu_armv71.$name        = "CONFIG_MPU_REGISTER";

mpu_armv72.size       = 15;
mpu_armv72.$name      = "CONFIG_MPU_TCMA";
mpu_armv72.attributes = "NonCached";

mpu_armv73.baseAddr   = 0x41010000;
mpu_armv73.size       = 15;
mpu_armv73.$name      = "CONFIG_MPU_TCMB";
mpu_armv73.attributes = "NonCached";

mpu_armv74.$name    = "HSRAM";
mpu_armv74.baseAddr = 0x43C00000;
mpu_armv74.size     = 19;

mpu_armv75.$name    = "OCMC_RAM";
mpu_armv75.size     = 20;
mpu_armv75.baseAddr = 0x72000000;

mpu_armv76.$name      = "HYPERRAM";
mpu_armv76.baseAddr   = 0x68000000;
mpu_armv76.attributes = "CUSTOM";
mpu_armv76.size       = 26;
mpu_armv76.tex        = 5;

mpu_armv77.$name        = "HYPERRAM_CR0_CR1";
mpu_armv77.size         = 5;
mpu_armv77.attributes   = "Device";
mpu_armv77.allowExecute = false;
mpu_armv77.baseAddr     = 0x68001000;

mpu_armv78.size         = 5;
mpu_armv78.attributes   = "Device";
mpu_armv78.allowExecute = false;
mpu_armv78.$name        = "HYPERRAM_ID0_ID1";
mpu_armv78.baseAddr     = 0x68000000;

mpu_armv79.$name    = "ATCM_SOC";
mpu_armv79.baseAddr = 0x78000000;
mpu_armv79.size     = 15;

/**
 * Pinmux solution for unlocked pins/peripherals. This ensures that minor changes to the automatic solver in a future
 * version of the tool will not impact the pinmux you originally saw.  These lines can be completely deleted in order to
 * re-solve from scratch.
 */
hyperRam1.peripheralDriver.HYPERBUS.$suggestSolution                 = "HYPERBUS";
hyperRam1.peripheralDriver.HYPERBUS.CK.$suggestSolution              = "OSPI1_CLK";
hyperRam1.peripheralDriver.HYPERBUS.CKn.$suggestSolution             = "OSPI1_LBCLKO";
hyperRam1.peripheralDriver.HYPERBUS.CSn0.$suggestSolution            = "OSPI1_CSn0";
hyperRam1.peripheralDriver.HYPERBUS.RWDS.$suggestSolution            = "OSPI1_DQS";
hyperRam1.peripheralDriver.HYPERBUS.WPn.$suggestSolution             = "OSPI0_CSn2";
hyperRam1.peripheralDriver.HYPERBUS.RESETn.$suggestSolution          = "OSPI1_CSn1";
hyperRam1.peripheralDriver.HYPERBUS.RESETOn.$suggestSolution         = "OSPI0_LBCLKO";
hyperRam1.peripheralDriver.HYPERBUS.INTn.$suggestSolution            = "OSPI0_CSn3";
hyperRam1.peripheralDriver.HYPERBUS.DQ7.$suggestSolution             = "OSPI1_D7";
hyperRam1.peripheralDriver.HYPERBUS.DQ6.$suggestSolution             = "OSPI1_D6";
hyperRam1.peripheralDriver.HYPERBUS.DQ5.$suggestSolution             = "OSPI1_D5";
hyperRam1.peripheralDriver.HYPERBUS.DQ4.$suggestSolution             = "OSPI1_D4";
hyperRam1.peripheralDriver.HYPERBUS.DQ3.$suggestSolution             = "OSPI1_D3";
hyperRam1.peripheralDriver.HYPERBUS.DQ2.$suggestSolution             = "OSPI1_D2";
hyperRam1.peripheralDriver.HYPERBUS.DQ1.$suggestSolution             = "OSPI1_D1";
hyperRam1.peripheralDriver.HYPERBUS.DQ0.$suggestSolution             = "OSPI1_D0";
flash1.serialFlashDriver.peripheralDriver.OSPI.CLK.$suggestSolution  = "OSPI0_CLK";
flash1.serialFlashDriver.peripheralDriver.OSPI.CSn0.$suggestSolution = "OSPI0_CSn0";
flash1.serialFlashDriver.peripheralDriver.OSPI.DQS.$suggestSolution  = "OSPI0_DQS";
flash1.serialFlashDriver.peripheralDriver.OSPI.D7.$suggestSolution   = "OSPI0_D7";
flash1.serialFlashDriver.peripheralDriver.OSPI.D6.$suggestSolution   = "OSPI0_D6";
flash1.serialFlashDriver.peripheralDriver.OSPI.D5.$suggestSolution   = "OSPI0_D5";
flash1.serialFlashDriver.peripheralDriver.OSPI.D4.$suggestSolution   = "OSPI0_D4";
flash1.serialFlashDriver.peripheralDriver.OSPI.D3.$suggestSolution   = "OSPI0_D3";
flash1.serialFlashDriver.peripheralDriver.OSPI.D2.$suggestSolution   = "OSPI0_D2";
flash1.serialFlashDriver.peripheralDriver.OSPI.D1.$suggestSolution   = "OSPI0_D1";
flash1.serialFlashDriver.peripheralDriver.OSPI.D0.$suggestSolution   = "OSPI0_D0";
debug_log.uartLog.WKUP_UART.$suggestSolution                         = "WKUP_UART";
debug_log.uartLog.WKUP_UART.RXD.$suggestSolution                     = "WKUP_UART0_RXD";
debug_log.uartLog.WKUP_UART.TXD.$suggestSolution                     = "WKUP_UART0_TXD";
