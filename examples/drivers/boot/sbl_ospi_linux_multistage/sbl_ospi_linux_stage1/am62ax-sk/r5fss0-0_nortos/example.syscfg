/**
 * @cliArgs --device "AM62Ax" --package "AMB" --part "Default" --context "r5fss0-0" --product "MCU_PLUS_SDK@07.03.01"
 * @versions {"tool":"1.15.0+2826"}
 */

/**
 * Import the modules used in this configuration.
 */
const flash       = scripting.addModule("/board/flash/flash", {}, false);
const flash1      = flash.addInstance();
const bootloader  = scripting.addModule("/drivers/bootloader/bootloader", {}, false);
const bootloader1 = bootloader.addInstance();
const bootloader2 = bootloader.addInstance();
const ddr         = scripting.addModule("/drivers/ddr/ddr", {}, false);
const ddr1        = ddr.addInstance();
const gtc         = scripting.addModule("/drivers/gtc/gtc");
const clock       = scripting.addModule("/kernel/dpl/clock");
const debug_log   = scripting.addModule("/kernel/dpl/debug_log");
const mpu_armv7   = scripting.addModule("/kernel/dpl/mpu_armv7", {}, false);
const mpu_armv71  = mpu_armv7.addInstance();
const mpu_armv72  = mpu_armv7.addInstance();
const mpu_armv73  = mpu_armv7.addInstance();
const mpu_armv74  = mpu_armv7.addInstance();
const mpu_armv75  = mpu_armv7.addInstance();
const mpu_armv76  = mpu_armv7.addInstance();
const mpu_armv77  = mpu_armv7.addInstance();
const mpu_armv78  = mpu_armv7.addInstance();
const mpu_armv79  = mpu_armv7.addInstance();
const mpu_armv710 = mpu_armv7.addInstance();
const mpu_armv711 = mpu_armv7.addInstance();

/**
 * Write custom configuration values to the imported modules.
 */
bootloader1.$name          = "CONFIG_BOOTLOADER_FLASH_MCU";
bootloader1.appImageOffset = "0x800000";

bootloader2.appImageOffset = "0x80000";
bootloader2.$name          = "CONFIG_BOOTLOADER_FLASH_SBL";

flash1.$name                                           = "CONFIG_FLASH0";
bootloader2.flashDriver                                = flash1;
bootloader1.flashDriver                                = flash1;
flash1.serialFlashDriver.$name                         = "board_flash_serialFlash_serialflash0";
flash1.serialFlashDriver.peripheralDriver.$name        = "CONFIG_OSPI0";
flash1.serialFlashDriver.peripheralDriver.inputClkFreq = 166666666;
flash1.serialFlashDriver.peripheralDriver.dmaEnable    = true;
flash1.serialFlashDriver.peripheralDriver.phyEnable    = true;
flash1.serialFlashDriver.peripheralDriver.ospiSkipProg = false;

ddr1.$name = "CONFIG_DDR0";

const udma                                           = scripting.addModule("/drivers/udma/udma", {}, false);
const udma1                                          = udma.addInstance({}, false);
udma1.$name                                          = "CONFIG_UDMA0";
flash1.serialFlashDriver.peripheralDriver.udmaDriver = udma1;

debug_log.enableUartLog                      = true;
debug_log.enableCssLog                       = false;
debug_log.uartLog.$name                      = "CONFIG_UART0";
debug_log.uartLog.intrEnable                 = "DISABLE";
debug_log.uartLog.useWakeupDomainPeripherals = false;

mpu_armv71.$name             = "CONFIG_MPU_REGION0";
mpu_armv71.accessPermissions = "Supervisor RD+WR, User RD";
mpu_armv71.allowExecute      = false;
mpu_armv71.attributes        = "NonCached";

mpu_armv72.$name             = "CONFIG_MPU_REGION1";
mpu_armv72.accessPermissions = "Supervisor RD+WR, User RD";
mpu_armv72.size              = 7;

mpu_armv73.$name             = "CONFIG_MPU_REGION2";
mpu_armv73.accessPermissions = "Supervisor RD+WR, User RD";
mpu_armv73.baseAddr          = 0x41C00000;
mpu_armv73.size              = 19;

mpu_armv74.$name             = "CONFIG_MPU_REGION3";
mpu_armv74.accessPermissions = "Supervisor RD+WR, User RD";
mpu_armv74.baseAddr          = 0x70000000;
mpu_armv74.size              = 16;

mpu_armv75.$name    = "CONFIG_MPU_REGION4";
mpu_armv75.baseAddr = 0x80000000;
mpu_armv75.size     = 31;

mpu_armv76.$name      = "CONFIG_MPU_REGION5";
mpu_armv76.baseAddr   = 0x41010000;
mpu_armv76.size       = 15;
mpu_armv76.attributes = "NonCached";

mpu_armv77.$name      = "CONFIG_MPU_REGION6";
mpu_armv77.size       = 15;
mpu_armv77.attributes = "NonCached";

mpu_armv78.$name    = "CONFIG_MPU_REGION8";
mpu_armv78.baseAddr = 0x43C00000;
mpu_armv78.size     = 18;

mpu_armv79.$name        = "CONFIG_MPU_REGION7";
mpu_armv79.baseAddr     = 0xFC40000;
mpu_armv79.size         = 8;
mpu_armv79.attributes   = "Device";
mpu_armv79.allowExecute = false;

mpu_armv710.$name        = "CONFIG_MPU_REGION9";
mpu_armv710.baseAddr     = 0x2800000;
mpu_armv710.size         = 9;
mpu_armv710.allowExecute = false;
mpu_armv710.attributes   = "Device";

mpu_armv711.$name        = "FSS0_DAT_REG1";
mpu_armv711.baseAddr     = 0x60000000;
mpu_armv711.size         = 27;
mpu_armv711.attributes   = "Device";
mpu_armv711.allowExecute = false;

/**
 * Pinmux solution for unlocked pins/peripherals. This ensures that minor changes to the automatic solver in a future
 * version of the tool will not impact the pinmux you originally saw.  These lines can be completely deleted in order to
 * re-solve from scratch.
 */
flash1.serialFlashDriver.peripheralDriver.OSPI.$suggestSolution      = "OSPI0";
flash1.serialFlashDriver.peripheralDriver.OSPI.CLK.$suggestSolution  = "ball.L22";
flash1.serialFlashDriver.peripheralDriver.OSPI.CSn0.$suggestSolution = "ball.H21";
flash1.serialFlashDriver.peripheralDriver.OSPI.DQS.$suggestSolution  = "ball.L21";
flash1.serialFlashDriver.peripheralDriver.OSPI.D7.$suggestSolution   = "ball.J22";
flash1.serialFlashDriver.peripheralDriver.OSPI.D6.$suggestSolution   = "ball.J20";
flash1.serialFlashDriver.peripheralDriver.OSPI.D5.$suggestSolution   = "ball.H19";
flash1.serialFlashDriver.peripheralDriver.OSPI.D4.$suggestSolution   = "ball.K21";
flash1.serialFlashDriver.peripheralDriver.OSPI.D3.$suggestSolution   = "ball.H18";
flash1.serialFlashDriver.peripheralDriver.OSPI.D2.$suggestSolution   = "ball.J19";
flash1.serialFlashDriver.peripheralDriver.OSPI.D1.$suggestSolution   = "ball.J18";
flash1.serialFlashDriver.peripheralDriver.OSPI.D0.$suggestSolution   = "ball.J21";
debug_log.uartLog.UART.$suggestSolution                              = "USART0";
debug_log.uartLog.UART.RXD.$suggestSolution                          = "ball.E14";
debug_log.uartLog.UART.TXD.$suggestSolution                          = "ball.D15";
