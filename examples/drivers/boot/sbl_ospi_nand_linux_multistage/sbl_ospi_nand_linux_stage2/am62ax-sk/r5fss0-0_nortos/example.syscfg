/**
 * These arguments were used when this file was generated. They will be automatically applied on subsequent loads
 * via the GUI or CLI. Run CLI with '--help' for additional information on how to override these arguments.
 * @cliArgs --device "AM62Ax" --package "AMB" --part "Default" --context "r5fss0-0" --product "MCU_PLUS_SDK@07.03.01"
 * @versions {"tool":"1.14.0+2667"}
 */

/**
 * Import the modules used in this configuration.
 */
const flash       = scripting.addModule("/board/flash/flash", {}, false);
const flash1      = flash.addInstance();
const bootloader  = scripting.addModule("/drivers/bootloader/bootloader", {}, false);
const bootloader1 = bootloader.addInstance();
const bootloader2 = bootloader.addInstance();
const bootloader3 = bootloader.addInstance();
const gtc         = scripting.addModule("/drivers/gtc/gtc");
const clock       = scripting.addModule("/kernel/dpl/clock");
const debug_log   = scripting.addModule("/kernel/dpl/debug_log");

/**
 * Write custom configuration values to the imported modules.
 */
bootloader1.$name          = "CONFIG_BOOTLOADER_FLASH_HSM";
bootloader1.appImageOffset = "0x800000";

bootloader2.$name          = "CONFIG_BOOTLOADER_FLASH_DM";
bootloader2.appImageOffset = "0xa00000";

bootloader3.$name          = "CONFIG_BOOTLOADER_FLASH_LINUX";
bootloader3.appImageOffset = "0xC00000";

flash1.$name                         = "CONFIG_FLASH0";
bootloader1.flashDriver              = flash1;
bootloader2.flashDriver              = flash1;
bootloader3.flashDriver              = flash1;
flash1.flashType                    = "SERIAL_NAND";
flash1.quirks                        = "";
flash1.peripheralDriver.$name        = "CONFIG_OSPI0";
flash1.peripheralDriver.inputClkFreq = 200000000;
flash1.peripheralDriver.baudRateDiv  = 8;
flash1.peripheralDriver.dmaEnable    = true;
flash1.peripheralDriver.baudRateDiv  = 8;
flash1.peripheralDriver.OSPI.$assign = "OSPI0";

const udma                         = scripting.addModule("/drivers/udma/udma", {}, false);
const udma1                        = udma.addInstance({}, false);
udma1.$name                        = "CONFIG_UDMA0";
flash1.peripheralDriver.udmaDriver = udma1;

debug_log.enableUartLog                      = true;
debug_log.enableCssLog                       = false;
debug_log.uartLog.$name                      = "CONFIG_UART0";
debug_log.uartLog.intrEnable                 = "DISABLE";
debug_log.uartLog.useWakeupDomainPeripherals = false;

/**
 * Pinmux solution for unlocked pins/peripherals. This ensures that minor changes to the automatic solver in a future
 * version of the tool will not impact the pinmux you originally saw.  These lines can be completely deleted in order to
 * re-solve from scratch.
 */
flash1.peripheralDriver.OSPI.CLK.$suggestSolution  = "ball.L22";
flash1.peripheralDriver.OSPI.CSn0.$suggestSolution = "ball.H21";
flash1.peripheralDriver.OSPI.DQS.$suggestSolution  = "ball.L21";
flash1.peripheralDriver.OSPI.D7.$suggestSolution   = "ball.J22";
flash1.peripheralDriver.OSPI.D6.$suggestSolution   = "ball.J20";
flash1.peripheralDriver.OSPI.D5.$suggestSolution   = "ball.H19";
flash1.peripheralDriver.OSPI.D4.$suggestSolution   = "ball.K21";
flash1.peripheralDriver.OSPI.D3.$suggestSolution   = "ball.H18";
flash1.peripheralDriver.OSPI.D2.$suggestSolution   = "ball.J19";
flash1.peripheralDriver.OSPI.D1.$suggestSolution   = "ball.J18";
flash1.peripheralDriver.OSPI.D0.$suggestSolution   = "ball.J21";
debug_log.uartLog.UART.$suggestSolution            = "USART0";
debug_log.uartLog.UART.RXD.$suggestSolution        = "ball.E14";
debug_log.uartLog.UART.TXD.$suggestSolution        = "ball.D15";
