/**
 * @cliArgs --device "AM62x" --package "ALW" --part "Default" --context "r5fss0-0" --product "MCU_PLUS_SDK@07.03.01"
 * @versions {"tool":"1.14.0+2667"}
 */

/**
 * Import the modules used in this configuration.
 */
const flash       = scripting.addModule("/board/flash/flash", {}, false);
const flash1      = flash.addInstance();
const bootloader  = scripting.addModule("/drivers/bootloader/bootloader", {}, false);
const bootloader1 = bootloader.addInstance();
const bootloader2 = bootloader.addInstance();
const bootloader3 = bootloader.addInstance();
const gtc         = scripting.addModule("/drivers/gtc/gtc");
const clock       = scripting.addModule("/kernel/dpl/clock");
const debug_log   = scripting.addModule("/kernel/dpl/debug_log");

/**
 * Write custom configuration values to the imported modules.
 */
bootloader1.$name          = "CONFIG_BOOTLOADER_FLASH_HSM";
bootloader1.appImageOffset = "0x800000";

bootloader2.$name          = "CONFIG_BOOTLOADER_FLASH_LINUX";
bootloader2.appImageOffset = "0xC00000";

bootloader3.$name          = "CONFIG_BOOTLOADER_FLASH_DM";
bootloader3.appImageOffset = "0xA00000";

flash1.$name                         = "CONFIG_FLASH0";
bootloader1.flashDriver              = flash1;
bootloader2.flashDriver              = flash1;
bootloader3.flashDriver              = flash1;
flash1.flashType                    = "SERIAL_NAND";
flash1.quirks                        = "";
flash1.peripheralDriver.$name        = "CONFIG_OSPI0";
flash1.peripheralDriver.inputClkFreq = 200000000;
flash1.peripheralDriver.baudRateDiv  = 8;
flash1.peripheralDriver.dmaEnable    = true;
flash1.peripheralDriver.baudRateDiv  = 8;

const udma                         = scripting.addModule("/drivers/udma/udma", {}, false);
const udma1                        = udma.addInstance({}, false);
udma1.$name                        = "CONFIG_UDMA0";
flash1.peripheralDriver.udmaDriver = udma1;

clock.instance = "TIMER1";

debug_log.enableUartLog                      = true;
debug_log.enableCssLog                       = false;
debug_log.uartLog.$name                      = "CONFIG_UART0";
debug_log.uartLog.intrEnable                 = "DISABLE";
debug_log.uartLog.useWakeupDomainPeripherals = false;

/**
 * Pinmux solution for unlocked pins/peripherals. This ensures that minor changes to the automatic solver in a future
 * version of the tool will not impact the pinmux you originally saw.  These lines can be completely deleted in order to
 * re-solve from scratch.
 */
flash1.peripheralDriver.OSPI.$suggestSolution      = "OSPI0";
flash1.peripheralDriver.OSPI.CLK.$suggestSolution  = "ball.H24";
flash1.peripheralDriver.OSPI.CSn0.$suggestSolution = "ball.F23";
flash1.peripheralDriver.OSPI.DQS.$suggestSolution  = "ball.J24";
flash1.peripheralDriver.OSPI.D7.$suggestSolution   = "ball.J22";
flash1.peripheralDriver.OSPI.D6.$suggestSolution   = "ball.H25";
flash1.peripheralDriver.OSPI.D5.$suggestSolution   = "ball.J25";
flash1.peripheralDriver.OSPI.D4.$suggestSolution   = "ball.J23";
flash1.peripheralDriver.OSPI.D3.$suggestSolution   = "ball.F24";
flash1.peripheralDriver.OSPI.D2.$suggestSolution   = "ball.F25";
flash1.peripheralDriver.OSPI.D1.$suggestSolution   = "ball.G24";
flash1.peripheralDriver.OSPI.D0.$suggestSolution   = "ball.E25";
debug_log.uartLog.UART.$suggestSolution            = "USART0";
debug_log.uartLog.UART.RXD.$suggestSolution        = "ball.D14";
debug_log.uartLog.UART.TXD.$suggestSolution        = "ball.E14";
