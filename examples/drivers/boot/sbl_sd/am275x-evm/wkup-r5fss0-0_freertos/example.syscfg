/**
 * @cliArgs --device "AM275x" --part "AM2754" --package "ANJ" --context "wkup-r5fss0-0" --product "MCU_PLUS_SDK@07.03.01"
 * @versions {"tool":"1.24.2+4234"}
 */

/**
 * Import the modules used in this configuration.
 */
const hyperRam      = scripting.addModule("/board/hyperRam/hyperRam", {}, false);
const hyperRam1     = hyperRam.addInstance();
const bootloader    = scripting.addModule("/drivers/bootloader/bootloader", {}, false);
const bootloader1   = bootloader.addInstance();
const uart          = scripting.addModule("/drivers/uart/uart", {}, false);
const uart1         = uart.addInstance();
const freertos_fat  = scripting.addModule("/fs/freertos_fat/freertos_fat", {}, false);
const freertos_fat1 = freertos_fat.addInstance();
const debug_log     = scripting.addModule("/kernel/dpl/debug_log");
const mpu_armv7     = scripting.addModule("/kernel/dpl/mpu_armv7", {}, false);
const mpu_armv71    = mpu_armv7.addInstance();
const mpu_armv72    = mpu_armv7.addInstance();
const mpu_armv73    = mpu_armv7.addInstance();
const mpu_armv74    = mpu_armv7.addInstance();
const mpu_armv75    = mpu_armv7.addInstance();
const mpu_armv76    = mpu_armv7.addInstance();
const mpu_armv77    = mpu_armv7.addInstance();
const mpu_armv78    = mpu_armv7.addInstance();
const mpu_armv79    = mpu_armv7.addInstance();
const mpu_armv710   = mpu_armv7.addInstance();

/**
 * Write custom configuration values to the imported modules.
 */
hyperRam1.$name                       = "CONFIG_HYPERRAM0";
hyperRam1.addedByBootloader           = true;
hyperRam1.peripheralDriver.$name      = "CONFIG_HYPERBUS0";
hyperRam1.peripheralDriver.deviceSize = 0x4000000;

bootloader1.bootMedia = "SD";
bootloader1.$name     = "CONFIG_BOOTLOADER_APP";

uart1.$name             = "CONFIG_UART_SBL";
uart1.intrEnable        = "DISABLE";
uart1.addedByBootloader = true;
uart1.UART.$assign      = "UART0";
uart1.UART.RXD.$assign  = "UART0_RXD";
uart1.UART.TXD.$assign  = "UART0_TXD";

freertos_fat1.addedByBootloader             = true;
freertos_fat1.$name                         = "CONFIG_FREERTOS_FAT_SBL";
freertos_fat1.peripheralDriver.moduleSelect = scripting.forceWrite("MMC");
freertos_fat1.peripheralDriver.$name        = "CONFIG_MMCSD_SBL";
freertos_fat1.peripheralDriver.cardType     = "SD";

debug_log.enableUartLog                      = true;
debug_log.uartTrace                          = true;
debug_log.uartLog.useWakeupDomainPeripherals = true;
debug_log.uartLog.intrEnable                 = "DISABLE";
debug_log.uartLog.$name                      = "CONFIG_UART_APP";

mpu_armv71.size         = 31;
mpu_armv71.attributes   = "Device";
mpu_armv71.allowExecute = false;
mpu_armv71.$name        = "CONFIG_MPU_REGISTER";

mpu_armv72.size       = 15;
mpu_armv72.attributes = "NonCached";
mpu_armv72.$name      = "CONFIG_MPU_TCMA";

mpu_armv73.baseAddr   = 0x41010000;
mpu_armv73.size       = 15;
mpu_armv73.attributes = "NonCached";
mpu_armv73.$name      = "CONFIG_MPU_TCMB";

mpu_armv74.baseAddr = 0x72000000;
mpu_armv74.$name    = "OSMC_RAM";
mpu_armv74.size     = 20;

mpu_armv75.$name    = "HSRAM";
mpu_armv75.size     = 19;
mpu_armv75.baseAddr = 0x43C00000;

mpu_armv76.$name        = "CONFIG_MPU_SOC_TCMA";
mpu_armv76.baseAddr     = 0x5C000000;
mpu_armv76.size         = 16;
mpu_armv76.attributes   = "NonCached";
mpu_armv76.allowExecute = false;

mpu_armv77.$name        = "UART0_REG";
mpu_armv77.baseAddr     = 0x28000000;
mpu_armv77.size         = 9;
mpu_armv77.attributes   = "Device";
mpu_armv77.allowExecute = false;

mpu_armv78.$name      = "HYPERRAM";
mpu_armv78.baseAddr   = 0x68000000;
mpu_armv78.attributes = "CUSTOM";
mpu_armv78.size       = 26;
mpu_armv78.tex        = 5;

mpu_armv79.$name        = "HYPERRAM_CR0_CR1";
mpu_armv79.baseAddr     = 0x68001000;
mpu_armv79.size         = 5;
mpu_armv79.attributes   = "Device";
mpu_armv79.allowExecute = false;

mpu_armv710.size         = 5;
mpu_armv710.attributes   = "Device";
mpu_armv710.allowExecute = false;
mpu_armv710.$name        = "HYPERRAM_ID0_ID1";
mpu_armv710.baseAddr     = 0x68000000;

/**
 * Pinmux solution for unlocked pins/peripherals. This ensures that minor changes to the automatic solver in a future
 * version of the tool will not impact the pinmux you originally saw.  These lines can be completely deleted in order to
 * re-solve from scratch.
 */
hyperRam1.peripheralDriver.HYPERBUS.$suggestSolution         = "HYPERBUS";
hyperRam1.peripheralDriver.HYPERBUS.CK.$suggestSolution      = "OSPI1_CLK";
hyperRam1.peripheralDriver.HYPERBUS.CKn.$suggestSolution     = "OSPI1_LBCLKO";
hyperRam1.peripheralDriver.HYPERBUS.CSn0.$suggestSolution    = "OSPI1_CSn0";
hyperRam1.peripheralDriver.HYPERBUS.RWDS.$suggestSolution    = "OSPI1_DQS";
hyperRam1.peripheralDriver.HYPERBUS.WPn.$suggestSolution     = "OSPI0_CSn2";
hyperRam1.peripheralDriver.HYPERBUS.RESETn.$suggestSolution  = "OSPI1_CSn1";
hyperRam1.peripheralDriver.HYPERBUS.RESETOn.$suggestSolution = "OSPI0_LBCLKO";
hyperRam1.peripheralDriver.HYPERBUS.INTn.$suggestSolution    = "OSPI0_CSn3";
hyperRam1.peripheralDriver.HYPERBUS.DQ7.$suggestSolution     = "OSPI1_D7";
hyperRam1.peripheralDriver.HYPERBUS.DQ6.$suggestSolution     = "OSPI1_D6";
hyperRam1.peripheralDriver.HYPERBUS.DQ5.$suggestSolution     = "OSPI1_D5";
hyperRam1.peripheralDriver.HYPERBUS.DQ4.$suggestSolution     = "OSPI1_D4";
hyperRam1.peripheralDriver.HYPERBUS.DQ3.$suggestSolution     = "OSPI1_D3";
hyperRam1.peripheralDriver.HYPERBUS.DQ2.$suggestSolution     = "OSPI1_D2";
hyperRam1.peripheralDriver.HYPERBUS.DQ1.$suggestSolution     = "OSPI1_D1";
hyperRam1.peripheralDriver.HYPERBUS.DQ0.$suggestSolution     = "OSPI1_D0";
freertos_fat1.peripheralDriver.MMC.$suggestSolution          = "MMC0";
freertos_fat1.peripheralDriver.MMC.MMC_CLK.$suggestSolution  = "MMC0_CLK";
freertos_fat1.peripheralDriver.MMC.MMC_CMD.$suggestSolution  = "MMC0_CMD";
freertos_fat1.peripheralDriver.MMC.MMC_DAT0.$suggestSolution = "MMC0_DAT0";
freertos_fat1.peripheralDriver.MMC.MMC_DAT1.$suggestSolution = "MMC0_DAT1";
freertos_fat1.peripheralDriver.MMC.MMC_DAT2.$suggestSolution = "MMC0_DAT2";
freertos_fat1.peripheralDriver.MMC.MMC_DAT3.$suggestSolution = "MMC0_DAT3";
freertos_fat1.peripheralDriver.MMC.MMC_DAT4.$suggestSolution = "MMC0_DAT4";
freertos_fat1.peripheralDriver.MMC.MMC_DAT5.$suggestSolution = "MMC0_DAT5";
freertos_fat1.peripheralDriver.MMC.MMC_DAT6.$suggestSolution = "MMC0_DAT6";
freertos_fat1.peripheralDriver.MMC.MMC_DAT7.$suggestSolution = "MMC0_DAT7";
debug_log.uartLog.WKUP_UART.$suggestSolution                 = "WKUP_UART";
debug_log.uartLog.WKUP_UART.RXD.$suggestSolution             = "WKUP_UART0_RXD";
debug_log.uartLog.WKUP_UART.TXD.$suggestSolution             = "WKUP_UART0_TXD";
