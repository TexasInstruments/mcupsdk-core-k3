/**
 * @cliArgs --device "AM62Dx" --package "AMB" --part "Default" --context "r5fss0-0" --product "MCU_PLUS_SDK@07.03.01"
 * @versions {"tool":"1.19.0+3426"}
 */

/**
 * Import the modules used in this configuration.
 */
const bootloader  = scripting.addModule("/drivers/bootloader/bootloader", {}, false);
const bootloader1 = bootloader.addInstance();
const ddr         = scripting.addModule("/drivers/ddr/ddr", {}, false);
const ddr1        = ddr.addInstance();
const gtc         = scripting.addModule("/drivers/gtc/gtc");
const uart        = scripting.addModule("/drivers/uart/uart", {}, false);
const uart1       = uart.addInstance();
const clock       = scripting.addModule("/kernel/dpl/clock");
const debug_log   = scripting.addModule("/kernel/dpl/debug_log");
const mpu_armv7   = scripting.addModule("/kernel/dpl/mpu_armv7", {}, false);
const mpu_armv71  = mpu_armv7.addInstance();
const mpu_armv72  = mpu_armv7.addInstance();
const mpu_armv73  = mpu_armv7.addInstance();
const mpu_armv74  = mpu_armv7.addInstance();
const mpu_armv75  = mpu_armv7.addInstance();
const mpu_armv76  = mpu_armv7.addInstance();
const mpu_armv77  = mpu_armv7.addInstance();
const mpu_armv78  = mpu_armv7.addInstance();
const mpu_armv79  = mpu_armv7.addInstance();

/**
 * Write custom configuration values to the imported modules.
 */
bootloader1.$name     = "CONFIG_BOOTLOADER0";
bootloader1.bootMedia = "MEM";

ddr1.$name = "CONFIG_DDR0";

uart1.$name                      = "CONFIG_UART0";
uart1.useWakeupDomainPeripherals = false;
uart1.intrEnable                 = "DISABLE";
uart1.UART.$assign               = "USART0";

debug_log.sysfwUartTrace                          = true;
debug_log.sysfwUartLog.$name                      = "CONFIG_UART_TRACE0";
debug_log.sysfwUartLog.useWakeupDomainPeripherals = false;
debug_log.sysfwUartLog.UART.$assign               = "USART1";
debug_log.sysfwUartLog.UART.RXD.$assign           = "MCASP0_AFSR";
debug_log.sysfwUartLog.UART.TXD.$assign           = "MCASP0_ACLKR";
debug_log.sysfwUartLog.UART.RTSn.$assign          = "MCASP0_AXR2";
debug_log.sysfwUartLog.UART.CTSn.$assign          = "MCASP0_AXR3";

mpu_armv71.$name             = "CONFIG_MPU_REGION0";
mpu_armv71.accessPermissions = "Supervisor RD+WR, User RD";
mpu_armv71.allowExecute      = false;
mpu_armv71.attributes        = "NonCached";

mpu_armv72.$name             = "CONFIG_MPU_REGION1";
mpu_armv72.accessPermissions = "Supervisor RD+WR, User RD";
mpu_armv72.size              = 7;

mpu_armv73.$name             = "CONFIG_MPU_REGION2";
mpu_armv73.accessPermissions = "Supervisor RD+WR, User RD";
mpu_armv73.baseAddr          = 0x41C00000;
mpu_armv73.size              = 19;

mpu_armv74.$name             = "CONFIG_MPU_REGION3";
mpu_armv74.accessPermissions = "Supervisor RD+WR, User RD";
mpu_armv74.baseAddr          = 0x70000000;
mpu_armv74.size              = 16;

mpu_armv75.$name    = "CONFIG_MPU_REGION4";
mpu_armv75.baseAddr = 0x80000000;
mpu_armv75.size     = 31;

mpu_armv76.$name      = "CONFIG_MPU_REGION5";
mpu_armv76.baseAddr   = 0x41010000;
mpu_armv76.size       = 15;
mpu_armv76.attributes = "NonCached";

mpu_armv77.$name      = "CONFIG_MPU_REGION6";
mpu_armv77.size       = 15;
mpu_armv77.attributes = "NonCached";

mpu_armv78.$name    = "CONFIG_MPU_REGION8";
mpu_armv78.baseAddr = 0x43C00000;
mpu_armv78.size     = 18;

mpu_armv79.$name      = "CONFIG_MPU_REGION10";
mpu_armv79.baseAddr   = 0x2800000;
mpu_armv79.size       = 9;
mpu_armv79.attributes = "Device";

/**
 * Pinmux solution for unlocked pins/peripherals. This ensures that minor changes to the automatic solver in a future
 * version of the tool will not impact the pinmux you originally saw.  These lines can be completely deleted in order to
 * re-solve from scratch.
 */
uart1.UART.RXD.$suggestSolution = "UART0_RXD";
uart1.UART.TXD.$suggestSolution = "UART0_TXD";
