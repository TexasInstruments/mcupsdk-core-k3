/**
 * @cliArgs --device "J722S_TDA4VEN_TDA4AEN_AM67" --part "Default" --package "AMW" --context "wkup-r5fss0-0" --product "MCU_PLUS_SDK@07.03.01"
 * @versions {"tool":"1.23.0+4000"}
 */

/**
 * Import the modules used in this configuration.
 */
const bootloader  = scripting.addModule("/drivers/bootloader/bootloader", {}, false);
const bootloader1 = bootloader.addInstance();
const ddr         = scripting.addModule("/drivers/ddr/ddr", {}, false);
const ddr1        = ddr.addInstance();
const gtc         = scripting.addModule("/drivers/gtc/gtc");
const qos         = scripting.addModule("/drivers/qos/qos", {}, false);
const qos1        = qos.addInstance();
const uart        = scripting.addModule("/drivers/uart/uart", {}, false);
const uart1       = uart.addInstance();
const clock       = scripting.addModule("/kernel/dpl/clock");
const debug_log   = scripting.addModule("/kernel/dpl/debug_log");
const mpu_armv7   = scripting.addModule("/kernel/dpl/mpu_armv7", {}, false);
const mpu_armv71  = mpu_armv7.addInstance();
const mpu_armv72  = mpu_armv7.addInstance();
const mpu_armv73  = mpu_armv7.addInstance();
const mpu_armv74  = mpu_armv7.addInstance();
const mpu_armv75  = mpu_armv7.addInstance();
const mpu_armv76  = mpu_armv7.addInstance();
const mpu_armv77  = mpu_armv7.addInstance();
const mpu_armv78  = mpu_armv7.addInstance();
const mpu_armv79  = mpu_armv7.addInstance();
const mpu_armv710 = mpu_armv7.addInstance();
const mpu_armv711 = mpu_armv7.addInstance();
const mpu_armv712 = mpu_armv7.addInstance();
const mpu_armv713 = mpu_armv7.addInstance();
const mpu_armv714 = mpu_armv7.addInstance();
const mpu_armv715 = mpu_armv7.addInstance();

/**
 * Write custom configuration values to the imported modules.
 */
bootloader1.$name     = "CONFIG_BOOTLOADER0";
bootloader1.bootMedia = "MEM";

ddr1.$name             = "CONFIG_DDR0";

qos1.$name = "CONFIG_QOS0";

uart1.$name                      = "CONFIG_UART0";
uart1.useWakeupDomainPeripherals = false;
uart1.intrEnable                 = "DISABLE";
uart1.UART.$assign               = "USART0";

debug_log.enableUartLog = true;
debug_log.uartLog.$name = "CONFIG_UART1";

mpu_armv71.allowExecute = false;
mpu_armv71.$name        = "REGISTER_REGION";
mpu_armv71.size         = 31;
mpu_armv71.attributes   = "Device";

mpu_armv72.baseAddr = 0x80000000;
mpu_armv72.size     = 31;
mpu_armv72.$name    = "DDR";

mpu_armv73.baseAddr   = 0x41010000;
mpu_armv73.size       = 15;
mpu_armv73.attributes = "NonCached";
mpu_armv73.$name      = "WKUP_R5_LOCAL_TCMB";

mpu_armv74.size       = 15;
mpu_armv74.$name      = "WKUP_R5_LOCAL_TCMA";
mpu_armv74.attributes = "NonCached";

mpu_armv75.baseAddr = 0x43C00000;
mpu_armv75.size     = 18;
mpu_armv75.$name    = "HSM_RAM";

mpu_armv76.$name    = "OCM_RAM";
mpu_armv76.size     = 18;
mpu_armv76.baseAddr = 0x43C40000;

mpu_armv77.$name      = "WKUP_R5_GLOBAL_TCMB";
mpu_armv77.baseAddr   = 0x78100000;
mpu_armv77.size       = 15;
mpu_armv77.attributes = "NonCached";

mpu_armv78.$name      = "WKUP_R5_GLOBAL_TCMA";
mpu_armv78.baseAddr   = 0x78000000;
mpu_armv78.size       = 15;
mpu_armv78.attributes = "NonCached";

mpu_armv79.$name      = "MCU_R5_GLOBAL_TCMA";
mpu_armv79.baseAddr   = 0x79000000;
mpu_armv79.size       = 15;
mpu_armv79.attributes = "NonCached";

mpu_armv710.$name      = "MCU_R5_GLOBAL_TCMB";
mpu_armv710.baseAddr   = 0x79020000;
mpu_armv710.size       = 15;
mpu_armv710.attributes = "NonCached";

mpu_armv711.$name      = "MAIN_R5_GLOBAL_TCMA";
mpu_armv711.size       = 15;
mpu_armv711.attributes = "NonCached";
mpu_armv711.baseAddr   = 0x78400000;

mpu_armv712.$name      = "MAIN_R5_GLOBAL_TCMB";
mpu_armv712.baseAddr   = 0x78500000;
mpu_armv712.size       = 15;
mpu_armv712.attributes = "NonCached";

mpu_armv713.baseAddr   = 0x7E000000;
mpu_armv713.attributes = "NonCached";
mpu_armv713.$name      = "L2S_RAM_C75_0";
mpu_armv713.size       = 21;

mpu_armv714.$name      = "L2S_RAM_C75_1";
mpu_armv714.baseAddr   = 0x7E200000;
mpu_armv714.attributes = "NonCached";
mpu_armv714.size       = 21;

mpu_armv715.$name    = "MS_RAM";
mpu_armv715.baseAddr = 0x79100000;
mpu_armv715.size     = 19;

/**
 * Pinmux solution for unlocked pins/peripherals. This ensures that minor changes to the automatic solver in a future
 * version of the tool will not impact the pinmux you originally saw.  These lines can be completely deleted in order to
 * re-solve from scratch.
 */
uart1.UART.RXD.$suggestSolution                  = "UART0_RXD";
uart1.UART.TXD.$suggestSolution                  = "UART0_TXD";
debug_log.uartLog.WKUP_UART.$suggestSolution     = "WKUP_USART0";
debug_log.uartLog.WKUP_UART.RXD.$suggestSolution = "WKUP_UART0_RXD";
debug_log.uartLog.WKUP_UART.TXD.$suggestSolution = "WKUP_UART0_TXD";
