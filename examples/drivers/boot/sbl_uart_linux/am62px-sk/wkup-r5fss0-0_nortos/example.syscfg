/**
 * @cliArgs --device "AM62Px" --package "AMH" --part "Default" --context "wkup-r5fss0-0" --product "MCU_PLUS_SDK@07.03.01"
 * @versions {"tool":"1.19.0+3426"}
 */

/**
 * Import the modules used in this configuration.
 */
const bootloader  = scripting.addModule("/drivers/bootloader/bootloader", {}, false);
const bootloader1 = bootloader.addInstance();
const bootloader2 = bootloader.addInstance();
const bootloader3 = bootloader.addInstance();
const ddr         = scripting.addModule("/drivers/ddr/ddr", {}, false);
const ddr1        = ddr.addInstance();
const gtc         = scripting.addModule("/drivers/gtc/gtc");
const uart        = scripting.addModule("/drivers/uart/uart", {}, false);
const uart1       = uart.addInstance();
const clock       = scripting.addModule("/kernel/dpl/clock");
const debug_log   = scripting.addModule("/kernel/dpl/debug_log");
const mpu_armv7   = scripting.addModule("/kernel/dpl/mpu_armv7", {}, false);
const mpu_armv71  = mpu_armv7.addInstance();
const mpu_armv72  = mpu_armv7.addInstance();
const mpu_armv73  = mpu_armv7.addInstance();
const mpu_armv74  = mpu_armv7.addInstance();
const mpu_armv75  = mpu_armv7.addInstance();
const mpu_armv76  = mpu_armv7.addInstance();
const mpu_armv77  = mpu_armv7.addInstance();
const mpu_armv78  = mpu_armv7.addInstance();
const mpu_armv79  = mpu_armv7.addInstance();

/**
 * Write custom configuration values to the imported modules.
 */
bootloader1.$name     = "CONFIG_BOOTLOADER0";
bootloader1.bootMedia = "MEM";

bootloader2.$name     = "CONFIG_BOOTLOADER_DM";
bootloader2.bootMedia = "MEM";

bootloader3.$name     = "CONFIG_BOOTLOADER_LINUX";
bootloader3.bootMedia = "MEM";

ddr1.$name = "CONFIG_DDR0";
ddr1.qosEnableFlag = true;

uart1.$name                      = "CONFIG_UART0";
uart1.useWakeupDomainPeripherals = false;
uart1.intrEnable                 = "DISABLE";
uart1.UART.$assign               = "USART0";

debug_log.sysfwUartTrace                          = true;
debug_log.sysfwUartLog.$name                      = "CONFIG_UART_TRACE0";
debug_log.sysfwUartLog.useWakeupDomainPeripherals = false;
debug_log.sysfwUartLog.UART.$assign               = "USART1";
debug_log.sysfwUartLog.UART.RXD.$assign           = "MCASP0_AFSR";
debug_log.sysfwUartLog.UART.TXD.$assign           = "MCASP0_ACLKR";
debug_log.sysfwUartLog.UART.RTSn.$assign          = "MCASP0_AXR2";
debug_log.sysfwUartLog.UART.CTSn.$assign          = "MCASP0_AXR3";

mpu_armv71.allowExecute = false;
mpu_armv71.$name        = "REGISTER_REGION";
mpu_armv71.size         = 31;
mpu_armv71.attributes   = "Device";

mpu_armv72.baseAddr = 0x80000000;
mpu_armv72.size     = 31;
mpu_armv72.$name    = "DDR";

mpu_armv73.baseAddr = 0x41010000;
mpu_armv73.size     = 15;
mpu_armv73.$name    = "WKUP_R5_TCMA_LOCAL_ADDR";

mpu_armv74.size  = 15;
mpu_armv74.$name = "WKUP_R5_TCMB_LOCAL_ADDR";

mpu_armv75.baseAddr = 0x43C00000;
mpu_armv75.size     = 18;
mpu_armv75.$name    = "HSM_RAM";

mpu_armv76.baseAddr = 0x78000000;
mpu_armv76.size     = 15;
mpu_armv76.$name    = "WKUP_R5_TCMA_SYS_ADDR";

mpu_armv77.size     = 15;
mpu_armv77.baseAddr = 0x78100000;
mpu_armv77.$name    = "WKUP_R5_TCMB_SYS_ADDR";

mpu_armv78.baseAddr = 0x79000000;
mpu_armv78.size     = 15;
mpu_armv78.$name    = "MCU_R5_TCMA_SYS_ADDR";

mpu_armv79.$name    = "MCU_R5_TCMB_SYS_ADDR";
mpu_armv79.size     = 15;
mpu_armv79.baseAddr = 0x79100000;

/**
 * Pinmux solution for unlocked pins/peripherals. This ensures that minor changes to the automatic solver in a future
 * version of the tool will not impact the pinmux you originally saw.  These lines can be completely deleted in order to
 * re-solve from scratch.
 */
uart1.UART.RXD.$suggestSolution = "UART0_RXD";
uart1.UART.TXD.$suggestSolution = "UART0_TXD";
