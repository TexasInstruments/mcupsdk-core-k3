/**
 * @cliArgs --device "AM62x" --package "ALW" --part "Default" --context "r5fss0-0" --product "MCU_PLUS_SDK@07.03.01"
 * @versions {"tool":"1.15.0+2826"}
 */

/**
 * Import the modules used in this configuration.
 */
const bootloader  = scripting.addModule("/drivers/bootloader/bootloader", {}, false);
const bootloader1 = bootloader.addInstance();
const ddr         = scripting.addModule("/drivers/ddr/ddr", {}, false);
const ddr1        = ddr.addInstance();
const uart        = scripting.addModule("/drivers/uart/uart", {}, false);
const uart1       = uart.addInstance();
const clock       = scripting.addModule("/kernel/dpl/clock");
const debug_log   = scripting.addModule("/kernel/dpl/debug_log");
const mpu_armv7   = scripting.addModule("/kernel/dpl/mpu_armv7", {}, false);
const mpu_armv71  = mpu_armv7.addInstance();
const mpu_armv72  = mpu_armv7.addInstance();
const mpu_armv73  = mpu_armv7.addInstance();
const mpu_armv74  = mpu_armv7.addInstance();
const mpu_armv75  = mpu_armv7.addInstance();
const mpu_armv76  = mpu_armv7.addInstance();
const mpu_armv77  = mpu_armv7.addInstance();
const mpu_armv78  = mpu_armv7.addInstance();
const mpu_armv79  = mpu_armv7.addInstance();
const mpu_armv710 = mpu_armv7.addInstance();
const mpu_armv711 = mpu_armv7.addInstance();
const mpu_armv712 = mpu_armv7.addInstance();
const mpu_armv713 = mpu_armv7.addInstance();
const mpu_armv714 = mpu_armv7.addInstance();
const mpu_armv715 = mpu_armv7.addInstance();

/**
 * Write custom configuration values to the imported modules.
 */
bootloader1.EMMCAppImageOffset = "0x800000";
bootloader1.$name              = "CONFIG_BOOTLOADER_MEM";
bootloader1.bootMedia          = "MEM";

ddr1.$name                    = "CONFIG_DDR0";
ddr1.ddrConfigIncludeFileName = "drivers/ddr/v0/soc/am62x/am62x_SIP_ddrReginit-50-800.h";

uart1.$name                      = "CONFIG_UART0";
uart1.intrEnable                 = "DISABLE";
uart1.useWakeupDomainPeripherals = false;
uart1.UART.$assign               = "USART0";

clock.instance = "TIMER1";

mpu_armv71.$name             = "CONFIG_MPU_REGION0";
mpu_armv71.accessPermissions = "Supervisor RD+WR, User RD";
mpu_armv71.allowExecute      = false;
mpu_armv71.attributes        = "NonCached";

mpu_armv72.$name             = "CONFIG_MPU_REGION1";
mpu_armv72.accessPermissions = "Supervisor RD+WR, User RD";
mpu_armv72.size              = 7;

mpu_armv73.$name             = "CONFIG_MPU_REGION2";
mpu_armv73.accessPermissions = "Supervisor RD+WR, User RD";
mpu_armv73.baseAddr          = 0x41C00000;
mpu_armv73.size              = 19;

mpu_armv74.$name             = "CONFIG_MPU_REGION3";
mpu_armv74.accessPermissions = "Supervisor RD+WR, User RD";
mpu_armv74.baseAddr          = 0x70000000;
mpu_armv74.size              = 16;

mpu_armv75.$name    = "CONFIG_MPU_REGION4";
mpu_armv75.baseAddr = 0x80000000;
mpu_armv75.size     = 31;

mpu_armv76.$name      = "CONFIG_MPU_REGION5";
mpu_armv76.baseAddr   = 0x41010000;
mpu_armv76.size       = 15;
mpu_armv76.attributes = "NonCached";

mpu_armv77.$name      = "CONFIG_MPU_REGION6";
mpu_armv77.size       = 15;
mpu_armv77.attributes = "NonCached";

mpu_armv78.$name    = "CONFIG_MPU_REGION8";
mpu_armv78.baseAddr = 0x43C00000;
mpu_armv78.size     = 18;

mpu_armv79.$name        = "CONFIG_MPU_REGION7";
mpu_armv79.baseAddr     = 0xFC40000;
mpu_armv79.allowExecute = false;
mpu_armv79.attributes   = "Device";
mpu_armv79.size         = 8;

mpu_armv710.$name        = "CONFIG_MPU_REGION9";
mpu_armv710.baseAddr     = 0x2B300000;
mpu_armv710.size         = 9;
mpu_armv710.allowExecute = false;
mpu_armv710.attributes   = "Device";

mpu_armv711.$name        = "CONFIG_MPU_REGION10";
mpu_armv711.baseAddr     = 0x60000000;
mpu_armv711.allowExecute = false;
mpu_armv711.attributes   = "Device";
mpu_armv711.size         = 27;

mpu_armv712.$name        = "CONFIG_MPU_REGION11";
mpu_armv712.baseAddr     = 0x2800000;
mpu_armv712.size         = 9;
mpu_armv712.attributes   = "Device";
mpu_armv712.allowExecute = false;

mpu_armv713.$name        = "CONFIG_MPU_REGION12";
mpu_armv713.baseAddr     = 0x3B000000;
mpu_armv713.size         = 10;
mpu_armv713.allowExecute = false;
mpu_armv713.attributes   = "Device";

mpu_armv714.$name        = "CONFIG_MPU_REGION13";
mpu_armv714.baseAddr     = 0x25010000;
mpu_armv714.size         = 12;
mpu_armv714.allowExecute = false;
mpu_armv714.attributes   = "Device";

mpu_armv715.$name        = "CONFIG_MPU_REGION14";
mpu_armv715.baseAddr     = 0x50000000;
mpu_armv715.size         = 27;
mpu_armv715.allowExecute = false;
mpu_armv715.attributes   = "Device";

/**
 * Pinmux solution for unlocked pins/peripherals. This ensures that minor changes to the automatic solver in a future
 * version of the tool will not impact the pinmux you originally saw.  These lines can be completely deleted in order to
 * re-solve from scratch.
 */
uart1.UART.RXD.$suggestSolution = "ball.D14";
uart1.UART.TXD.$suggestSolution = "ball.E14";
