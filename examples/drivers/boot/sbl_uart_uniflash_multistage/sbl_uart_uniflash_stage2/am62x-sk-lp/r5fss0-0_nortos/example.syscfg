/**
 * These arguments were used when this file was generated. They will be automatically applied on subsequent loads
 * via the GUI or CLI. Run CLI with '--help' for additional information on how to override these arguments.
 * @cliArgs --device "AM62x" --package "ALW" --part "Default" --context "r5fss0-0" --product "MCU_PLUS_SDK@07.03.01"
 * @versions {"tool":"1.12.1+2446"}
 */

/**
 * Import the modules used in this configuration.
 */
const flash       = scripting.addModule("/board/flash/flash", {}, false);
const flash1      = flash.addInstance();
const bootloader  = scripting.addModule("/drivers/bootloader/bootloader", {}, false);
const bootloader1 = bootloader.addInstance();
const mmcsd       = scripting.addModule("/drivers/mmcsd/mmcsd", {}, false);
const mmcsd1      = mmcsd.addInstance();
const uart        = scripting.addModule("/drivers/uart/uart", {}, false);
const uart1       = uart.addInstance();
const clock       = scripting.addModule("/kernel/dpl/clock");
const debug_log   = scripting.addModule("/kernel/dpl/debug_log");

/**
 * Write custom configuration values to the imported modules.
 */
flash1.$name                         = "CONFIG_FLASH0";
flash1.name                          = "W35N01JWTBAG";
flash1.peripheralDriver.$name        = "CONFIG_OSPI0";
flash1.peripheralDriver.xferLines    = scripting.forceWrite("OCTAL");
flash1.peripheralDriver.inputClkFreq = 200000000;

bootloader1.$name     = "CONFIG_BOOTLOADER_MEM";
bootloader1.bootMedia = "MEM";

mmcsd1.$name        = "CONFIG_MMCSD";
mmcsd1.MMC0.$assign = "MMC0";

uart1.$name                      = "CONFIG_UART0";
uart1.intrEnable                 = "DISABLE";
uart1.useWakeupDomainPeripherals = false;

clock.instance = "TIMER1";

/**
 * Pinmux solution for unlocked pins/peripherals. This ensures that minor changes to the automatic solver in a future
 * version of the tool will not impact the pinmux you originally saw.  These lines can be completely deleted in order to
 * re-solve from scratch.
 */
flash1.peripheralDriver.OSPI.$suggestSolution      = "OSPI0";
flash1.peripheralDriver.OSPI.CLK.$suggestSolution  = "ball.H24";
flash1.peripheralDriver.OSPI.CSn0.$suggestSolution = "ball.F23";
flash1.peripheralDriver.OSPI.DQS.$suggestSolution  = "ball.J24";
flash1.peripheralDriver.OSPI.D7.$suggestSolution   = "ball.J22";
flash1.peripheralDriver.OSPI.D6.$suggestSolution   = "ball.H25";
flash1.peripheralDriver.OSPI.D5.$suggestSolution   = "ball.J25";
flash1.peripheralDriver.OSPI.D4.$suggestSolution   = "ball.J23";
flash1.peripheralDriver.OSPI.D3.$suggestSolution   = "ball.F24";
flash1.peripheralDriver.OSPI.D2.$suggestSolution   = "ball.F25";
flash1.peripheralDriver.OSPI.D1.$suggestSolution   = "ball.G24";
flash1.peripheralDriver.OSPI.D0.$suggestSolution   = "ball.E25";
mmcsd1.MMC0.CLK.$suggestSolution                   = "ball.AB1";
mmcsd1.MMC0.CMD.$suggestSolution                   = "ball.Y3";
mmcsd1.MMC0.DAT0.$suggestSolution                  = "ball.AA2";
mmcsd1.MMC0.DAT1.$suggestSolution                  = "ball.AA1";
mmcsd1.MMC0.DAT2.$suggestSolution                  = "ball.AA3";
mmcsd1.MMC0.DAT3.$suggestSolution                  = "ball.Y4";
mmcsd1.MMC0.DAT4.$suggestSolution                  = "ball.AB2";
mmcsd1.MMC0.DAT5.$suggestSolution                  = "ball.AC1";
mmcsd1.MMC0.DAT6.$suggestSolution                  = "ball.AD2";
mmcsd1.MMC0.DAT7.$suggestSolution                  = "ball.AC2";
uart1.UART.$suggestSolution                        = "USART0";
uart1.UART.RXD.$suggestSolution                    = "ball.D14";
uart1.UART.TXD.$suggestSolution                    = "ball.E14";
