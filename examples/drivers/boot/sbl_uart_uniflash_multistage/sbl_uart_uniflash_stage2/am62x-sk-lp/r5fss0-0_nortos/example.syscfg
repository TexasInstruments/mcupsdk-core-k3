/**
 * @cliArgs --device "AM62x" --part "Default" --package "AMC" --context "r5fss0-0" --product "MCU_PLUS_SDK@07.03.01"
 * @versions {"tool":"1.24.0+4150"}
 */

/**
 * Import the modules used in this configuration.
 */
const flash       = scripting.addModule("/board/flash/flash", {}, false);
const flash1      = flash.addInstance();
const bootloader  = scripting.addModule("/drivers/bootloader/bootloader", {}, false);
const bootloader1 = bootloader.addInstance();
const mmcsd       = scripting.addModule("/drivers/mmcsd/mmcsd", {}, false);
const mmcsd1      = mmcsd.addInstance();
const uart        = scripting.addModule("/drivers/uart/uart", {}, false);
const uart1       = uart.addInstance();
const clock       = scripting.addModule("/kernel/dpl/clock");
const debug_log   = scripting.addModule("/kernel/dpl/debug_log");

/**
 * Write custom configuration values to the imported modules.
 */
flash1.$name                                        = "CONFIG_FLASH0";
flash1.serialFlashDriver.$name                      = "board_flash_serialFlash_serialflash0";
flash1.serialFlashDriver.flashType                  = "SERIAL_NAND";
flash1.serialFlashDriver.badBlockCheck              = "Yes";
flash1.serialFlashDriver.protocol                   = "1s_8s_8s";
flash1.serialFlashDriver.peripheralDriver.$name     = "CONFIG_OSPI0";
flash1.serialFlashDriver.peripheralDriver.dmaEnable = true;
flash1.serialFlashDriver.peripheralDriver.phyEnable = true;

bootloader1.$name     = "CONFIG_BOOTLOADER_MEM";
bootloader1.bootMedia = "MEM";

mmcsd1.$name        = "CONFIG_MMCSD";
mmcsd1.MMC0.$assign = "MMC0";

uart1.$name                      = "CONFIG_UART0";
uart1.intrEnable                 = "DISABLE";
uart1.useWakeupDomainPeripherals = false;

const udma                                           = scripting.addModule("/drivers/udma/udma", {}, false);
const udma1                                          = udma.addInstance({}, false);
udma1.$name                                          = "CONFIG_UDMA0";
bootloader1.udmaDriver                               = udma1;
flash1.serialFlashDriver.peripheralDriver.udmaDriver = udma1;

const udma_blkcopy_channel                                   = scripting.addModule("/drivers/udma/udma_blkcopy_channel", {}, false);
const udma_blkcopy_channel1                                  = udma_blkcopy_channel.addInstance({}, false);
udma_blkcopy_channel1.$name                                  = "CONFIG_UDMA_BLKCOPY_CH0";
bootloader1.udmaBlkCopyChannel                               = udma_blkcopy_channel1;
flash1.serialFlashDriver.peripheralDriver.udmaBlkCopyChannel = udma_blkcopy_channel1;

clock.instance = "TIMER1";

/**
 * Pinmux solution for unlocked pins/peripherals. This ensures that minor changes to the automatic solver in a future
 * version of the tool will not impact the pinmux you originally saw.  These lines can be completely deleted in order to
 * re-solve from scratch.
 */
flash1.serialFlashDriver.peripheralDriver.OSPI.$suggestSolution      = "OSPI0";
flash1.serialFlashDriver.peripheralDriver.OSPI.CLK.$suggestSolution  = "OSPI0_CLK";
flash1.serialFlashDriver.peripheralDriver.OSPI.CSn0.$suggestSolution = "OSPI0_CSn0";
flash1.serialFlashDriver.peripheralDriver.OSPI.DQS.$suggestSolution  = "OSPI0_DQS";
flash1.serialFlashDriver.peripheralDriver.OSPI.D7.$suggestSolution   = "OSPI0_D7";
flash1.serialFlashDriver.peripheralDriver.OSPI.D6.$suggestSolution   = "OSPI0_D6";
flash1.serialFlashDriver.peripheralDriver.OSPI.D5.$suggestSolution   = "OSPI0_D5";
flash1.serialFlashDriver.peripheralDriver.OSPI.D4.$suggestSolution   = "OSPI0_D4";
flash1.serialFlashDriver.peripheralDriver.OSPI.D3.$suggestSolution   = "OSPI0_D3";
flash1.serialFlashDriver.peripheralDriver.OSPI.D2.$suggestSolution   = "OSPI0_D2";
flash1.serialFlashDriver.peripheralDriver.OSPI.D1.$suggestSolution   = "OSPI0_D1";
flash1.serialFlashDriver.peripheralDriver.OSPI.D0.$suggestSolution   = "OSPI0_D0";
mmcsd1.MMC0.CLK.$suggestSolution                                     = "MMC0_CLK";
mmcsd1.MMC0.CMD.$suggestSolution                                     = "MMC0_CMD";
mmcsd1.MMC0.DAT0.$suggestSolution                                    = "MMC0_DAT0";
mmcsd1.MMC0.DAT1.$suggestSolution                                    = "MMC0_DAT1";
mmcsd1.MMC0.DAT2.$suggestSolution                                    = "MMC0_DAT2";
mmcsd1.MMC0.DAT3.$suggestSolution                                    = "MMC0_DAT3";
mmcsd1.MMC0.DAT4.$suggestSolution                                    = "MMC0_DAT4";
mmcsd1.MMC0.DAT5.$suggestSolution                                    = "MMC0_DAT5";
mmcsd1.MMC0.DAT6.$suggestSolution                                    = "MMC0_DAT6";
mmcsd1.MMC0.DAT7.$suggestSolution                                    = "MMC0_DAT7";
uart1.UART.$suggestSolution                                          = "USART0";
uart1.UART.RXD.$suggestSolution                                      = "UART0_RXD";
uart1.UART.TXD.$suggestSolution                                      = "UART0_TXD";
