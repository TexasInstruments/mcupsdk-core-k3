/**
 * @cliArgs --device "AM62Dx" --package "AMB" --part "Default" --context "a53ss0-0" --product "MCU_PLUS_SDK@07.03.01"
 * @versions {"tool":"1.16.1+2960"}
 */

/**
 * Import the modules used in this configuration.
 */
const epwm       = scripting.addModule("/drivers/epwm/epwm", {}, false);
const epwm1      = epwm.addInstance();
const epwm2      = epwm.addInstance();
const epwm3      = epwm.addInstance();
const gpio       = scripting.addModule("/drivers/gpio/gpio", {}, false);
const gpio1      = gpio.addInstance();
const debug_log  = scripting.addModule("/kernel/dpl/debug_log");
const mmu_armv8  = scripting.addModule("/kernel/dpl/mmu_armv8", {}, false);
const mmu_armv81 = mmu_armv8.addInstance();
const mmu_armv82 = mmu_armv8.addInstance();

/**
 * Write custom configuration values to the imported modules.
 */
epwm1.$name            = "CONFIG_EPWM0";
epwm1.EPWM.$assign     = "EHRPWM0";
epwm1.EPWM.A.$assign   = "SPI0_CS0";
epwm1.EPWM.B.$assign   = "SPI0_CS1";
epwm1.EPWM.SYNCO.$used = false;
epwm1.EPWM.SYNCI.rx    = false;
epwm1.EPWM.SYNCI.$used = false;

epwm2.$name            = "CONFIG_EPWM1";
epwm2.EPWM.$assign     = "EHRPWM1";
epwm2.EPWM.A.$assign   = "MCASP0_AXR1";
epwm2.EPWM.B.$assign   = "MCASP0_AXR0";
epwm2.EPWM.SYNCO.$used = false;
epwm2.EPWM.SYNCI.rx    = false;
epwm2.EPWM.SYNCI.$used = false;

epwm3.$name            = "CONFIG_EPWM2";
epwm3.EPWM.$assign     = "EHRPWM2";
epwm3.EPWM.A.$assign   = "I2C1_SCL";
epwm3.EPWM.B.$assign   = "I2C1_SDA";
epwm3.EPWM.SYNCO.$used = false;
epwm3.EPWM.SYNCI.rx    = false;
epwm3.EPWM.SYNCI.$used = false;

gpio1.$name        = "CONFIG_GPIO0";
gpio1.pinDir       = "OUTPUT";
gpio1.GPIO.$assign = "GPIO0";

debug_log.enableUartLog        = true;
debug_log.enableCssLog         = false;
debug_log.uartLog.$name        = "CONFIG_UART0";
debug_log.uartLog.UART.$assign = "USART0";

mmu_armv81.size  = 0x80000000;
mmu_armv81.$name = "REGISTER_REGION";

mmu_armv82.size      = 0x80000000;
mmu_armv82.vAddr     = 0x80000000;
mmu_armv82.pAddr     = 0x80000000;
mmu_armv82.attribute = "MAIR7";
mmu_armv82.$name     = "DDR";

/**
 * Pinmux solution for unlocked pins/peripherals. This ensures that minor changes to the automatic solver in a future
 * version of the tool will not impact the pinmux you originally saw.  These lines can be completely deleted in order to
 * re-solve from scratch.
 */
gpio1.GPIO.gpioPin.$suggestSolution         = "OSPI0_CLK";
debug_log.uartLog.UART.RXD.$suggestSolution = "UART0_RXD";
debug_log.uartLog.UART.TXD.$suggestSolution = "UART0_TXD";
