/**
 * @cliArgs --device "AM62Dx" --package "ANF" --part "AM62D24-G" --context "a53ss0-0" --product "MCU_PLUS_SDK@07.03.01"
 * @versions {"tool":"1.20.999+143"}
 */

/**
 * Import the modules used in this configuration.
 */
const epwm       = scripting.addModule("/drivers/epwm/epwm", {}, false);
const epwm1      = epwm.addInstance();
const eqep       = scripting.addModule("/drivers/eqep/eqep", {}, false);
const eqep1      = eqep.addInstance();
const gpio       = scripting.addModule("/drivers/gpio/gpio", {}, false);
const gpio1      = gpio.addInstance();
const debug_log  = scripting.addModule("/kernel/dpl/debug_log");
const mmu_armv8  = scripting.addModule("/kernel/dpl/mmu_armv8", {}, false);
const mmu_armv81 = mmu_armv8.addInstance();
const mmu_armv82 = mmu_armv8.addInstance();

/**
 * Write custom configuration values to the imported modules.
 */
epwm1.$name            = "CONFIG_EPWM0";
epwm1.EPWM.A.$assign   = "MCASP0_AFSR";
epwm1.EPWM.B.$assign   = "MCASP0_ACLKR";
epwm1.EPWM.SYNCO.$used = false;
epwm1.EPWM.SYNCI.rx    = false;
epwm1.EPWM.SYNCI.$used = false;

eqep1.$name = "CONFIG_EQEP0";

gpio1.$name        = "CONFIG_GPIO0";
gpio1.pinDir       = "OUTPUT";
gpio1.GPIO.$assign = "MCASP0_ACLKX";

debug_log.enableUartLog        = true;
debug_log.uartLog.$name        = "CONFIG_UART0";
debug_log.uartLog.UART.$assign = "USART0";

mmu_armv81.size  = 0x80000000;
mmu_armv81.$name = "SOC_MEM_REGION";

mmu_armv82.size      = 0x80000000;
mmu_armv82.vAddr     = 0x80000000;
mmu_armv82.pAddr     = 0x80000000;
mmu_armv82.attribute = "MAIR7";
mmu_armv82.$name     = "DDR_REGION";

/**
 * Pinmux solution for unlocked pins/peripherals. This ensures that minor changes to the automatic solver in a future
 * version of the tool will not impact the pinmux you originally saw.  These lines can be completely deleted in order to
 * re-solve from scratch.
 */
epwm1.EPWM.$suggestSolution                 = "EHRPWM0";
eqep1.EQEP.$suggestSolution                 = "EQEP0";
eqep1.EQEP.A.$suggestSolution               = "MCASP0_AXR3";
eqep1.EQEP.B.$suggestSolution               = "MCASP0_AXR2";
eqep1.EQEP.I.$suggestSolution               = "MCASP0_AXR0";
eqep1.EQEP.S.$suggestSolution               = "MCASP0_AXR1";
debug_log.uartLog.UART.RXD.$suggestSolution = "UART0_RXD";
debug_log.uartLog.UART.TXD.$suggestSolution = "UART0_TXD";
