/**
 * @cliArgs --device "AM62SIP" --package "AMK" --part "Default" --context "a53ss1-0" --product "MCU_PLUS_SDK@07.03.01"
 * @versions {"tool":"1.20.0+3587"}
 */

/**
 * Import the modules used in this configuration.
 */
const gpio       = scripting.addModule("/drivers/gpio/gpio", {}, false);
const gpio1      = gpio.addInstance();
const debug_log  = scripting.addModule("/kernel/dpl/debug_log");
const mmu_armv8  = scripting.addModule("/kernel/dpl/mmu_armv8", {}, false);
const mmu_armv81 = mmu_armv8.addInstance();
const mmu_armv82 = mmu_armv8.addInstance();
const mmu_armv83 = mmu_armv8.addInstance();
const mmu_armv84 = mmu_armv8.addInstance();
const mmu_armv85 = mmu_armv8.addInstance();

/**
 * Write custom configuration values to the imported modules.
 */
gpio1.$name                = "GPIO_PUSH_BUTTON";
gpio1.trigType             = "RISE_EDGE";
gpio1.GPIO.$assign         = "GPIO1";
gpio1.GPIO.gpioPin.pu_pd   = "pu";
gpio1.GPIO.gpioPin.$assign = "UART0_CTSn";

debug_log.enableSharedMemLog = true;

mmu_armv81.size  = 0x80000000;
mmu_armv81.$name = "SOC_MEM_REGION";

mmu_armv82.attribute = "MAIR7";
mmu_armv82.$name     = "DDR_REGION";
mmu_armv82.size      = 0x2000000;
mmu_armv82.vAddr     = 0x86080000;
mmu_armv82.pAddr     = 0x86080000;

mmu_armv83.$name     = "LOG_SHM_MEM";
mmu_armv83.size      = 0x40000;
mmu_armv83.attribute = "MAIR4";
mmu_armv83.vAddr     = 0x8D000000;
mmu_armv83.pAddr     = 0x8D000000;

mmu_armv84.$name     = "AMP_SHM";
mmu_armv84.vAddr     = 0x99000000;
mmu_armv84.pAddr     = 0x99000000;
mmu_armv84.size      = 0x4000;
mmu_armv84.attribute = "MAIR7";

mmu_armv85.$name             = "ATF_REGION";
mmu_armv85.vAddr             = 0x86000000;
mmu_armv85.pAddr             = 0x86000000;
mmu_armv85.size              = 0x80000;
mmu_armv85.accessPermissions = "Privilege RO, User None";
mmu_armv85.shareable         = "Non Shareable";

/**
 * Pinmux solution for unlocked pins/peripherals. This ensures that minor changes to the automatic solver in a future
 * version of the tool will not impact the pinmux you originally saw.  These lines can be completely deleted in order to
 * re-solve from scratch.
 */
