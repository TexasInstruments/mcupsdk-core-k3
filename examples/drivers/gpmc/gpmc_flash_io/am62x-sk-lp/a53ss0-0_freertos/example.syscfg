/**
 * @cliArgs --device "AM62x" --package "AMC" --part "Default" --context "a53ss0-0" --product "MCU_PLUS_SDK@07.03.01"
 * @versions {"tool":"1.20.0+3587"}
 */

/**
 * Import the modules used in this configuration.
 */
const flash      = scripting.addModule("/board/flash/flash", {}, false);
const flash1     = flash.addInstance();
const clock      = scripting.addModule("/kernel/dpl/clock");
const debug_log  = scripting.addModule("/kernel/dpl/debug_log");
const mmu_armv8  = scripting.addModule("/kernel/dpl/mmu_armv8", {}, false);
const mmu_armv81 = mmu_armv8.addInstance();
const mmu_armv82 = mmu_armv8.addInstance();

/**
 * Write custom configuration values to the imported modules.
 */
flash1.$name                                      = "CONFIG_FLASH0";
flash1.flashTopology                              = "parallelFlash";
flash1.parallelFlashDriver.$name                  = "board_flash_parallelFlash_parallelflash0";
flash1.parallelFlashDriver.peripheralDriver.$name = "CONFIG_GPMC0";

const udma                                             = scripting.addModule("/drivers/udma/udma", {}, false);
const udma1                                            = udma.addInstance({}, false);
udma1.$name                                            = "CONFIG_UDMA0";
flash1.parallelFlashDriver.peripheralDriver.udmaDriver = udma1;

const udma_blkcopy_channel                                     = scripting.addModule("/drivers/udma/udma_blkcopy_channel", {}, false);
const udma_blkcopy_channel1                                    = udma_blkcopy_channel.addInstance({}, false);
udma_blkcopy_channel1.$name                                    = "CONFIG_UDMA_BLKCOPY_CH0";
flash1.parallelFlashDriver.peripheralDriver.udmaBlkCopyChannel = udma_blkcopy_channel1;

debug_log.enableUartLog = true;
debug_log.uartLog.$name = "CONFIG_UART0";

mmu_armv81.$name = "SOC_MEM_REGION";
mmu_armv81.size  = 0x80000000;

mmu_armv82.$name     = "DDR_REGION";
mmu_armv82.vAddr     = 0x80000000;
mmu_armv82.pAddr     = 0x80000000;
mmu_armv82.size      = 0x80000000;
mmu_armv82.attribute = "MAIR7";

/**
 * Pinmux solution for unlocked pins/peripherals. This ensures that minor changes to the automatic solver in a future
 * version of the tool will not impact the pinmux you originally saw.  These lines can be completely deleted in order to
 * re-solve from scratch.
 */
flash1.parallelFlashDriver.peripheralDriver.GPMC.$suggestSolution          = "GPMC0";
flash1.parallelFlashDriver.peripheralDriver.GPMC.OEn_REn.$suggestSolution  = "GPMC0_OEn_REn";
flash1.parallelFlashDriver.peripheralDriver.GPMC.ADVn_ALE.$suggestSolution = "GPMC0_ADVn_ALE";
flash1.parallelFlashDriver.peripheralDriver.GPMC.WEn.$suggestSolution      = "GPMC0_WEn";
flash1.parallelFlashDriver.peripheralDriver.GPMC.BE0n_CLE.$suggestSolution = "GPMC0_BE0n_CLE";
flash1.parallelFlashDriver.peripheralDriver.GPMC.CSn0.$suggestSolution     = "GPMC0_CSn0";
flash1.parallelFlashDriver.peripheralDriver.GPMC.AD0.$suggestSolution      = "GPMC0_AD0";
flash1.parallelFlashDriver.peripheralDriver.GPMC.AD1.$suggestSolution      = "GPMC0_AD1";
flash1.parallelFlashDriver.peripheralDriver.GPMC.AD2.$suggestSolution      = "GPMC0_AD2";
flash1.parallelFlashDriver.peripheralDriver.GPMC.AD3.$suggestSolution      = "GPMC0_AD3";
flash1.parallelFlashDriver.peripheralDriver.GPMC.AD4.$suggestSolution      = "GPMC0_AD4";
flash1.parallelFlashDriver.peripheralDriver.GPMC.AD5.$suggestSolution      = "GPMC0_AD5";
flash1.parallelFlashDriver.peripheralDriver.GPMC.AD6.$suggestSolution      = "GPMC0_AD6";
flash1.parallelFlashDriver.peripheralDriver.GPMC.AD7.$suggestSolution      = "GPMC0_AD7";
flash1.parallelFlashDriver.peripheralDriver.GPMC.WAIT0.$suggestSolution    = "GPMC0_WAIT0";
debug_log.uartLog.UART.$suggestSolution                                    = "USART0";
debug_log.uartLog.UART.RXD.$suggestSolution                                = "UART0_RXD";
debug_log.uartLog.UART.TXD.$suggestSolution                                = "UART0_TXD";
