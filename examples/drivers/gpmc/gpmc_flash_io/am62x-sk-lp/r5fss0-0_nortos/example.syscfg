/**
 * @cliArgs --device "AM62x" --package "ALW" --part "Default" --context "r5fss0-0" --product "MCU_PLUS_SDK@07.03.01"
 * @versions {"tool":"1.15.0+2826"}
 */

/**
 * Import the modules used in this configuration.
 */
const flash       = scripting.addModule("/board/flash/flash", {}, false);
const flash1      = flash.addInstance();
const clock       = scripting.addModule("/kernel/dpl/clock");
const debug_log   = scripting.addModule("/kernel/dpl/debug_log");
const mpu_armv7   = scripting.addModule("/kernel/dpl/mpu_armv7", {}, false);
const mpu_armv71  = mpu_armv7.addInstance();
const mpu_armv72  = mpu_armv7.addInstance();
const mpu_armv73  = mpu_armv7.addInstance();
const mpu_armv74  = mpu_armv7.addInstance();
const mpu_armv75  = mpu_armv7.addInstance();
const mpu_armv76  = mpu_armv7.addInstance();
const mpu_armv77  = mpu_armv7.addInstance();
const mpu_armv78  = mpu_armv7.addInstance();
const mpu_armv79  = mpu_armv7.addInstance();
const mpu_armv710 = mpu_armv7.addInstance();
const mpu_armv711 = mpu_armv7.addInstance();

/**
 * Write custom configuration values to the imported modules.
 */
flash1.$name                                          = "CONFIG_FLASH0";
flash1.flashTopology                                  = "parallelFlash";
flash1.parallelFlashDriver.$name                      = "board_flash_parallelFlash_parallelflash0";
flash1.parallelFlashDriver.peripheralDriver.$name     = "CONFIG_GPMC0";
flash1.parallelFlashDriver.peripheralDriver.dmaEnable = false;

clock.instance = "TIMER1";

debug_log.enableUartLog      = true;
debug_log.uartLog.$name      = "CONFIG_UART0";
debug_log.uartLog.intrEnable = "DISABLE";

mpu_armv71.$name             = "CONFIG_MPU_REGION0";
mpu_armv71.accessPermissions = "Supervisor RD+WR, User RD";
mpu_armv71.allowExecute      = false;
mpu_armv71.attributes        = "NonCached";

mpu_armv72.$name             = "CONFIG_MPU_REGION1";
mpu_armv72.accessPermissions = "Supervisor RD+WR, User RD";
mpu_armv72.size              = 7;

mpu_armv73.$name             = "CONFIG_MPU_REGION2";
mpu_armv73.accessPermissions = "Supervisor RD+WR, User RD";
mpu_armv73.baseAddr          = 0x41C00000;
mpu_armv73.size              = 19;

mpu_armv74.$name             = "CONFIG_MPU_REGION3";
mpu_armv74.accessPermissions = "Supervisor RD+WR, User RD";
mpu_armv74.baseAddr          = 0x70000000;
mpu_armv74.size              = 16;

mpu_armv75.$name    = "CONFIG_MPU_REGION4";
mpu_armv75.baseAddr = 0x80000000;
mpu_armv75.size     = 31;

mpu_armv76.$name      = "CONFIG_MPU_REGION5";
mpu_armv76.baseAddr   = 0x41010000;
mpu_armv76.size       = 15;
mpu_armv76.attributes = "NonCached";

mpu_armv77.$name      = "CONFIG_MPU_REGION6";
mpu_armv77.size       = 15;
mpu_armv77.attributes = "NonCached";

mpu_armv78.$name    = "CONFIG_MPU_REGION8";
mpu_armv78.baseAddr = 0x43C00000;
mpu_armv78.size     = 18;

mpu_armv79.$name        = "CONFIG_MPU_REGION7";
mpu_armv79.baseAddr     = 0x3B000000;
mpu_armv79.size         = 10;
mpu_armv79.attributes   = "Device";
mpu_armv79.allowExecute = false;

mpu_armv710.$name        = "CONFIG_MPU_REGION9";
mpu_armv710.baseAddr     = 0x50000000;
mpu_armv710.size         = 27;
mpu_armv710.attributes   = "Device";
mpu_armv710.allowExecute = false;

mpu_armv711.$name        = "CONFIG_MPU_REGION10";
mpu_armv711.allowExecute = false;
mpu_armv711.attributes   = "Device";
mpu_armv711.baseAddr     = 0x25010000;
mpu_armv711.size         = 12;

/**
 * Pinmux solution for unlocked pins/peripherals. This ensures that minor changes to the automatic solver in a future
 * version of the tool will not impact the pinmux you originally saw.  These lines can be completely deleted in order to
 * re-solve from scratch.
 */
flash1.parallelFlashDriver.peripheralDriver.GPMC.$suggestSolution          = "GPMC0";
flash1.parallelFlashDriver.peripheralDriver.GPMC.OEn_REn.$suggestSolution  = "ball.L24";
flash1.parallelFlashDriver.peripheralDriver.GPMC.ADVn_ALE.$suggestSolution = "ball.L23";
flash1.parallelFlashDriver.peripheralDriver.GPMC.WEn.$suggestSolution      = "ball.L25";
flash1.parallelFlashDriver.peripheralDriver.GPMC.BE0n_CLE.$suggestSolution = "ball.M24";
flash1.parallelFlashDriver.peripheralDriver.GPMC.CSn0.$suggestSolution     = "ball.M21";
flash1.parallelFlashDriver.peripheralDriver.GPMC.AD0.$suggestSolution      = "ball.M25";
flash1.parallelFlashDriver.peripheralDriver.GPMC.AD1.$suggestSolution      = "ball.N23";
flash1.parallelFlashDriver.peripheralDriver.GPMC.AD2.$suggestSolution      = "ball.N24";
flash1.parallelFlashDriver.peripheralDriver.GPMC.AD3.$suggestSolution      = "ball.N25";
flash1.parallelFlashDriver.peripheralDriver.GPMC.AD4.$suggestSolution      = "ball.P24";
flash1.parallelFlashDriver.peripheralDriver.GPMC.AD5.$suggestSolution      = "ball.P22";
flash1.parallelFlashDriver.peripheralDriver.GPMC.AD6.$suggestSolution      = "ball.P21";
flash1.parallelFlashDriver.peripheralDriver.GPMC.AD7.$suggestSolution      = "ball.R23";
flash1.parallelFlashDriver.peripheralDriver.GPMC.WAIT0.$suggestSolution    = "ball.U23";
debug_log.uartLog.WKUP_UART.$suggestSolution                               = "WKUP_USART0";
debug_log.uartLog.WKUP_UART.RXD.$suggestSolution                           = "ball.B4";
debug_log.uartLog.WKUP_UART.TXD.$suggestSolution                           = "ball.C5";
