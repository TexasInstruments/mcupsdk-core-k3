/**
 * @cliArgs --device "AM62x" --package "ALW" --part "Default" --context "r5fss0-0" --product "MCU_PLUS_SDK@07.03.01"
 * @versions {"tool":"1.18.0+3266"}
 */

/**
 * Import the modules used in this configuration.
 */
const led        = scripting.addModule("/board/led/led", {}, false);
const led1       = led.addInstance();
const i2c        = scripting.addModule("/drivers/i2c/i2c", {}, false);
const i2c1       = i2c.addInstance();
const clock      = scripting.addModule("/kernel/dpl/clock");
const debug_log  = scripting.addModule("/kernel/dpl/debug_log");
const mpu_armv7  = scripting.addModule("/kernel/dpl/mpu_armv7", {}, false);
const mpu_armv71 = mpu_armv7.addInstance();
const mpu_armv72 = mpu_armv7.addInstance();
const mpu_armv73 = mpu_armv7.addInstance();
const mpu_armv74 = mpu_armv7.addInstance();
const mpu_armv75 = mpu_armv7.addInstance();
const mpu_armv76 = mpu_armv7.addInstance();
const mpu_armv77 = mpu_armv7.addInstance();
const mpu_armv78 = mpu_armv7.addInstance();

/**
 * Write custom configuration values to the imported modules.
 */
led1.$name   = "CONFIG_LED0";
led1.name    = "Ioexp";
led1.ioIndex = 23;

i2c1.$name                      = "CONFIG_I2C0";
led1.peripheralDriver           = i2c1;
i2c1.useWakeupDomainPeripherals = false;
i2c1.I2C.$assign                = "I2C1";

clock.instance = "TIMER1";

debug_log.enableUartLog = true;
debug_log.uartTrace     = true;
debug_log.uartLog.$name = "CONFIG_UART0";

mpu_armv71.allowExecute = false;
mpu_armv71.size         = 31;
mpu_armv71.attributes   = "Device";
mpu_armv71.$name        = "REGISTER_REGION";

mpu_armv72.accessPermissions = "Supervisor RD+WR, User RD";
mpu_armv72.size              = 7;
mpu_armv72.$name             = "TCMA_VEC";

mpu_armv73.$name             = "CONFIG_MPU_REGION2";
mpu_armv73.accessPermissions = "Supervisor RD+WR, User RD";
mpu_armv73.baseAddr          = 0x41C00000;
mpu_armv73.size              = 19;

mpu_armv74.$name             = "CONFIG_MPU_REGION3";
mpu_armv74.accessPermissions = "Supervisor RD+WR, User RD";
mpu_armv74.baseAddr          = 0x70000000;
mpu_armv74.size              = 16;

mpu_armv75.baseAddr = 0x80000000;
mpu_armv75.size     = 31;
mpu_armv75.$name    = "DDR";

mpu_armv76.baseAddr   = 0x41010000;
mpu_armv76.size       = 15;
mpu_armv76.attributes = "NonCached";
mpu_armv76.$name      = "TCMB";

mpu_armv77.size       = 15;
mpu_armv77.attributes = "NonCached";
mpu_armv77.$name      = "TCMA";

mpu_armv78.baseAddr = 0x43C00000;
mpu_armv78.size     = 18;
mpu_armv78.$name    = "HSM_RAM";

/**
 * Pinmux solution for unlocked pins/peripherals. This ensures that minor changes to the automatic solver in a future
 * version of the tool will not impact the pinmux you originally saw.  These lines can be completely deleted in order to
 * re-solve from scratch.
 */
i2c1.I2C.SCL.$suggestSolution                    = "I2C1_SCL";
i2c1.I2C.SDA.$suggestSolution                    = "I2C1_SDA";
debug_log.uartLog.WKUP_UART.$suggestSolution     = "WKUP_USART0";
debug_log.uartLog.WKUP_UART.RXD.$suggestSolution = "WKUP_UART0_RXD";
debug_log.uartLog.WKUP_UART.TXD.$suggestSolution = "WKUP_UART0_TXD";
