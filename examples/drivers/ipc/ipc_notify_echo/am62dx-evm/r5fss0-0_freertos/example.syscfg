/**
 * @cliArgs --device "AM62Dx" --package "ANF" --part "AM62D24-G" --context "r5fss0-0" --product "MCU_PLUS_SDK@07.03.01"
 * @versions {"tool":"1.20.999+143"}
 */

/**
 * Import the modules used in this configuration.
 */
const flash       = scripting.addModule("/board/flash/flash", {}, false);
const flash1      = flash.addInstance();
const bootloader  = scripting.addModule("/drivers/bootloader/bootloader", {}, false);
const bootloader1 = bootloader.addInstance();
const bootloader2 = bootloader.addInstance();
const bootloader3 = bootloader.addInstance();
const bootloader4 = bootloader.addInstance();
const bootloader5 = bootloader.addInstance();
const bootloader6 = bootloader.addInstance();
const ipc         = scripting.addModule("/drivers/ipc/ipc");
const mmcsd       = scripting.addModule("/drivers/mmcsd/mmcsd", {}, false);
const mmcsd1      = mmcsd.addInstance();
const uart        = scripting.addModule("/drivers/uart/uart", {}, false);
const uart1       = uart.addInstance();
const clock       = scripting.addModule("/kernel/dpl/clock");
const debug_log   = scripting.addModule("/kernel/dpl/debug_log");
const mpu_armv7   = scripting.addModule("/kernel/dpl/mpu_armv7", {}, false);
const mpu_armv71  = mpu_armv7.addInstance();
const mpu_armv72  = mpu_armv7.addInstance();
const mpu_armv73  = mpu_armv7.addInstance();
const mpu_armv74  = mpu_armv7.addInstance();
const mpu_armv75  = mpu_armv7.addInstance();
const mpu_armv76  = mpu_armv7.addInstance();
const mpu_armv77  = mpu_armv7.addInstance();
const mpu_armv78  = mpu_armv7.addInstance();
const mpu_armv79  = mpu_armv7.addInstance();
const mpu_armv710 = mpu_armv7.addInstance();
const mpu_armv711 = mpu_armv7.addInstance();
const mpu_armv712 = mpu_armv7.addInstance();

/**
 * Write custom configuration values to the imported modules.
 */
bootloader1.$name          = "CONFIG_BOOTLOADER_FLASH_HSM";
bootloader1.appImageOffset = "0x240000";

bootloader2.$name          = "CONFIG_BOOTLOADER_FLASH_A53";
bootloader2.appImageOffset = "0x1200000";

bootloader3.appImageOffset = "0x800000";
bootloader3.$name          = "CONFIG_BOOTLOADER_FLASH_MCU";

bootloader1.flashDriver                         = flash1;
bootloader2.flashDriver                         = flash1;
bootloader3.flashDriver                         = flash1;
flash1.$name                                    = "CONFIG_FLASH_SBL";
flash1.serialFlashDriver.$name                  = "board_flash_serialFlash_serialflash0";
flash1.serialFlashDriver.peripheralDriver.$name = "CONFIG_OSPI_SBL";

bootloader4.bootMedia          = "EMMC";
bootloader4.$name              = "CONFIG_BOOTLOADER_EMMC_HSM";
bootloader4.EMMCAppImageOffset = "0x240000";

bootloader5.$name              = "CONFIG_BOOTLOADER_EMMC_A53";
bootloader5.bootMedia          = "EMMC";
bootloader5.EMMCAppImageOffset = "0x1200000";

bootloader6.$name              = "CONFIG_BOOTLOADER_EMMC_MCU";
bootloader6.appImageOffset     = "0x800000";
bootloader6.bootMedia          = "EMMC";
bootloader6.EMMCAppImageOffset = "0x800000";

ipc.c75ss0_0       = "NONE";
ipc.mcu_r5fss0_0   = "notify";
ipc.enableLinuxIpc = false;
ipc.a53ss0_0       = "notify";

bootloader4.MMCSDDriver = mmcsd1;
bootloader5.MMCSDDriver = mmcsd1;
mmcsd1.$name            = "CONFIG_MMCSD_SBL";
bootloader6.MMCSDDriver = mmcsd1;

uart1.$name                      = "CONFIG_UART_SBL";
uart1.addedByBootloader          = true;
uart1.useWakeupDomainPeripherals = false;
uart1.intrEnable                 = "DISABLE";

debug_log.enableUartLog            = true;
debug_log.enableSharedMemLog       = true;
debug_log.enableSharedMemLogReader = true;
debug_log.enableCssLog             = false;
debug_log.uartTrace                = true;
debug_log.uartLog.$name            = "CONFIG_UART_APP";

mpu_armv71.accessPermissions = "Supervisor RD+WR, User RD";
mpu_armv71.allowExecute      = false;
mpu_armv71.size              = 31;
mpu_armv71.attributes        = "Device";
mpu_armv71.$name             = "REGISTER_REGION";

mpu_armv72.accessPermissions = "Supervisor RD+WR, User RD";
mpu_armv72.size              = 7;
mpu_armv72.$name             = "TCMA_VEC";

mpu_armv73.$name             = "CONFIG_MPU_REGION2";
mpu_armv73.accessPermissions = "Supervisor RD+WR, User RD";
mpu_armv73.baseAddr          = 0x41C00000;
mpu_armv73.size              = 19;

mpu_armv74.$name             = "CONFIG_MPU_REGION3";
mpu_armv74.accessPermissions = "Supervisor RD+WR, User RD";
mpu_armv74.baseAddr          = 0x70000000;
mpu_armv74.size              = 16;

mpu_armv75.$name    = "DDR";
mpu_armv75.baseAddr = 0x80000000;
mpu_armv75.size     = 31;

mpu_armv76.baseAddr   = 0x41010000;
mpu_armv76.size       = 15;
mpu_armv76.attributes = "NonCached";
mpu_armv76.$name      = "TCMB";

mpu_armv77.size       = 15;
mpu_armv77.attributes = "NonCached";
mpu_armv77.$name      = "TCMA";

mpu_armv78.baseAddr = 0x43C00000;
mpu_armv78.size     = 18;
mpu_armv78.$name    = "HSM_RAM";

mpu_armv79.$name      = "RING_BUFFER";
mpu_armv79.baseAddr   = 0x9C800000;
mpu_armv79.attributes = "NonCached";
mpu_armv79.size       = 21;

mpu_armv710.attributes   = "NonCached";
mpu_armv710.size         = 20;
mpu_armv710.allowExecute = false;
mpu_armv710.$name        = "RESOURCE_TABLE";
mpu_armv710.baseAddr     = 0x9D900000;

mpu_armv711.$name        = "RTOS_NORTOS_IPC_VRING";
mpu_armv711.baseAddr     = 0xA0000000;
mpu_armv711.size         = 23;
mpu_armv711.allowExecute = false;
mpu_armv711.attributes   = "NonCached";

mpu_armv712.$name      = "LOG_SHM_MEM";
mpu_armv712.baseAddr   = 0xA1000000;
mpu_armv712.attributes = "NonCached";
mpu_armv712.size       = 18;

/**
 * Pinmux solution for unlocked pins/peripherals. This ensures that minor changes to the automatic solver in a future
 * version of the tool will not impact the pinmux you originally saw.  These lines can be completely deleted in order to
 * re-solve from scratch.
 */
flash1.serialFlashDriver.peripheralDriver.OSPI.$suggestSolution      = "OSPI0";
flash1.serialFlashDriver.peripheralDriver.OSPI.CLK.$suggestSolution  = "OSPI0_CLK";
flash1.serialFlashDriver.peripheralDriver.OSPI.CSn0.$suggestSolution = "OSPI0_CSn0";
flash1.serialFlashDriver.peripheralDriver.OSPI.DQS.$suggestSolution  = "OSPI0_DQS";
flash1.serialFlashDriver.peripheralDriver.OSPI.D7.$suggestSolution   = "OSPI0_D7";
flash1.serialFlashDriver.peripheralDriver.OSPI.D6.$suggestSolution   = "OSPI0_D6";
flash1.serialFlashDriver.peripheralDriver.OSPI.D5.$suggestSolution   = "OSPI0_D5";
flash1.serialFlashDriver.peripheralDriver.OSPI.D4.$suggestSolution   = "OSPI0_D4";
flash1.serialFlashDriver.peripheralDriver.OSPI.D3.$suggestSolution   = "OSPI0_D3";
flash1.serialFlashDriver.peripheralDriver.OSPI.D2.$suggestSolution   = "OSPI0_D2";
flash1.serialFlashDriver.peripheralDriver.OSPI.D1.$suggestSolution   = "OSPI0_D1";
flash1.serialFlashDriver.peripheralDriver.OSPI.D0.$suggestSolution   = "OSPI0_D0";
mmcsd1.MMC0.$suggestSolution                                         = "MMC0";
mmcsd1.MMC0.CLK.$suggestSolution                                     = "MMC0_CLK";
mmcsd1.MMC0.CMD.$suggestSolution                                     = "MMC0_CMD";
mmcsd1.MMC0.DAT0.$suggestSolution                                    = "MMC0_DAT0";
mmcsd1.MMC0.DAT1.$suggestSolution                                    = "MMC0_DAT1";
mmcsd1.MMC0.DAT2.$suggestSolution                                    = "MMC0_DAT2";
mmcsd1.MMC0.DAT3.$suggestSolution                                    = "MMC0_DAT3";
mmcsd1.MMC0.DAT4.$suggestSolution                                    = "MMC0_DAT4";
mmcsd1.MMC0.DAT5.$suggestSolution                                    = "MMC0_DAT5";
mmcsd1.MMC0.DAT6.$suggestSolution                                    = "MMC0_DAT6";
mmcsd1.MMC0.DAT7.$suggestSolution                                    = "MMC0_DAT7";
uart1.UART.$suggestSolution                                          = "USART0";
uart1.UART.RXD.$suggestSolution                                      = "UART0_RXD";
uart1.UART.TXD.$suggestSolution                                      = "UART0_TXD";
debug_log.uartLog.WKUP_UART.$suggestSolution                         = "WKUP_USART0";
debug_log.uartLog.WKUP_UART.RXD.$suggestSolution                     = "WKUP_UART0_RXD";
debug_log.uartLog.WKUP_UART.TXD.$suggestSolution                     = "WKUP_UART0_TXD";
