/**
 * @cliArgs --device "J722S_TDA4VEN_TDA4AEN_AM67" --package "AMW" --part "Default" --context "c75ss1-0" --product "MCU_PLUS_SDK@07.03.01"
 * @versions {"tool":"1.20.0+3587"}
 */

/**
 * Import the modules used in this configuration.
 */
const ipc         = scripting.addModule("/drivers/ipc/ipc");
const debug_log   = scripting.addModule("/kernel/dpl/debug_log");
const mmu_armv8   = scripting.addModule("/kernel/dpl/mmu_armv8", {}, false);
const mmu_armv81  = mmu_armv8.addInstance();
const mmu_armv82  = mmu_armv8.addInstance();
const mmu_armv83  = mmu_armv8.addInstance();
const mmu_armv84  = mmu_armv8.addInstance();
const mmu_armv85  = mmu_armv8.addInstance();
const mmu_armv86  = mmu_armv8.addInstance();
const mmu_armv87  = mmu_armv8.addInstance();
const mmu_armv88  = mmu_armv8.addInstance();
const mmu_armv89  = mmu_armv8.addInstance();

/**
 * Write custom configuration values to the imported modules.
 */
ipc.vringAllocationPDK = false;

debug_log.enableSharedMemLog   = true;
debug_log.enableLogZoneWarning = false;
debug_log.enableLogZoneError   = false;
debug_log.enableUartLog        = false;
debug_log.enableCssLog         = false;

/**
 * Register region 0.
 * Region start: 0x0
 * Region end: 0x20000000
 * Read and write for both privileged and user modes.
 * No Execute for both privileged and user modes.
 * Attribute is MAIR0.
 */
mmu_armv81.vAddr             = 0x00000000;
mmu_armv81.pAddr             = 0x00000000;
mmu_armv81.size              = 0x20000000;
mmu_armv81.$name             = "REGISTER_REGION_0";
mmu_armv81.accessPermissions = "Privilege RW, User RW";
mmu_armv81.privExecute       = false;
mmu_armv81.userExecute       = false;
mmu_armv81.attribute = "MAIR0";

/**
 * Register region 1.
 * Region start: 0x20000000
 * Region end: 0x40000000
 * Read and write for both privileged and user modes.
 * No Execute for both privileged and user modes.
 * Attribute is MAIR0.
 */
mmu_armv82.vAddr             = 0x20000000;
mmu_armv82.pAddr             = 0x20000000;
mmu_armv82.size              = 0x20000000;
mmu_armv82.$name             = "REGISTER_REGION_1";
mmu_armv82.accessPermissions = "Privilege RW, User RW";
mmu_armv82.privExecute       = false;
mmu_armv82.userExecute       = false;
mmu_armv82.attribute         = "MAIR0";

/**
 * Register region 2.
 * Region start: 0x40000000
 * Region end: 0x60000000
 * Read and write for both privileged and user modes.
 * No Execute for both privileged and user modes.
 * Attribute is MAIR0.
 */
mmu_armv83.vAddr             = 0x40000000;
mmu_armv83.pAddr             = 0x40000000;
mmu_armv83.size              = 0x20000000;
mmu_armv83.$name             = "REGISTER_REGION_2";
mmu_armv83.accessPermissions = "Privilege RW, User RW";
mmu_armv83.privExecute       = false;
mmu_armv83.userExecute       = false;
mmu_armv83.attribute         = "MAIR0";

/**
 * FSS region.
 * Region start: 0x60000000
 * Region end: 0x64000000
 * Read and write for both privileged and user modes.
 * No Execute for both privileged and user modes.
 * Attribute is MAIR0.
 */
mmu_armv84.vAddr             = 0x60000000;
mmu_armv84.pAddr             = 0x60000000;
mmu_armv84.size              = 0x4000000;
mmu_armv84.$name             = "FSS0_DAT_REGION";
mmu_armv84.accessPermissions = "Privilege RW, User RW";
mmu_armv84.privExecute       = false;
mmu_armv84.userExecute       = false;
mmu_armv84.attribute         = "MAIR0";

/**
 * CLEC region.
 * Region start: 0x7D200000
 * Region end: 0x7D200000
 * Read and write for both privileged and user modes.
 * No Execute for both privileged and user modes.
 * Attribute is MAIR0.
 */
mmu_armv85.vAddr             = 0x7D200000;
mmu_armv85.pAddr             = 0x7D200000;
mmu_armv85.$name             = "CLEC";
mmu_armv85.accessPermissions = "Privilege RW, User RW";
mmu_armv85.size              = 0x100000;
mmu_armv85.privExecute       = false;
mmu_armv85.userExecute       = false;
mmu_armv85.attribute         = "MAIR0";

/**
 * DRU region.
 * Region start: 0x7D400000
 * Region end: 0x7D400000
 * Read and write for both privileged and user modes.
 * No Execute for both privileged and user modes.
 * Attribute is MAIR0.
 */
mmu_armv86.$name             = "DRU";
mmu_armv86.vAddr             = 0x7D400000;
mmu_armv86.pAddr             = 0x7D400000;
mmu_armv86.size              = 0x100000;
mmu_armv86.accessPermissions = "Privilege RW, User RW";
mmu_armv86.privExecute       = false;
mmu_armv86.userExecute       = false;
mmu_armv86.attribute         = "MAIR0";

/**
 * DDR region.
 * Region start: 0x7D200000
 * Region end: 0x7D210000
 * Read and write for both privileged and user modes.
 * Execute for both privileged and user modes.
 * Attribute is MAIR7.
 */
mmu_armv87.vAddr       = 0x80000000;
mmu_armv87.pAddr       = 0x80000000;
mmu_armv87.size        = 0x80000000;
mmu_armv87.attribute   = "MAIR7";
mmu_armv87.$name       = "DDR_0";
mmu_armv87.privExecute = true;
mmu_armv87.userExecute = true;

mmu_armv88.size      = 0x2000000;
mmu_armv88.$name     = "RTOS_IPC_VRING";
mmu_armv88.attribute = "MAIR4";
mmu_armv88.vAddr     = 0xA5000000;
mmu_armv88.pAddr     = 0xA5000000;

mmu_armv89.size      = 0x200000;
mmu_armv89.$name     = "LINUX_VRING";
mmu_armv89.attribute = "MAIR4";
mmu_armv89.vAddr     = 0xA4000000;
mmu_armv89.pAddr     = 0xA4000000;
