/**
 * @cliArgs --device "AM62Px" --package "AMH" --part "Default" --context "wkup-r5fss0-0" --product "MCU_PLUS_SDK@07.03.01"
 * @versions {"tool":"1.18.0+3266"}
 */

/**
 * Import the modules used in this configuration.
 */
const flash       = scripting.addModule("/board/flash/flash", {}, false);
const flash1      = flash.addInstance();
const bootloader  = scripting.addModule("/drivers/bootloader/bootloader", {}, false);
const bootloader1 = bootloader.addInstance();
const bootloader2 = bootloader.addInstance();
const bootloader3 = bootloader.addInstance();
const gtc         = scripting.addModule("/drivers/gtc/gtc");
const ipc         = scripting.addModule("/drivers/ipc/ipc");
const mmcsd       = scripting.addModule("/drivers/mmcsd/mmcsd", {}, false);
const mmcsd1      = mmcsd.addInstance();
const uart        = scripting.addModule("/drivers/uart/uart", {}, false);
const uart1       = uart.addInstance();
const clock       = scripting.addModule("/kernel/dpl/clock");
const debug_log   = scripting.addModule("/kernel/dpl/debug_log");
const mpu_armv7   = scripting.addModule("/kernel/dpl/mpu_armv7", {}, false);
const mpu_armv71  = mpu_armv7.addInstance();
const mpu_armv72  = mpu_armv7.addInstance();
const mpu_armv73  = mpu_armv7.addInstance();
const mpu_armv74  = mpu_armv7.addInstance();
const mpu_armv75  = mpu_armv7.addInstance();
const mpu_armv76  = mpu_armv7.addInstance();
const mpu_armv77  = mpu_armv7.addInstance();
const mpu_armv78  = mpu_armv7.addInstance();
const mpu_armv79  = mpu_armv7.addInstance();
const mpu_armv710 = mpu_armv7.addInstance();

/**
 * Write custom configuration values to the imported modules.
 */
bootloader1.appImageOffset = "0x240000";
bootloader1.$name          = "CONFIG_BOOTLOADER_FLASH_HSM";

bootloader2.$name          = "CONFIG_BOOTLOADER_FLASH_LINUX";
bootloader2.appImageOffset = "0x1200000";

bootloader3.$name          = "CONFIG_BOOTLOADER_FLASH_MCU";
bootloader3.appImageOffset = "0x800000";

bootloader1.flashDriver                                  = flash1;
bootloader2.flashDriver                                  = flash1;
bootloader3.flashDriver                                  = flash1;
flash1.$name                                             = "CONFIG_FLASH_SBL";
flash1.serialFlashDriver.$name                           = "board_flash_serialFlash_serialflash0";
flash1.serialFlashDriver.peripheralDriver.dmaEnable      = true;
flash1.serialFlashDriver.peripheralDriver.phyEnable      = true;
flash1.serialFlashDriver.peripheralDriver.$name          = "CONFIG_OSPI_SBL";
flash1.serialFlashDriver.peripheralDriver.phySkipTuning = true;

ipc.enableLinuxIpc = false;
ipc.a53ss0_0       = "notify_rpmsg";

mmcsd1.$name        = "CONFIG_MMCSD0";
mmcsd1.moduleSelect = "MMC1";

uart1.useWakeupDomainPeripherals = false;
uart1.intrEnable                 = "DISABLE";
uart1.addedByBootloader          = true;
uart1.$name                      = "CONFIG_UART_SBL";
uart1.UART.$assign               = "USART0";

const udma                                           = scripting.addModule("/drivers/udma/udma", {}, false);
const udma1                                          = udma.addInstance({}, false);
udma1.$name                                          = "CONFIG_UDMA0";
flash1.serialFlashDriver.peripheralDriver.udmaDriver = udma1;

const udma_blkcopy_channel                                   = scripting.addModule("/drivers/udma/udma_blkcopy_channel", {}, false);
const udma_blkcopy_channel1                                  = udma_blkcopy_channel.addInstance({}, false);
udma_blkcopy_channel1.$name                                  = "CONFIG_UDMA_BLKCOPY_CH0";
flash1.serialFlashDriver.peripheralDriver.udmaBlkCopyChannel = udma_blkcopy_channel1;

debug_log.enableUartLog      = true;
debug_log.uartTrace          = true;
debug_log.uartLog.intrEnable = "DISABLE";
debug_log.uartLog.$name      = "CONFIG_UART_APP";

mpu_armv71.accessPermissions = "Supervisor RD+WR, User RD";
mpu_armv71.allowExecute      = false;
mpu_armv71.size              = 31;
mpu_armv71.attributes        = "Device";
mpu_armv71.$name             = "REGISTER_REGION";

mpu_armv72.accessPermissions = "Supervisor RD+WR, User RD";
mpu_armv72.size              = 7;
mpu_armv72.$name             = "TCMA_VEC";

mpu_armv73.$name    = "DDR";
mpu_armv73.baseAddr = 0x80000000;
mpu_armv73.size     = 31;

mpu_armv74.baseAddr   = 0x41010000;
mpu_armv74.size       = 15;
mpu_armv74.attributes = "NonCached";
mpu_armv74.$name      = "TCMB";

mpu_armv75.size       = 15;
mpu_armv75.attributes = "NonCached";
mpu_armv75.$name      = "TCMA";

mpu_armv76.baseAddr = 0x43C00000;
mpu_armv76.size     = 18;
mpu_armv76.$name    = "HSM_RAM";

mpu_armv77.baseAddr     = 0x9B500000;
mpu_armv77.allowExecute = false;
mpu_armv77.attributes   = "NonCached";
mpu_armv77.$name        = "RTOS_NORTOS_IPC_VRING1";
mpu_armv77.size         = 20;

mpu_armv78.$name        = "RTOS_NORTOS_IPC_VRING2";
mpu_armv78.baseAddr     = 0x9B600000;
mpu_armv78.size         = 21;
mpu_armv78.allowExecute = false;
mpu_armv78.attributes   = "NonCached";

mpu_armv79.$name        = "FSS0_OSPI0_CTRL_REG";
mpu_armv79.baseAddr     = 0xFC40000;
mpu_armv79.attributes   = "Device";
mpu_armv79.allowExecute = false;
mpu_armv79.size         = 8;

mpu_armv710.$name        = "UART0_REG";
mpu_armv710.baseAddr     = 0x2800000;
mpu_armv710.size         = 9;
mpu_armv710.attributes   = "Device";
mpu_armv710.allowExecute = false;

/**
 * Pinmux solution for unlocked pins/peripherals. This ensures that minor changes to the automatic solver in a future
 * version of the tool will not impact the pinmux you originally saw.  These lines can be completely deleted in order to
 * re-solve from scratch.
 */
flash1.serialFlashDriver.peripheralDriver.OSPI.$suggestSolution      = "OSPI0";
flash1.serialFlashDriver.peripheralDriver.OSPI.CLK.$suggestSolution  = "OSPI0_CLK";
flash1.serialFlashDriver.peripheralDriver.OSPI.CSn0.$suggestSolution = "OSPI0_CSn0";
flash1.serialFlashDriver.peripheralDriver.OSPI.DQS.$suggestSolution  = "OSPI0_DQS";
flash1.serialFlashDriver.peripheralDriver.OSPI.D7.$suggestSolution   = "OSPI0_D7";
flash1.serialFlashDriver.peripheralDriver.OSPI.D6.$suggestSolution   = "OSPI0_D6";
flash1.serialFlashDriver.peripheralDriver.OSPI.D5.$suggestSolution   = "OSPI0_D5";
flash1.serialFlashDriver.peripheralDriver.OSPI.D4.$suggestSolution   = "OSPI0_D4";
flash1.serialFlashDriver.peripheralDriver.OSPI.D3.$suggestSolution   = "OSPI0_D3";
flash1.serialFlashDriver.peripheralDriver.OSPI.D2.$suggestSolution   = "OSPI0_D2";
flash1.serialFlashDriver.peripheralDriver.OSPI.D1.$suggestSolution   = "OSPI0_D1";
flash1.serialFlashDriver.peripheralDriver.OSPI.D0.$suggestSolution   = "OSPI0_D0";
mmcsd1.MMC1.$suggestSolution                                         = "MMC1";
mmcsd1.MMC1.CLK.$suggestSolution                                     = "MMC1_CLK";
mmcsd1.MMC1.CMD.$suggestSolution                                     = "MMC1_CMD";
mmcsd1.MMC1.DAT0.$suggestSolution                                    = "MMC1_DAT0";
mmcsd1.MMC1.DAT1.$suggestSolution                                    = "MMC1_DAT1";
mmcsd1.MMC1.DAT2.$suggestSolution                                    = "MMC1_DAT2";
mmcsd1.MMC1.DAT3.$suggestSolution                                    = "MMC1_DAT3";
uart1.UART.RXD.$suggestSolution                                      = "UART0_RXD";
uart1.UART.TXD.$suggestSolution                                      = "UART0_TXD";
debug_log.uartLog.WKUP_UART.$suggestSolution                         = "WKUP_USART0";
debug_log.uartLog.WKUP_UART.RXD.$suggestSolution                     = "WKUP_UART0_RXD";
debug_log.uartLog.WKUP_UART.TXD.$suggestSolution                     = "WKUP_UART0_TXD";
