/**
 * @cliArgs --device "AM62Dx" --part "AM62D24-G" --package "ANF" --context "c75ss0-0" --product "MCU_PLUS_SDK@07.03.01"
 * @versions {"tool":"1.24.0+4150"}
 */

/**
 * Import the modules used in this configuration.
 */
const gpio        = scripting.addModule("/drivers/gpio/gpio", {}, false);
const gpio1       = gpio.addInstance();
const gpio2       = gpio.addInstance();
const gpio3       = gpio.addInstance();
const gpio4       = gpio.addInstance();
const i2c         = scripting.addModule("/drivers/i2c/i2c", {}, false);
const i2c1        = i2c.addInstance();
const i2c2        = i2c.addInstance();
const mcasp       = scripting.addModule("/drivers/mcasp/mcasp", {}, false);
const mcasp1      = mcasp.addInstance();
const mcasp2      = mcasp.addInstance();
const debug_log   = scripting.addModule("/kernel/dpl/debug_log");
const mmu_armv8   = scripting.addModule("/kernel/dpl/mmu_armv8", {}, false);
const mmu_armv81  = mmu_armv8.addInstance();
const mmu_armv82  = mmu_armv8.addInstance();
const mmu_armv83  = mmu_armv8.addInstance();
const mmu_armv84  = mmu_armv8.addInstance();
const mmu_armv85  = mmu_armv8.addInstance();
const mmu_armv86  = mmu_armv8.addInstance();
const mmu_armv87  = mmu_armv8.addInstance();
const mmu_armv88  = mmu_armv8.addInstance();
const mmu_armv89  = mmu_armv8.addInstance();
const mmu_armv810 = mmu_armv8.addInstance();
const mmu_armv811 = mmu_armv8.addInstance();

/**
 * Write custom configuration values to the imported modules.
 */
gpio1.pinDir       = "OUTPUT";
gpio1.$name        = "GPIO_STBY_AEC1_TAS0";
gpio1.GPIO.$assign = "GPMC0_OEn_REn";

gpio2.pinDir       = "OUTPUT";
gpio2.$name        = "GPIO_STBY_AEC1_TAS1";
gpio2.GPIO.$assign = "GPMC0_WEn";

gpio3.$name        = "GPIO_STBY_AEC2_TAS0";
gpio3.pinDir       = "OUTPUT";
gpio3.GPIO.$assign = "GPIO0_45";

gpio4.$name        = "GPIO_STBY_AEC2_TAS1";
gpio4.pinDir       = "OUTPUT";
gpio4.GPIO.$assign = "GPIO0_46";

i2c1.$name           = "CONFIG_I2C0";
i2c1.I2C.$assign     = "I2C2";
i2c1.I2C.SCL.$assign = "GPMC0_CSn2";
i2c1.I2C.SDA.$assign = "GPMC0_CSn3";
i2c1.I2C_child.$name = "drivers_i2c_v0_i2c_v0_template0";

i2c2.$name           = "CONFIG_I2C1";
i2c2.I2C.$assign     = "I2C1";
i2c2.I2C.SCL.$assign = "I2C1_SCL";
i2c2.I2C.SDA.$assign = "I2C1_SDA";
i2c2.I2C_child.$name = "drivers_i2c_v0_i2c_v0_template1";

mcasp1.$name                                   = "CONFIG_MCASP0";
mcasp1.enableLoopback                          = false;
mcasp1.txDataMask                              = 0xFFFFFFFF;
mcasp1.rxCallbackFxn                           = "mcasp_rxcb";
mcasp1.rxDataMask                              = 0xFFFFFFFF;
mcasp1.clkSyncMode                             = "ASYNC";
mcasp1.RxMode                                  = "TDM";
mcasp1.rxFsWidth                               = 0;
mcasp1.rxBitClkPolarity                        = 0;
mcasp1.rxActiveSlotMask                        = 0x3;
mcasp1.rxFsPolarity                            = 0;
mcasp1.enableMcaspRx                           = false;
mcasp1.TxMode                                  = "TDM";
mcasp1.txFsWidth                               = 0;
mcasp1.txFsPolarity                            = 0;
mcasp1.NumTxSlots                              = 8;
mcasp1.txActiveSlotMask                        = 0xFF;
mcasp1.txDataDelay                             = 0;
mcasp1.txCallbackFxn                           = "mcasp_txcb";
mcasp1.externTxLoopjob                         = true;
mcasp1.txLoopjobBufExtern                      = "unsigned int audio_sample[]";
mcasp1.txLoopjobBuf                            = "audio_sample";
mcasp1.txLoopjobBufLength                      = 1411200;
mcasp1.txClkDiv                                = 2;
mcasp1.txBclkCalculated                        = 12000000;
mcasp1.txClkApplyAlert                         = false;
mcasp1.rxClkApplyAlert                         = false;
mcasp1.SYSTEM.$assignAllowConflicts            = "SYSTEM0";
mcasp1.mcaspSer.create(1);
mcasp1.mcaspSer[0].$name                       = "CONFIG_MCASP_SER0";
mcasp1.mcaspSer[0].MCASP.$assignAllowConflicts = "MCASP1";
mcasp1.mcaspSer[0].MCASP.AXR0.$assign          = "MMC2_DAT0";
mcasp1.MCASP.$assignAllowConflicts             = "MCASP1";
mcasp1.MCASP.AFSX.$assign                      = "MMC2_SDWP";
mcasp1.MCASP.ACLKX.$assign                     = "MMC2_SDCD";
scripting.suppress("Resource conflict,SYSTEM0 is also in use by @@@.+?@@@", mcasp1.SYSTEM, "$assign");
scripting.suppress("Resource conflict,MCASP1 is also in use by @@@.+?@@@", mcasp1.mcaspSer[0].MCASP, "$assign");
scripting.suppress("Resource conflict,MCASP1 is also in use by @@@.+?@@@", mcasp1.MCASP, "$assign");

mcasp2.$name                                   = "CONFIG_MCASP1";
mcasp2.enableLoopback                          = false;
mcasp2.clkSyncMode                             = "ASYNC";
mcasp2.TxMode                                  = "TDM";
mcasp2.NumTxSlots                              = 8;
mcasp2.txDataDelay                             = 0;
mcasp2.txFsWidth                               = 0;
mcasp2.txFsPolarity                            = 0;
mcasp2.txDataMask                              = 0xFFFFFFFF;
mcasp2.txActiveSlotMask                        = 0xFF;
mcasp2.enableMcaspRx                           = false;
mcasp2.txCallbackFxn                           = "mcasp_txcb";
mcasp2.externTxLoopjob                         = true;
mcasp2.txLoopjobBufExtern                      = "unsigned int audio_sample[]";
mcasp2.txLoopjobBuf                            = "audio_sample";
mcasp2.txLoopjobBufLength                      = 1411200;
mcasp2.txClkDiv                                = 2;
mcasp2.txBclkCalculated                        = 12000000;
mcasp2.txClkApplyAlert                         = false;
mcasp2.rxClkApplyAlert                         = false;
mcasp2.SYSTEM.$assignAllowConflicts            = "SYSTEM0";
mcasp2.mcaspSer.create(1);
mcasp2.mcaspSer[0].$name                       = "CONFIG_MCASP_SER1";
mcasp2.mcaspSer[0].MCASP.$assignAllowConflicts = "MCASP2";
mcasp2.MCASP.$assignAllowConflicts             = "MCASP2";
mcasp2.MCASP.AFSX.$assign                      = "GPMC0_AD12";
mcasp2.MCASP.ACLKX.$assign                     = "GPMC0_AD13";
scripting.suppress("Resource conflict,SYSTEM0 is also in use by @@@.+?@@@", mcasp2.SYSTEM, "$assign");
scripting.suppress("Resource conflict,MCASP2 is also in use by @@@.+?@@@", mcasp2.mcaspSer[0].MCASP, "$assign");
scripting.suppress("Resource conflict,MCASP2 is also in use by @@@.+?@@@", mcasp2.MCASP, "$assign");

const udma         = scripting.addModule("/drivers/udma/udma", {}, false);
const udma1        = udma.addInstance({}, false);
udma1.$name        = "CONFIG_UDMA0";
mcasp1.bcDmaDriver = udma1;
mcasp2.bcDmaDriver = udma1;

debug_log.enableUartLog                   = true;
debug_log.enableCssLog                    = false;
debug_log.uartLog.$name                   = "CONFIG_UART0";
debug_log.uartLog.useMcuDomainPeripherals = true;

mmu_armv81.size  = 0x20000000;
mmu_armv81.$name = "REGISTER_REGION_0";

mmu_armv82.vAddr = 0x20000000;
mmu_armv82.pAddr = 0x20000000;
mmu_armv82.size  = 0x20000000;
mmu_armv82.$name = "REGISTER_REGION_1";

mmu_armv83.vAddr = 0x40000000;
mmu_armv83.pAddr = 0x40000000;
mmu_armv83.size  = 0x20000000;
mmu_armv83.$name = "REGISTER_REGION_2";

mmu_armv84.vAddr = 0x60000000;
mmu_armv84.pAddr = 0x60000000;
mmu_armv84.size  = 0x10000000;
mmu_armv84.$name = "FSS0_DAT_REGION";

mmu_armv85.vAddr = 0x7C200000;
mmu_armv85.pAddr = 0x7C200000;
mmu_armv85.$name = "CLEC";
mmu_armv85.size  = 0x100000;

mmu_armv86.$name = "DRU";
mmu_armv86.vAddr = 0x7C400000;
mmu_armv86.pAddr = 0x7C400000;
mmu_armv86.size  = 0x100000;

mmu_armv87.vAddr     = 0x80000000;
mmu_armv87.pAddr     = 0x80000000;
mmu_armv87.size      = 0x20000000;
mmu_armv87.attribute = "MAIR7";
mmu_armv87.$name     = "DDR_0";

mmu_armv88.vAddr     = 0xA0000000;
mmu_armv88.pAddr     = 0xA0000000;
mmu_armv88.size      = 0x20000000;
mmu_armv88.attribute = "MAIR7";
mmu_armv88.$name     = "DDR_1";

mmu_armv89.vAddr     = 0xAA000000;
mmu_armv89.pAddr     = 0xAA000000;
mmu_armv89.size      = 0x2000000;
mmu_armv89.attribute = "MAIR4";
mmu_armv89.$name     = "DDR_2";

mmu_armv810.$name       = "MCASP";
mmu_armv810.vAddr       = 0x2B10000;
mmu_armv810.pAddr       = 0x2B10000;
mmu_armv810.size        = 0x2000000;
mmu_armv810.privExecute = false;

mmu_armv811.$name     = "CCS_DEBUG_LOG_MEM";
mmu_armv811.vAddr     = 0x99C10000;
mmu_armv811.pAddr     = 0x99C10000;
mmu_armv811.size      = 0x1000;
mmu_armv811.attribute = "MAIR4";

/**
 * Pinmux solution for unlocked pins/peripherals. This ensures that minor changes to the automatic solver in a future
 * version of the tool will not impact the pinmux you originally saw.  These lines can be completely deleted in order to
 * re-solve from scratch.
 */
mcasp2.mcaspSer[0].MCASP.AXR0.$suggestSolution  = "GPMC0_AD8";
debug_log.uartLog.MCU_UART.$suggestSolution     = "MCU_USART0";
debug_log.uartLog.MCU_UART.RXD.$suggestSolution = "MCU_UART0_RXD";
debug_log.uartLog.MCU_UART.TXD.$suggestSolution = "MCU_UART0_TXD";
