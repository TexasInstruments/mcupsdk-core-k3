/**
 * @cliArgs --device "AM62Dx" --part "AM62D24-G" --package "ANF" --context "a53ss0-0" --product "MCU_PLUS_SDK@07.03.01"
 * @versions {"tool":"1.26.2+4477"}
 */

/**
 * Import the modules used in this configuration.
 */
const gpio       = scripting.addModule("/drivers/gpio/gpio", {}, false);
const gpio1      = gpio.addInstance();
const mcasp      = scripting.addModule("/drivers/mcasp/mcasp", {}, false);
const mcasp1     = mcasp.addInstance();
const debug_log  = scripting.addModule("/kernel/dpl/debug_log");
const mmu_armv8  = scripting.addModule("/kernel/dpl/mmu_armv8", {}, false);
const mmu_armv81 = mmu_armv8.addInstance();
const mmu_armv82 = mmu_armv8.addInstance();
const mmu_armv83 = mmu_armv8.addInstance();

/**
 * Write custom configuration values to the imported modules.
 */
gpio1.$name        = "CONFIG_GPIO0";
gpio1.pinDir       = "OUTPUT";
gpio1.GPIO.$assign = "GPMC0_WAIT0";

mcasp1.$name                                   = "CONFIG_MCASP0";
mcasp1.txDataMask                              = 0xFFFFFFFF;
mcasp1.txCallbackFxn                           = "mcasp_txcb";
mcasp1.rxDataMask                              = 0xFFFFFFFF;
mcasp1.rxCallbackFxn                           = "mcasp_rxcb";
mcasp1.enableLoopback                          = false;
mcasp1.RxMode                                  = "TDM";
mcasp1.clkSyncMode                             = "ASYNC";
mcasp1.rxFsWidth                               = 0;
mcasp1.rxActiveSlotMask                        = 0x3;
mcasp1.rxFsPolarity                            = 0;
mcasp1.txActiveSlotMask                        = 0x3;
mcasp1.rxBitClkPolarity                        = 0;
mcasp1.txHclkSourceMux                         = 3;
mcasp1.rxHclkSource                            = 0;
mcasp1.rxHclkSourceMux                         = 3;
mcasp1.txLoopjobBufLength                      = 2048;
mcasp1.rxLoopjobBufLength                      = 2048;
mcasp1.txHclkExpected                          = 24576000;
mcasp1.rxHclkExpected                          = 24576000;
mcasp1.rxHclkDiv                               = 1;
mcasp1.rxClkDiv                                = 2;
mcasp1.rxBclkCalculated                        = 12288000;
mcasp1.rxFsyncCalculated                       = 48000;
mcasp1.rxClkApplyAlert                         = false;
mcasp1.txClkApplyAlert                         = false;
mcasp1.MCASP.$assignAllowConflicts             = "MCASP1";
mcasp1.mcaspSer.create(2);
mcasp1.mcaspSer[0].$name                       = "CONFIG_MCASP_SER0";
mcasp1.mcaspSer[0].MCASP.$assignAllowConflicts = "MCASP1";
mcasp1.mcaspSer[0].MCASP.AXR0.$assign          = "MMC2_DAT0";
mcasp1.mcaspSer[1].$name                       = "CONFIG_MCASP_SER1";
mcasp1.mcaspSer[1].dataDir                     = "Receive";
mcasp1.mcaspSer[1].serNum                      = 1;
mcasp1.mcaspSer[1].MCASP.$assignAllowConflicts = "MCASP1";
mcasp1.mcaspSer[1].MCASP.AXR1.$assign          = "MMC2_DAT1";
scripting.suppress("Resource conflict,MCASP1 is also in use by @@@.+?@@@, @@@.+?@@@", mcasp1.MCASP, "$assign");
scripting.suppress("Resource conflict,MCASP1 is also in use by @@@.+?@@@, @@@.+?@@@", mcasp1.mcaspSer[0].MCASP, "$assign");
scripting.suppress("Resource conflict,MCASP1 is also in use by @@@.+?@@@, @@@.+?@@@", mcasp1.mcaspSer[1].MCASP, "$assign");

const udma         = scripting.addModule("/drivers/udma/udma", {}, false);
const udma1        = udma.addInstance({}, false);
udma1.$name        = "CONFIG_UDMA0";
mcasp1.bcDmaDriver = udma1;

debug_log.enableUartLog        = true;
debug_log.uartLog.$name        = "CONFIG_UART_CONSOLE";
debug_log.uartLog.UART.$assign = "USART0";

mmu_armv81.size  = 0x80000000;
mmu_armv81.$name = "SOC_MEM_REGION";

mmu_armv82.vAddr     = 0x70000000;
mmu_armv82.pAddr     = 0x70000000;
mmu_armv82.size      = 0x200000;
mmu_armv82.attribute = "MAIR7";
mmu_armv82.$name     = "SHM_MEM_REGION";

mmu_armv83.vAddr     = 0x80000000;
mmu_armv83.pAddr     = 0x80000000;
mmu_armv83.size      = 0x80000000;
mmu_armv83.attribute = "MAIR7";
mmu_armv83.$name     = "DDR_REGION";

/**
 * Pinmux solution for unlocked pins/peripherals. This ensures that minor changes to the automatic solver in a future
 * version of the tool will not impact the pinmux you originally saw.  These lines can be completely deleted in order to
 * re-solve from scratch.
 */
mcasp1.MCASP.AFSX.$suggestSolution               = "MMC2_SDWP";
mcasp1.MCASP.ACLKX.$suggestSolution              = "MMC2_SDCD";
mcasp1.MCASP.AFSR.$suggestSolution               = "MMC2_CMD";
mcasp1.MCASP.ACLKR.$suggestSolution              = "MMC2_CLK";
mcasp1.SYSTEM.$suggestSolution                   = "SYSTEM0";
mcasp1.SYSTEM.AUDIO_EXT_REFCLK1.$suggestSolution = "GPMC0_WPn";
debug_log.uartLog.UART.RXD.$suggestSolution      = "UART0_RXD";
debug_log.uartLog.UART.TXD.$suggestSolution      = "UART0_TXD";
