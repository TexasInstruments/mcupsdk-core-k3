/**
 * @cliArgs --device "AM62Ax" --package "AMB" --part "Default" --context "c75ss0-0" --product "MCU_PLUS_SDK@07.03.01"
 * @versions {"tool":"1.16.1+2960"}
 */

/**
 * Import the modules used in this configuration.
 */
const mcasp      = scripting.addModule("/drivers/mcasp/mcasp", {}, false);
const mcasp1     = mcasp.addInstance();
const udma       = scripting.addModule("/drivers/udma/udma", {}, false);
const udma1      = udma.addInstance();
const clock      = scripting.addModule("/kernel/dpl/clock");
const debug_log  = scripting.addModule("/kernel/dpl/debug_log");
const mmu_armv8  = scripting.addModule("/kernel/dpl/mmu_armv8", {}, false);
const mmu_armv81 = mmu_armv8.addInstance();
const mmu_armv82 = mmu_armv8.addInstance();
const mmu_armv83 = mmu_armv8.addInstance();
const mmu_armv84 = mmu_armv8.addInstance();
const mmu_armv85 = mmu_armv8.addInstance();
const mmu_armv86 = mmu_armv8.addInstance();
const mmu_armv87 = mmu_armv8.addInstance();
const mmu_armv88 = mmu_armv8.addInstance();
const mmu_armv89 = mmu_armv8.addInstance();

/**
 * Write custom configuration values to the imported modules.
 */
mcasp1.$name                                   = "CONFIG_MCASP0";
mcasp1.txCallbackFxn                           = "mcasp_loopback_txcb";
mcasp1.rxCallbackFxn                           = "mcasp_loopback_rxcb";
mcasp1.txDataMask                              = 0xFFFFFFFF;
mcasp1.rxDataMask                              = 0xFFFFFFFF;
mcasp1.txActiveSlotMask                        = 0x3;
mcasp1.rxActiveSlotMask                        = 0x3;
mcasp1.masterClkx                              = 128;
mcasp1.masterClkr                              = 128;
mcasp1.fsx                                     = 48;
mcasp1.fsr                                     = 48;
mcasp1.MCASP.$assignAllowConflicts             = "MCASP1";
mcasp1.mcaspSer.create(2);
mcasp1.mcaspSer[0].$name                       = "CONFIG_MCASP_SER0";
mcasp1.mcaspSer[0].MCASP.$assignAllowConflicts = "MCASP1";
mcasp1.mcaspSer[1].$name                       = "CONFIG_MCASP_SER1";
mcasp1.mcaspSer[1].serNum                      = 1;
mcasp1.mcaspSer[1].dataDir                     = "Receive";
mcasp1.mcaspSer[1].MCASP.$assignAllowConflicts = "MCASP1";
scripting.suppress("Resource conflict,MCASP1 is also in use by @@@.+?@@@, @@@.+?@@@", mcasp1.MCASP, "$assign");
scripting.suppress("Resource conflict,MCASP1 is also in use by @@@.+?@@@, @@@.+?@@@", mcasp1.mcaspSer[0].MCASP, "$assign");
scripting.suppress("Resource conflict,MCASP1 is also in use by @@@.+?@@@, @@@.+?@@@", mcasp1.mcaspSer[1].MCASP, "$assign");

udma1.$name                         = "CONFIG_UDMA0";
udma1.parentName                    = "MCASP";
mcasp1.udmaDriver                   = udma1;
udma1.udmaBlkCopyChannel[0].$name   = "CONFIG_UDMA_BLKCOPY_CH0";
udma1.udmaBlkCopyChannel[0].elemCnt = 4;
udma1.udmaBlkCopyChannel[1].$name   = "CONFIG_UDMA_BLKCOPY_CH1";
udma1.udmaBlkCopyChannel[1].elemCnt = 4;

debug_log.enableCssLog         = false;
debug_log.enableUartLog        = true;
debug_log.uartLog.$name        = "CONFIG_UART0";
debug_log.uartLog.UART.$assign = "USART0";

mmu_armv81.size  = 0x20000000;
mmu_armv81.$name = "REGISTER_REGION_0";

mmu_armv82.vAddr = 0x20000000;
mmu_armv82.pAddr = 0x20000000;
mmu_armv82.size  = 0x20000000;
mmu_armv82.$name = "REGISTER_REGION_1";

mmu_armv83.vAddr = 0x40000000;
mmu_armv83.pAddr = 0x40000000;
mmu_armv83.size  = 0x20000000;
mmu_armv83.$name = "REGISTER_REGION_2";

mmu_armv84.vAddr = 0x60000000;
mmu_armv84.pAddr = 0x60000000;
mmu_armv84.size  = 0x10000000;
mmu_armv84.$name = "REGISTER_REGION_3";

mmu_armv85.vAddr = 0x7C200000;
mmu_armv85.pAddr = 0x7C200000;
mmu_armv85.$name = "CLEC";
mmu_armv85.size  = 0x100000;

mmu_armv86.$name = "DRU";
mmu_armv86.vAddr = 0x7C400000;
mmu_armv86.pAddr = 0x7C400000;
mmu_armv86.size  = 0x100000;

mmu_armv87.vAddr     = 0x80000000;
mmu_armv87.pAddr     = 0x80000000;
mmu_armv87.size      = 0x20000000;
mmu_armv87.attribute = "MAIR7";
mmu_armv87.$name     = "DDR_0";

mmu_armv88.vAddr     = 0xA0000000;
mmu_armv88.pAddr     = 0xA0000000;
mmu_armv88.size      = 0x20000000;
mmu_armv88.attribute = "MAIR7";
mmu_armv88.$name     = "DDR_1";

mmu_armv89.size  = 0x2000000;
mmu_armv89.$name = "MCASP";
mmu_armv89.vAddr = 0x2B00000;
mmu_armv89.pAddr = 0x2B00000;

/**
 * Pinmux solution for unlocked pins/peripherals. This ensures that minor changes to the automatic solver in a future
 * version of the tool will not impact the pinmux you originally saw.  These lines can be completely deleted in order to
 * re-solve from scratch.
 */
mcasp1.MCASP.AFSX.$suggestSolution             = "GPMC0_WAIT0";
mcasp1.MCASP.ACLKX.$suggestSolution            = "GPMC0_BE0n_CLE";
mcasp1.MCASP.AFSR.$suggestSolution             = "GPMC0_CSn2";
mcasp1.MCASP.ACLKR.$suggestSolution            = "GPMC0_CSn3";
mcasp1.mcaspSer[0].MCASP.AXR0.$suggestSolution = "GPMC0_WEn";
mcasp1.mcaspSer[1].MCASP.AXR1.$suggestSolution = "GPMC0_OEn_REn";
debug_log.uartLog.UART.RXD.$suggestSolution    = "UART0_RXD";
debug_log.uartLog.UART.TXD.$suggestSolution    = "UART0_TXD";
