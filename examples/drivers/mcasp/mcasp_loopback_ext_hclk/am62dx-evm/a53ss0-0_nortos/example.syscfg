/**
 * @cliArgs --device "AM62Dx" --package "AMB" --part "Default" --context "a53ss0-0" --product "MCU_PLUS_SDK@07.03.01"
 * @versions {"tool":"1.19.0+3426"}
 */

/**
 * Import the modules used in this configuration.
 */
const mcasp      = scripting.addModule("/drivers/mcasp/mcasp", {}, false);
const mcasp1     = mcasp.addInstance();
const debug_log  = scripting.addModule("/kernel/dpl/debug_log");
const mmu_armv8  = scripting.addModule("/kernel/dpl/mmu_armv8", {}, false);
const mmu_armv81 = mmu_armv8.addInstance();
const mmu_armv82 = mmu_armv8.addInstance();

/**
 * Write custom configuration values to the imported modules.
 */
mcasp1.$name                                   = "CONFIG_MCASP0";
mcasp1.txDataMask                              = 0xFFFFFFFF;
mcasp1.txActiveSlotMask                        = 0x3;
mcasp1.rxDataMask                              = 0xFFFFFFFF;
mcasp1.rxActiveSlotMask                        = 0x3;
mcasp1.txCallbackFxn                           = "mcasp_loopback_txcb";
mcasp1.rxCallbackFxn                           = "mcasp_loopback_rxcb";
mcasp1.txHclkSource                            = 0;
mcasp1.txHclkSourceMux                         = 2;
mcasp1.rxHclkSource                            = 0;
mcasp1.rxHclkSourceMux                         = 2;
mcasp1.MCASP.$assignAllowConflicts             = "MCASP0";
mcasp1.SYSTEM.AUDIO_EXT_REFCLK0.$assign        = "UART0_CTSn";
mcasp1.mcaspSer.create(2);
mcasp1.mcaspSer[0].$name                       = "CONFIG_MCASP_SER0";
mcasp1.mcaspSer[0].MCASP.$assignAllowConflicts = "MCASP0";
mcasp1.mcaspSer[1].$name                       = "CONFIG_MCASP_SER1";
mcasp1.mcaspSer[1].dataDir                     = "Receive";
mcasp1.mcaspSer[1].serNum                      = 1;
mcasp1.mcaspSer[1].MCASP.$assignAllowConflicts = "MCASP0";
scripting.suppress("Resource conflict,MCASP0 is also in use by @@@.+?@@@, @@@.+?@@@", mcasp1.MCASP, "$assign");
scripting.suppress("Resource conflict,MCASP0 is also in use by @@@.+?@@@, @@@.+?@@@", mcasp1.mcaspSer[0].MCASP, "$assign");
scripting.suppress("Resource conflict,MCASP0 is also in use by @@@.+?@@@, @@@.+?@@@", mcasp1.mcaspSer[1].MCASP, "$assign");

const udma         = scripting.addModule("/drivers/udma/udma", {}, false);
const udma1        = udma.addInstance({}, false);
udma1.$name        = "CONFIG_UDMA0";
mcasp1.bcDmaDriver = udma1;

const udma2         = udma.addInstance({}, false);
udma2.$name         = "CONFIG_UDMA1";
mcasp1.pktDmaDriver = udma2;

debug_log.enableUartLog = true;
debug_log.uartLog.$name = "CONFIG_UART0";

mmu_armv81.$name = "SOC_MEM_REGION";
mmu_armv81.size  = 0x80000000;

mmu_armv82.$name     = "DDR_REGION";
mmu_armv82.vAddr     = 0x80000000;
mmu_armv82.pAddr     = 0x80000000;
mmu_armv82.size      = 0x80000000;
mmu_armv82.attribute = "MAIR7";

/**
 * Pinmux solution for unlocked pins/peripherals. This ensures that minor changes to the automatic solver in a future
 * version of the tool will not impact the pinmux you originally saw.  These lines can be completely deleted in order to
 * re-solve from scratch.
 */
mcasp1.MCASP.AFSX.$suggestSolution             = "MCASP0_AFSX";
mcasp1.MCASP.ACLKX.$suggestSolution            = "MCASP0_ACLKX";
mcasp1.MCASP.AFSR.$suggestSolution             = "MCASP0_AFSR";
mcasp1.MCASP.ACLKR.$suggestSolution            = "MCASP0_ACLKR";
mcasp1.SYSTEM.$suggestSolution                 = "SYSTEM0";
mcasp1.mcaspSer[0].MCASP.AXR0.$suggestSolution = "MCASP0_AXR0";
mcasp1.mcaspSer[1].MCASP.AXR1.$suggestSolution = "MCASP0_AXR1";
debug_log.uartLog.UART.$suggestSolution        = "USART0";
debug_log.uartLog.UART.RXD.$suggestSolution    = "UART0_RXD";
debug_log.uartLog.UART.TXD.$suggestSolution    = "UART0_TXD";
