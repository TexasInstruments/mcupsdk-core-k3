/**
 * @cliArgs --device "AM275x" --part "AM2754" --package "ANJ" --context "c75ss0-0" --product "MCU_PLUS_SDK@07.03.01"
 * @versions {"tool":"1.24.0+4150"}
 */

/**
 * Import the modules used in this configuration.
 */
const uart          = scripting.addModule("/drivers/uart/uart", {}, false);
const uart1         = uart.addInstance();
const freertos_fat  = scripting.addModule("/fs/freertos_fat/freertos_fat", {}, false);
const freertos_fat1 = freertos_fat.addInstance();
const debug_log     = scripting.addModule("/kernel/dpl/debug_log");
const mmu_armv8     = scripting.addModule("/kernel/dpl/mmu_armv8", {}, false);
const mmu_armv81    = mmu_armv8.addInstance();
const mmu_armv82    = mmu_armv8.addInstance();
const mmu_armv83    = mmu_armv8.addInstance();
const mmu_armv84    = mmu_armv8.addInstance();
const mmu_armv85    = mmu_armv8.addInstance();
const mmu_armv86    = mmu_armv8.addInstance();
const mmu_armv87    = mmu_armv8.addInstance();
const mmu_armv88    = mmu_armv8.addInstance();
const mmu_armv89    = mmu_armv8.addInstance();
const mmu_armv810   = mmu_armv8.addInstance();
const mmu_armv811   = mmu_armv8.addInstance();
const mmu_armv812   = mmu_armv8.addInstance();

/**
 * Write custom configuration values to the imported modules.
 */
uart1.$name        = "CONFIG_UART0";
uart1.UART.$assign = "UART3";

freertos_fat1.$name                                 = "CONFIG_FREERTOS_FAT0";
freertos_fat1.peripheralDriver.$name                = "CONFIG_MMCSD0";
freertos_fat1.peripheralDriver.cardType             = "SD";
freertos_fat1.peripheralDriver.MMC.MMC_CLK.$assign  = "MMC0_CLK";
freertos_fat1.peripheralDriver.MMC.MMC_CMD.$assign  = "MMC0_CMD";
freertos_fat1.peripheralDriver.MMC.MMC_DAT0.$assign = "MMC0_DAT0";
freertos_fat1.peripheralDriver.MMC.MMC_DAT1.$assign = "MMC0_DAT1";
freertos_fat1.peripheralDriver.MMC.MMC_DAT2.$assign = "MMC0_DAT2";
freertos_fat1.peripheralDriver.MMC.MMC_DAT3.$assign = "MMC0_DAT3";
freertos_fat1.peripheralDriver.MMC.MMC_DAT4.$assign = "MMC0_DAT4";
freertos_fat1.peripheralDriver.MMC.MMC_DAT6.$assign = "MMC0_DAT6";
freertos_fat1.peripheralDriver.MMC.MMC_DAT7.$assign = "MMC0_DAT7";

debug_log.enableUartLog = true;
debug_log.uartLog.$name = "CONFIG_UART1";

mmu_armv81.size  = 0x20000000;
mmu_armv81.$name = "REGISTERS_REGION0";

mmu_armv82.vAddr = 0x20000000;
mmu_armv82.pAddr = 0x20000000;
mmu_armv82.size  = 0x20000000;
mmu_armv82.$name = "REGISTERS_REGION1";

mmu_armv83.vAddr = 0x40000000;
mmu_armv83.pAddr = 0x40000000;
mmu_armv83.size  = 0x20000000;
mmu_armv83.$name = "REGISTERS_REGION2";

mmu_armv84.vAddr = 0x60000000;
mmu_armv84.pAddr = 0x60000000;
mmu_armv84.size  = 0x10000000;
mmu_armv84.$name = "REGISTERS_REGION3";

mmu_armv85.vAddr = 0x7C200000;
mmu_armv85.pAddr = 0x7C200000;
mmu_armv85.$name = "CLEC";
mmu_armv85.size  = 0x100000;

mmu_armv86.$name = "DRU";
mmu_armv86.vAddr = 0x7C400000;
mmu_armv86.pAddr = 0x7C400000;
mmu_armv86.size  = 0x300000;

mmu_armv87.$name     = "L2SRAM";
mmu_armv87.vAddr     = 0x7E000000;
mmu_armv87.pAddr     = 0x7E000000;
mmu_armv87.attribute = "MAIR7";
mmu_armv87.size      = 0x200000;

mmu_armv88.$name     = "L2SRAM_AUX";
mmu_armv88.vAddr     = 0x7E200000;
mmu_armv88.pAddr     = 0x7E200000;
mmu_armv88.size      = 0x40000;
mmu_armv88.attribute = "MAIR7";

mmu_armv89.attribute = "MAIR7";
mmu_armv89.$name     = "MSRAM_BANK0_TO_BANK3";
mmu_armv89.vAddr     = 0x80000000;
mmu_armv89.size      = 0x400000;
mmu_armv89.pAddr     = 0x72000000;

mmu_armv810.$name     = "MSRAM_BANK4_TO_BANK5";
mmu_armv810.size      = 0x200000;
mmu_armv810.attribute = "MAIR7";
mmu_armv810.vAddr     = 0x80400000;
mmu_armv810.pAddr     = 0x72400000;

mmu_armv811.$name = "CONFIG_MMU_REGION0_MMCSD";
mmu_armv811.vAddr = 0xFA00000;
mmu_armv811.pAddr = 0xFA00000;
mmu_armv811.size  = 0x1000;

mmu_armv812.size      = 0x1000;
mmu_armv812.attribute = "MAIR4";
mmu_armv812.pAddr     = 0x8027F000;
mmu_armv812.vAddr     = 0x8027F000;
mmu_armv812.$name     = "CCS_DEBUG_LOG_MEM";

/**
 * Pinmux solution for unlocked pins/peripherals. This ensures that minor changes to the automatic solver in a future
 * version of the tool will not impact the pinmux you originally saw.  These lines can be completely deleted in order to
 * re-solve from scratch.
 */
uart1.UART.RXD.$suggestSolution                              = "MCASP0_AXR8";
uart1.UART.TXD.$suggestSolution                              = "GPIO1_47";
freertos_fat1.peripheralDriver.MMC.$suggestSolution          = "MMC0";
freertos_fat1.peripheralDriver.MMC.MMC_DAT5.$suggestSolution = "MMC0_DAT5";
debug_log.uartLog.UART.$suggestSolution                      = "UART0";
debug_log.uartLog.UART.RXD.$suggestSolution                  = "MCASP4_AXR0";
debug_log.uartLog.UART.TXD.$suggestSolution                  = "MLB0_MLBCLK";
