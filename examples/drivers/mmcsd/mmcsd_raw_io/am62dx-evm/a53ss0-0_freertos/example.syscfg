/**
 * @cliArgs --device "AM62Ax" --package "AMB" --part "Default" --context "a53ss0-0" --product "MCU_PLUS_SDK@07.03.01"
 * @versions {"tool":"1.18.0+3266"}
 */

/**
 * Import the modules used in this configuration.
 */
const mmcsd      = scripting.addModule("/drivers/mmcsd/mmcsd", {}, false);
const mmcsd1     = mmcsd.addInstance();
const clock      = scripting.addModule("/kernel/dpl/clock");
const debug_log  = scripting.addModule("/kernel/dpl/debug_log");
const mmu_armv8  = scripting.addModule("/kernel/dpl/mmu_armv8", {}, false);
const mmu_armv81 = mmu_armv8.addInstance();
const mmu_armv82 = mmu_armv8.addInstance();

/**
 * Write custom configuration values to the imported modules.
 */
mmcsd1.$name = "CONFIG_MMCSD0";

debug_log.enableUartLog = true;
debug_log.enableCssLog  = false;
debug_log.uartLog.$name = "CONFIG_UART0";

mmu_armv81.size  = 0x80000000;
mmu_armv81.$name = "SOC_MEM_REGION";

mmu_armv82.$name     = "DDR_MEM_REGION";
mmu_armv82.vAddr     = 0x80000000;
mmu_armv82.pAddr     = 0x80000000;
mmu_armv82.size      = 0x80000000;
mmu_armv82.attribute = "MAIR7";

/**
 * Pinmux solution for unlocked pins/peripherals. This ensures that minor changes to the automatic solver in a future
 * version of the tool will not impact the pinmux you originally saw.  These lines can be completely deleted in order to
 * re-solve from scratch.
 */
mmcsd1.MMC0.$suggestSolution                = "MMC0";
mmcsd1.MMC0.CLK.$suggestSolution            = "MMC0_CLK";
mmcsd1.MMC0.CMD.$suggestSolution            = "MMC0_CMD";
mmcsd1.MMC0.DAT0.$suggestSolution           = "MMC0_DAT0";
mmcsd1.MMC0.DAT1.$suggestSolution           = "MMC0_DAT1";
mmcsd1.MMC0.DAT2.$suggestSolution           = "MMC0_DAT2";
mmcsd1.MMC0.DAT3.$suggestSolution           = "MMC0_DAT3";
mmcsd1.MMC0.DAT4.$suggestSolution           = "MMC0_DAT4";
mmcsd1.MMC0.DAT5.$suggestSolution           = "MMC0_DAT5";
mmcsd1.MMC0.DAT6.$suggestSolution           = "MMC0_DAT6";
mmcsd1.MMC0.DAT7.$suggestSolution           = "MMC0_DAT7";
debug_log.uartLog.UART.$suggestSolution     = "USART0";
debug_log.uartLog.UART.RXD.$suggestSolution = "UART0_RXD";
debug_log.uartLog.UART.TXD.$suggestSolution = "UART0_TXD";
