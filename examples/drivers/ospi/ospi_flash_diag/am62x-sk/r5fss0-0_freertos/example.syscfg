/**
 * @cliArgs --device "AM62x" --package "ALW" --part "Default" --context "r5fss0-0" --product "MCU_PLUS_SDK@07.03.01"
 * @versions {"tool":"1.20.0+3587"}
 */

/**
 * Import the modules used in this configuration.
 */
const ospi        = scripting.addModule("/drivers/ospi/ospi", {}, false);
const ospi1       = ospi.addInstance();
const clock       = scripting.addModule("/kernel/dpl/clock");
const debug_log   = scripting.addModule("/kernel/dpl/debug_log");
const mpu_armv7   = scripting.addModule("/kernel/dpl/mpu_armv7", {}, false);
const mpu_armv71  = mpu_armv7.addInstance();
const mpu_armv72  = mpu_armv7.addInstance();
const mpu_armv73  = mpu_armv7.addInstance();
const mpu_armv74  = mpu_armv7.addInstance();
const mpu_armv75  = mpu_armv7.addInstance();
const mpu_armv76  = mpu_armv7.addInstance();
const mpu_armv77  = mpu_armv7.addInstance();
const mpu_armv78  = mpu_armv7.addInstance();
const mpu_armv79  = mpu_armv7.addInstance();
const mpu_armv710 = mpu_armv7.addInstance();

/**
 * Write custom configuration values to the imported modules.
 */
ospi1.$name = "CONFIG_OSPI0";

clock.instance = "TIMER1";

debug_log.enableUartLog = true;
debug_log.uartTrace     = true;
debug_log.uartLog.$name = "CONFIG_UART0";

mpu_armv71.accessPermissions = "Supervisor RD+WR, User RD";
mpu_armv71.allowExecute      = false;
mpu_armv71.size              = 31;
mpu_armv71.attributes        = "Device";
mpu_armv71.$name             = "REGISTER_REGION";

mpu_armv72.accessPermissions = "Supervisor RD+WR, User RD";
mpu_armv72.size              = 7;
mpu_armv72.$name             = "TCMA_VEC";

mpu_armv73.$name             = "CONFIG_MPU_REGION2";
mpu_armv73.accessPermissions = "Supervisor RD+WR, User RD";
mpu_armv73.baseAddr          = 0x41C00000;
mpu_armv73.size              = 19;

mpu_armv74.$name             = "CONFIG_MPU_REGION3";
mpu_armv74.accessPermissions = "Supervisor RD+WR, User RD";
mpu_armv74.baseAddr          = 0x70000000;
mpu_armv74.size              = 16;

mpu_armv75.$name    = "DDR";
mpu_armv75.baseAddr = 0x90000000;
mpu_armv75.size     = 28;

mpu_armv76.baseAddr   = 0x41010000;
mpu_armv76.size       = 15;
mpu_armv76.attributes = "NonCached";
mpu_armv76.$name      = "TCMB";

mpu_armv77.size       = 15;
mpu_armv77.attributes = "NonCached";
mpu_armv77.$name      = "TCMA";

mpu_armv78.baseAddr = 0x43C00000;
mpu_armv78.size     = 18;
mpu_armv78.$name    = "HSM_RAM";

mpu_armv79.$name        = "CONFIG_MPU_REGION7";
mpu_armv79.baseAddr     = 0xFC40000;
mpu_armv79.size         = 8;
mpu_armv79.allowExecute = false;
mpu_armv79.attributes   = "Device";

mpu_armv710.$name        = "CONFIG_MPU_REGION9";
mpu_armv710.baseAddr     = 0x60000000;
mpu_armv710.attributes   = "Device";
mpu_armv710.allowExecute = false;
mpu_armv710.size         = 7;

/**
 * Pinmux solution for unlocked pins/peripherals. This ensures that minor changes to the automatic solver in a future
 * version of the tool will not impact the pinmux you originally saw.  These lines can be completely deleted in order to
 * re-solve from scratch.
 */
ospi1.OSPI.$suggestSolution                      = "OSPI0";
ospi1.OSPI.CLK.$suggestSolution                  = "OSPI0_CLK";
ospi1.OSPI.CSn0.$suggestSolution                 = "OSPI0_CSn0";
ospi1.OSPI.DQS.$suggestSolution                  = "OSPI0_DQS";
ospi1.OSPI.D7.$suggestSolution                   = "OSPI0_D7";
ospi1.OSPI.D6.$suggestSolution                   = "OSPI0_D6";
ospi1.OSPI.D5.$suggestSolution                   = "OSPI0_D5";
ospi1.OSPI.D4.$suggestSolution                   = "OSPI0_D4";
ospi1.OSPI.D3.$suggestSolution                   = "OSPI0_D3";
ospi1.OSPI.D2.$suggestSolution                   = "OSPI0_D2";
ospi1.OSPI.D1.$suggestSolution                   = "OSPI0_D1";
ospi1.OSPI.D0.$suggestSolution                   = "OSPI0_D0";
debug_log.uartLog.WKUP_UART.$suggestSolution     = "WKUP_USART0";
debug_log.uartLog.WKUP_UART.RXD.$suggestSolution = "WKUP_UART0_RXD";
debug_log.uartLog.WKUP_UART.TXD.$suggestSolution = "WKUP_UART0_TXD";
