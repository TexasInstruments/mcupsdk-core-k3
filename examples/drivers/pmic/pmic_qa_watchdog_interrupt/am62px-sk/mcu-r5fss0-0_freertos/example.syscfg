/**
 * @cliArgs --device "AM62Px" --package "AMH" --part "Default" --context "mcu-r5fss0-0" --product "MCU_PLUS_SDK@07.03.01"
 * @versions {"tool":"1.20.0+3587"}
 */

/**
 * Import the modules used in this configuration.
 */
const pmic       = scripting.addModule("/board/pmic/pmic", {}, false);
const pmic1      = pmic.addInstance();
const gpio       = scripting.addModule("/drivers/gpio/gpio", {}, false);
const gpio1      = gpio.addInstance();
const i2c        = scripting.addModule("/drivers/i2c/i2c", {}, false);
const i2c1       = i2c.addInstance();
const debug_log  = scripting.addModule("/kernel/dpl/debug_log");
const mpu_armv7  = scripting.addModule("/kernel/dpl/mpu_armv7", {}, false);
const mpu_armv71 = mpu_armv7.addInstance();
const mpu_armv72 = mpu_armv7.addInstance();
const mpu_armv73 = mpu_armv7.addInstance();
const mpu_armv74 = mpu_armv7.addInstance();
const mpu_armv75 = mpu_armv7.addInstance();

/**
 * Write custom configuration values to the imported modules.
 */
pmic1.$name       = "CONFIG_PMIC0";
pmic1.qaI2CEnable = true;
pmic1.wdogEnable  = true;
pmic1.wdogMode    = "qaMode";

gpio1.trigType = "FALL_EDGE";
gpio1.$name    = "GPIO_WDOG_INT";

pmic1.mainPeripheralDriver      = i2c1;
i2c1.useWakeupDomainPeripherals = true;

const i2c2                       = i2c.addInstance({}, false);
pmic1.QaWatchdogPeripheralDriver = i2c2;

debug_log.enableUartLog = true;
debug_log.uartLog.$name = "CONFIG_UART0";

mpu_armv71.size              = 31;
mpu_armv71.attributes        = "Device";
mpu_armv71.accessPermissions = "Supervisor RD+WR, User RD";
mpu_armv71.allowExecute      = false;
mpu_armv71.$name             = "CONFIG_MPU_REGISTER";

mpu_armv72.size              = 15;
mpu_armv72.accessPermissions = "Supervisor RD+WR, User RD";
mpu_armv72.$name             = "CONFIG_MPU_TCMA";

mpu_armv73.baseAddr          = 0x41010000;
mpu_armv73.size              = 15;
mpu_armv73.accessPermissions = "Supervisor RD+WR, User RD";
mpu_armv73.$name             = "CONFIG_MPU_TCMB";

mpu_armv74.accessPermissions = "Supervisor RD+WR, User RD";
mpu_armv74.baseAddr          = 0x79100000;
mpu_armv74.size              = 19;
mpu_armv74.$name             = "CONFIG_MPU_MCU_MSRAM";

mpu_armv75.baseAddr = 0x80000000;
mpu_armv75.size     = 31;
mpu_armv75.$name    = "CONFIG_MPU_DDR";

/**
 * Pinmux solution for unlocked pins/peripherals. This ensures that minor changes to the automatic solver in a future
 * version of the tool will not impact the pinmux you originally saw.  These lines can be completely deleted in order to
 * re-solve from scratch.
 */
gpio1.MCU_GPIO.$suggestSolution                 = "MCU_GPIO0";
gpio1.MCU_GPIO.gpioPin.$suggestSolution         = "MCU_SPI0_CS0";
i2c1.WKUP_I2C.$suggestSolution                  = "WKUP_I2C0";
i2c1.WKUP_I2C.SCL.$suggestSolution              = "WKUP_I2C0_SCL";
i2c1.WKUP_I2C.SDA.$suggestSolution              = "WKUP_I2C0_SDA";
i2c2.MCU_I2C.$suggestSolution                   = "MCU_I2C0";
i2c2.MCU_I2C.SCL.$suggestSolution               = "MCU_I2C0_SCL";
i2c2.MCU_I2C.SDA.$suggestSolution               = "MCU_I2C0_SDA";
debug_log.uartLog.MCU_UART.$suggestSolution     = "MCU_USART0";
debug_log.uartLog.MCU_UART.RXD.$suggestSolution = "MCU_UART0_RXD";
debug_log.uartLog.MCU_UART.TXD.$suggestSolution = "MCU_UART0_TXD";
