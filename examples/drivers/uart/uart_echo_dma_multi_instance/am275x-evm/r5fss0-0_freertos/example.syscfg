/**
 * @cliArgs --device "AM275x" --part "AM2754" --package "ANJ" --context "r5fss0-0" --product "MCU_PLUS_SDK@07.03.01"
 * @versions {"tool":"1.24.0+4150"}
 */

/**
 * Import the modules used in this configuration.
 */
const uart       = scripting.addModule("/drivers/uart/uart", {}, false);
const uart1      = uart.addInstance();
const uart2      = uart.addInstance();
const udma       = scripting.addModule("/drivers/udma/udma", {}, false);
const udma1      = udma.addInstance();
const debug_log  = scripting.addModule("/kernel/dpl/debug_log");
const mpu_armv7  = scripting.addModule("/kernel/dpl/mpu_armv7", {}, false);
const mpu_armv71 = mpu_armv7.addInstance();
const mpu_armv72 = mpu_armv7.addInstance();
const mpu_armv73 = mpu_armv7.addInstance();
const mpu_armv74 = mpu_armv7.addInstance();
const mpu_armv75 = mpu_armv7.addInstance();
const mpu_armv76 = mpu_armv7.addInstance();

/**
 * Write custom configuration values to the imported modules.
 */
uart1.$name            = "CONFIG_UART0";
uart1.intrEnable       = "DMA";
uart1.UART.RXD.$assign = "UART0_RXD";
uart1.UART.TXD.$assign = "UART0_TXD";

uart2.$name            = "CONFIG_UART1";
uart2.intrEnable       = "DMA";
uart2.UART.RXD.$assign = "MCASP0_AXR6";
uart2.UART.TXD.$assign = "SPI1_CS1";

udma1.$name      = "CONFIG_UDMA0";
uart1.udmaDriver = udma1;
uart2.udmaDriver = udma1;
udma1.instance   = "PKTDMA_0";

mpu_armv71.size              = 31;
mpu_armv71.attributes        = "Device";
mpu_armv71.accessPermissions = "Supervisor RD+WR, User RD";
mpu_armv71.allowExecute      = false;
mpu_armv71.$name             = "REGISTERS";

mpu_armv72.size              = 15;
mpu_armv72.accessPermissions = "Supervisor RD+WR, User RD";
mpu_armv72.$name             = "TCMA";

mpu_armv73.baseAddr          = 0x41010000;
mpu_armv73.size              = 15;
mpu_armv73.accessPermissions = "Supervisor RD+WR, User RD";
mpu_armv73.$name             = "TCMB";

mpu_armv74.baseAddr          = 0x60000000;
mpu_armv74.size              = 28;
mpu_armv74.accessPermissions = "Supervisor RD, User RD";
mpu_armv74.$name             = "FLASH";

mpu_armv75.$name    = "MSRAM_BANK0_TO_BANK3";
mpu_armv75.baseAddr = 0x72000000;
mpu_armv75.size     = 22;

mpu_armv76.$name    = "MSRAM_BANK4_TO_BANK5";
mpu_armv76.baseAddr = 0x72400000;
mpu_armv76.size     = 21;

/**
 * Pinmux solution for unlocked pins/peripherals. This ensures that minor changes to the automatic solver in a future
 * version of the tool will not impact the pinmux you originally saw.  These lines can be completely deleted in order to
 * re-solve from scratch.
 */
uart1.UART.$suggestSolution = "UART0";
uart2.UART.$suggestSolution = "UART2";
