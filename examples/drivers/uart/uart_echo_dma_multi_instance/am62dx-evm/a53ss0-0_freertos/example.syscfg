/**
 * @cliArgs --device "AM62Dx" --part "AM62D24-G" --package "ANF" --context "a53ss0-0" --product "MCU_PLUS_SDK@07.03.01"
 * @versions {"tool":"1.24.0+4150"}
 */

/**
 * Import the modules used in this configuration.
 */
const uart       = scripting.addModule("/drivers/uart/uart", {}, false);
const uart2      = uart.addInstance();
const udma       = scripting.addModule("/drivers/udma/udma", {}, false);
const udma1      = udma.addInstance();
const debug_log  = scripting.addModule("/kernel/dpl/debug_log");
const mmu_armv8  = scripting.addModule("/kernel/dpl/mmu_armv8", {}, false);
const mmu_armv81 = mmu_armv8.addInstance();
const mmu_armv82 = mmu_armv8.addInstance();

/**
 * Write custom configuration values to the imported modules.
 */
uart2.$name      = "CONFIG_UART1";
uart2.intrEnable = "DMA";

debug_log.enableUartLog        = true;
debug_log.uartLog.$name        = "CONFIG_UART0";
debug_log.uartLog.intrEnable   = "DMA";
debug_log.uartLog.UART.$assign = "USART4";

udma1.$name                  = "CONFIG_UDMA0";
debug_log.uartLog.udmaDriver = udma1;
udma1.instance               = "PKTDMA_0";
uart2.udmaDriver             = udma1;

mmu_armv81.size  = 0x80000000;
mmu_armv81.$name = "REGISTER_REGION";

mmu_armv82.vAddr     = 0x80000000;
mmu_armv82.pAddr     = 0x80000000;
mmu_armv82.size      = 0x80000000;
mmu_armv82.attribute = "MAIR7";
mmu_armv82.$name     = "DDR";

/**
 * Pinmux solution for unlocked pins/peripherals. This ensures that minor changes to the automatic solver in a future
 * version of the tool will not impact the pinmux you originally saw.  These lines can be completely deleted in order to
 * re-solve from scratch.
 */
uart2.UART.$suggestSolution                 = "USART0";
uart2.UART.RXD.$suggestSolution             = "UART0_RXD";
uart2.UART.TXD.$suggestSolution             = "UART0_TXD";
debug_log.uartLog.UART.RXD.$suggestSolution = "GPIO0_49";
debug_log.uartLog.UART.TXD.$suggestSolution = "GPIO0_50";
