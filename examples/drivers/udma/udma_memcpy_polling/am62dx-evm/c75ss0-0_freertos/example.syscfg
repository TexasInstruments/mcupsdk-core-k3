/**
 * @cliArgs --device "AM62Dx" --package "AMB" --part "Default" --context "c75ss0-0" --product "MCU_PLUS_SDK@07.03.01"
 * @versions {"tool":"1.20.0+3587"}
 */

/**
 * Import the modules used in this configuration.
 */
const udma        = scripting.addModule("/drivers/udma/udma", {}, false);
const udma1       = udma.addInstance();
const debug_log   = scripting.addModule("/kernel/dpl/debug_log");
const mmu_armv8   = scripting.addModule("/kernel/dpl/mmu_armv8", {}, false);
const mmu_armv81  = mmu_armv8.addInstance();
const mmu_armv82  = mmu_armv8.addInstance();
const mmu_armv83  = mmu_armv8.addInstance();
const mmu_armv84  = mmu_armv8.addInstance();
const mmu_armv85  = mmu_armv8.addInstance();
const mmu_armv86  = mmu_armv8.addInstance();
const mmu_armv87  = mmu_armv8.addInstance();
const mmu_armv88  = mmu_armv8.addInstance();
const mmu_armv89  = mmu_armv8.addInstance();
const mmu_armv810 = mmu_armv8.addInstance();

/**
 * Write custom configuration values to the imported modules.
 */
udma1.$name                       = "CONFIG_UDMA0";
udma1.udmaBlkCopyChannel.create(1);
udma1.udmaBlkCopyChannel[0].$name = "CONFIG_UDMA_BLKCOPY_CH0";

debug_log.enableUartLog                   = true;
debug_log.uartLog.$name                   = "CONFIG_UART0";
debug_log.uartLog.useMcuDomainPeripherals = true;

mmu_armv81.size  = 0x20000000;
mmu_armv81.$name = "REGISTER_REGION_0";

mmu_armv82.vAddr = 0x20000000;
mmu_armv82.pAddr = 0x20000000;
mmu_armv82.size  = 0x20000000;
mmu_armv82.$name = "REGISTER_REGION_1";

mmu_armv83.vAddr = 0x40000000;
mmu_armv83.pAddr = 0x40000000;
mmu_armv83.size  = 0x20000000;
mmu_armv83.$name = "REGISTER_REGION_2";

mmu_armv84.vAddr = 0x60000000;
mmu_armv84.pAddr = 0x60000000;
mmu_armv84.size  = 0x10000000;
mmu_armv84.$name = "FSS0_DAT_REGION";

mmu_armv85.vAddr = 0x7C200000;
mmu_armv85.pAddr = 0x7C200000;
mmu_armv85.$name = "CLEC";
mmu_armv85.size  = 0x100000;

mmu_armv86.$name = "DRU";
mmu_armv86.vAddr = 0x7C400000;
mmu_armv86.pAddr = 0x7C400000;
mmu_armv86.size  = 0x100000;

mmu_armv87.vAddr     = 0x80000000;
mmu_armv87.pAddr     = 0x80000000;
mmu_armv87.size      = 0x20000000;
mmu_armv87.attribute = "MAIR7";
mmu_armv87.$name     = "DDR_0";

mmu_armv88.vAddr     = 0xA0000000;
mmu_armv88.pAddr     = 0xA0000000;
mmu_armv88.size      = 0x20000000;
mmu_armv88.attribute = "MAIR7";
mmu_armv88.$name     = "DDR_1";

mmu_armv89.vAddr     = 0xAA000000;
mmu_armv89.pAddr     = 0xAA000000;
mmu_armv89.size      = 0x2000000;
mmu_armv89.attribute = "MAIR4";
mmu_armv89.$name     = "DDR_2";

mmu_armv810.$name     = "CCS_DEBUG_LOG_MEM";
mmu_armv810.vAddr     = 0x99C10000;
mmu_armv810.pAddr     = 0x99C10000;
mmu_armv810.size      = 0x1000;
mmu_armv810.attribute = "MAIR4";

/**
 * Pinmux solution for unlocked pins/peripherals. This ensures that minor changes to the automatic solver in a future
 * version of the tool will not impact the pinmux you originally saw.  These lines can be completely deleted in order to
 * re-solve from scratch.
 */
debug_log.uartLog.MCU_UART.$suggestSolution     = "MCU_USART0";
debug_log.uartLog.MCU_UART.RXD.$suggestSolution = "MCU_UART0_RXD";
debug_log.uartLog.MCU_UART.TXD.$suggestSolution = "MCU_UART0_TXD";
