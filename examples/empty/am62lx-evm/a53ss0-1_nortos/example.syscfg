/**
 * @cliArgs --device "AM62Lx" --part "AM62L32-G-ANB" --package "ANB" --context "a53ss0-1" --product "MCU_PLUS_SDK@07.03.01"
 * @versions {"tool":"1.21.999+170"}
 */

/**
 * Import the modules used in this configuration.
 */
const debug_log  = scripting.addModule("/kernel/dpl/debug_log");
const mmu_armv8  = scripting.addModule("/kernel/dpl/mmu_armv8", {}, false);
const mmu_armv81 = mmu_armv8.addInstance();
const mmu_armv82 = mmu_armv8.addInstance();
const mmu_armv83 = mmu_armv8.addInstance();

/**
 * Write custom configuration values to the imported modules.
 */
debug_log.enableUartLog            = true;
debug_log.uartLog.$name            = "CONFIG_UART1";
debug_log.uartLog.UART.$assign     = "USART1";
debug_log.uartLog.UART.RXD.$assign = "MCASP0_AFSR";
debug_log.uartLog.UART.TXD.$assign = "MCASP0_ACLKR";

mmu_armv81.size  = 0x80000000;
mmu_armv81.$name = "SOC_MEM_REGION";

mmu_armv82.vAddr     = 0x88000000;
mmu_armv82.pAddr     = 0x88000000;
mmu_armv82.size      = 0x2000000;
mmu_armv82.attribute = "MAIR7";
mmu_armv82.$name     = "DDR_REGION";

mmu_armv83.vAddr     = 0x99000000;
mmu_armv83.pAddr     = 0x99000000;
mmu_armv83.size      = 0x4000;
mmu_armv83.attribute = "MAIR7";
mmu_armv83.$name     = "AMP_SHM";
