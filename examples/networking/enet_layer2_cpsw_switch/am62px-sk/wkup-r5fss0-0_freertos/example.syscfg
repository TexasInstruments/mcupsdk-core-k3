/**
 * @cliArgs --device "AM62Px" --package "AMH" --part "Default" --context "wkup-r5fss0-0" --product "MCU_PLUS_SDK@07.03.01"
 * @versions {"tool":"1.20.0+3587"}
 */

/**
 * Import the modules used in this configuration.
 */
const eeprom      = scripting.addModule("/board/eeprom/eeprom", {}, false);
const eeprom1     = eeprom.addInstance();
const flash       = scripting.addModule("/board/flash/flash", {}, false);
const flash1      = flash.addInstance();
const bootloader  = scripting.addModule("/drivers/bootloader/bootloader", {}, false);
const bootloader1 = bootloader.addInstance();
const bootloader2 = bootloader.addInstance();
const bootloader3 = bootloader.addInstance();
const gtc         = scripting.addModule("/drivers/gtc/gtc");
const i2c         = scripting.addModule("/drivers/i2c/i2c", {}, false);
const i2c1        = i2c.addInstance();
const uart        = scripting.addModule("/drivers/uart/uart", {}, false);
const uart1       = uart.addInstance();
const clock       = scripting.addModule("/kernel/dpl/clock");
const debug_log   = scripting.addModule("/kernel/dpl/debug_log");
const mpu_armv7   = scripting.addModule("/kernel/dpl/mpu_armv7", {}, false);
const mpu_armv71  = mpu_armv7.addInstance();
const mpu_armv72  = mpu_armv7.addInstance();
const mpu_armv73  = mpu_armv7.addInstance();
const mpu_armv74  = mpu_armv7.addInstance();
const mpu_armv75  = mpu_armv7.addInstance();
const mpu_armv76  = mpu_armv7.addInstance();
const enet_cpsw   = scripting.addModule("/networking/enet_cpsw/enet_cpsw", {}, false);
const enet_cpsw1  = enet_cpsw.addInstance();

/**
 * Write custom configuration values to the imported modules.
 */
eeprom1.$name = "CONFIG_EEPROM0";

bootloader1.appImageOffset = "0x240000";
bootloader1.$name          = "CONFIG_BOOTLOADER_FLASH_HSM";
bootloader1.bootloaderDma  = true;

bootloader2.$name          = "CONFIG_BOOTLOADER_FLASH_LINUX";
bootloader2.appImageOffset = "0x1200000";

bootloader3.$name          = "CONFIG_BOOTLOADER_FLASH_MCU";
bootloader3.appImageOffset = "0x800000";

bootloader1.flashDriver                                 = flash1;
bootloader2.flashDriver                                 = flash1;
bootloader3.flashDriver                                 = flash1;
flash1.$name                                            = "CONFIG_FLASH_SBL";
flash1.serialFlashDriver.$name                          = "board_flash_serialFlash_serialflash0";
flash1.serialFlashDriver.peripheralDriver.dmaEnable     = true;
flash1.serialFlashDriver.peripheralDriver.phyEnable     = true;
flash1.serialFlashDriver.peripheralDriver.$name         = "CONFIG_OSPI_SBL";
flash1.serialFlashDriver.peripheralDriver.phySkipTuning = true;

i2c1.$name                      = "CONFIG_I2C0";
eeprom1.peripheralDriver        = i2c1;
i2c1.useWakeupDomainPeripherals = false;
i2c1.I2C_child.$name            = "drivers_i2c_v0_i2c_v0_template0";
i2c1.I2C.$assign                = "I2C0";

uart1.$name                      = "CONFIG_UART_SBL";
uart1.useWakeupDomainPeripherals = false;
uart1.intrEnable                 = "DISABLE";
uart1.addedByBootloader          = true;
uart1.UART.$assign               = "USART0";

const udma                                           = scripting.addModule("/drivers/udma/udma", {}, false);
const udma1                                          = udma.addInstance({}, false);
udma1.$name                                          = "CONFIG_UDMA0";
bootloader1.udmaDriver                               = udma1;
flash1.serialFlashDriver.peripheralDriver.udmaDriver = udma1;

const udma_blkcopy_channel                                   = scripting.addModule("/drivers/udma/udma_blkcopy_channel", {}, false);
const udma_blkcopy_channel1                                  = udma_blkcopy_channel.addInstance({}, false);
udma_blkcopy_channel1.$name                                  = "CONFIG_UDMA_BLKCOPY_CH0";
bootloader1.udmaBlkCopyChannel                               = udma_blkcopy_channel1;
flash1.serialFlashDriver.peripheralDriver.udmaBlkCopyChannel = udma_blkcopy_channel1;

debug_log.enableUartLog      = true;
debug_log.uartTrace          = true;
debug_log.uartLog.intrEnable = "DISABLE";
debug_log.uartLog.$name      = "CONFIG_UART_APP";

mpu_armv71.accessPermissions = "Supervisor RD+WR, User RD";
mpu_armv71.allowExecute      = false;
mpu_armv71.size              = 31;
mpu_armv71.attributes        = "Device";
mpu_armv71.$name             = "REGISTER_REGION";

mpu_armv72.accessPermissions = "Supervisor RD+WR, User RD";
mpu_armv72.size              = 7;
mpu_armv72.$name             = "TCMA_VEC";

mpu_armv73.$name    = "DDR";
mpu_armv73.baseAddr = 0x80000000;
mpu_armv73.size     = 31;

mpu_armv74.baseAddr   = 0x41010000;
mpu_armv74.size       = 15;
mpu_armv74.attributes = "NonCached";
mpu_armv74.$name      = "TCMB";

mpu_armv75.size       = 15;
mpu_armv75.attributes = "NonCached";
mpu_armv75.$name      = "TCMA";

mpu_armv76.$name        = "UART0_REG";
mpu_armv76.baseAddr     = 0x2800000;
mpu_armv76.size         = 9;
mpu_armv76.attributes   = "Device";
mpu_armv76.allowExecute = false;

enet_cpsw1.$name                 = "CONFIG_ENET_CPSW0";
enet_cpsw1.txDmaChannel[0].$name = "ENET_DMA_TX_CH0";
enet_cpsw1.rxDmaChannel[0].$name = "ENET_DMA_RX_CH0";
enet_cpsw1.pinmux[0].$name       = "ENET_CPSW_PINMUX0";

const udma2        = udma.addInstance({}, false);
enet_cpsw1.udmaDrv = udma2;

/**
 * Pinmux solution for unlocked pins/peripherals. This ensures that minor changes to the automatic solver in a future
 * version of the tool will not impact the pinmux you originally saw.  These lines can be completely deleted in order to
 * re-solve from scratch.
 */
flash1.serialFlashDriver.peripheralDriver.OSPI.$suggestSolution      = "OSPI0";
flash1.serialFlashDriver.peripheralDriver.OSPI.CLK.$suggestSolution  = "OSPI0_CLK";
flash1.serialFlashDriver.peripheralDriver.OSPI.CSn0.$suggestSolution = "OSPI0_CSn0";
flash1.serialFlashDriver.peripheralDriver.OSPI.DQS.$suggestSolution  = "OSPI0_DQS";
flash1.serialFlashDriver.peripheralDriver.OSPI.D7.$suggestSolution   = "OSPI0_D7";
flash1.serialFlashDriver.peripheralDriver.OSPI.D6.$suggestSolution   = "OSPI0_D6";
flash1.serialFlashDriver.peripheralDriver.OSPI.D5.$suggestSolution   = "OSPI0_D5";
flash1.serialFlashDriver.peripheralDriver.OSPI.D4.$suggestSolution   = "OSPI0_D4";
flash1.serialFlashDriver.peripheralDriver.OSPI.D3.$suggestSolution   = "OSPI0_D3";
flash1.serialFlashDriver.peripheralDriver.OSPI.D2.$suggestSolution   = "OSPI0_D2";
flash1.serialFlashDriver.peripheralDriver.OSPI.D1.$suggestSolution   = "OSPI0_D1";
flash1.serialFlashDriver.peripheralDriver.OSPI.D0.$suggestSolution   = "OSPI0_D0";
i2c1.I2C.SCL.$suggestSolution                                        = "I2C0_SCL";
i2c1.I2C.SDA.$suggestSolution                                        = "I2C0_SDA";
uart1.UART.RXD.$suggestSolution                                      = "UART0_RXD";
uart1.UART.TXD.$suggestSolution                                      = "UART0_TXD";
debug_log.uartLog.WKUP_UART.$suggestSolution                         = "WKUP_USART0";
debug_log.uartLog.WKUP_UART.RXD.$suggestSolution                     = "WKUP_UART0_RXD";
debug_log.uartLog.WKUP_UART.TXD.$suggestSolution                     = "WKUP_UART0_TXD";
enet_cpsw1.pinmux[0].MDIO.$suggestSolution                           = "MDIO0";
enet_cpsw1.pinmux[0].MDIO.MDC.$suggestSolution                       = "MDIO0_MDC";
enet_cpsw1.pinmux[0].MDIO.MDIO.$suggestSolution                      = "MDIO0_MDIO";
enet_cpsw1.pinmux[0].RGMII1.$suggestSolution                         = "RGMII2";
enet_cpsw1.pinmux[0].RGMII1.RD0.$suggestSolution                     = "RGMII2_RD0";
enet_cpsw1.pinmux[0].RGMII1.RD1.$suggestSolution                     = "RGMII2_RD1";
enet_cpsw1.pinmux[0].RGMII1.RD2.$suggestSolution                     = "RGMII2_RD2";
enet_cpsw1.pinmux[0].RGMII1.RD3.$suggestSolution                     = "RGMII2_RD3";
enet_cpsw1.pinmux[0].RGMII1.RX_CTL.$suggestSolution                  = "RGMII2_RX_CTL";
enet_cpsw1.pinmux[0].RGMII1.RXC.$suggestSolution                     = "RGMII2_RXC";
enet_cpsw1.pinmux[0].RGMII1.TD0.$suggestSolution                     = "RGMII2_TD0";
enet_cpsw1.pinmux[0].RGMII1.TD1.$suggestSolution                     = "RGMII2_TD1";
enet_cpsw1.pinmux[0].RGMII1.TD2.$suggestSolution                     = "RGMII2_TD2";
enet_cpsw1.pinmux[0].RGMII1.TD3.$suggestSolution                     = "RGMII2_TD3";
enet_cpsw1.pinmux[0].RGMII1.TX_CTL.$suggestSolution                  = "RGMII2_TX_CTL";
enet_cpsw1.pinmux[0].RGMII1.TXC.$suggestSolution                     = "RGMII2_TXC";
enet_cpsw1.pinmux[0].RGMII2.$suggestSolution                         = "RGMII1";
enet_cpsw1.pinmux[0].RGMII2.RD0.$suggestSolution                     = "RGMII1_RD0";
enet_cpsw1.pinmux[0].RGMII2.RD1.$suggestSolution                     = "RGMII1_RD1";
enet_cpsw1.pinmux[0].RGMII2.RD2.$suggestSolution                     = "RGMII1_RD2";
enet_cpsw1.pinmux[0].RGMII2.RD3.$suggestSolution                     = "RGMII1_RD3";
enet_cpsw1.pinmux[0].RGMII2.RX_CTL.$suggestSolution                  = "RGMII1_RX_CTL";
enet_cpsw1.pinmux[0].RGMII2.RXC.$suggestSolution                     = "RGMII1_RXC";
enet_cpsw1.pinmux[0].RGMII2.TD0.$suggestSolution                     = "RGMII1_TD0";
enet_cpsw1.pinmux[0].RGMII2.TD1.$suggestSolution                     = "RGMII1_TD1";
enet_cpsw1.pinmux[0].RGMII2.TD2.$suggestSolution                     = "RGMII1_TD2";
enet_cpsw1.pinmux[0].RGMII2.TD3.$suggestSolution                     = "RGMII1_TD3";
enet_cpsw1.pinmux[0].RGMII2.TX_CTL.$suggestSolution                  = "RGMII1_TX_CTL";
enet_cpsw1.pinmux[0].RGMII2.TXC.$suggestSolution                     = "RGMII1_TXC";
