/**
 * @cliArgs --device "AM62Ax" --package "AMB" --part "Default" --context "a53ss0-0" --product "MCU_PLUS_SDK@07.03.01"
 * @versions {"tool":"1.18.0+3266"}
 */

/**
 * Import the modules used in this configuration.
 */
const eeprom     = scripting.addModule("/board/eeprom/eeprom", {}, false);
const eeprom1    = eeprom.addInstance();
const i2c        = scripting.addModule("/drivers/i2c/i2c", {}, false);
const i2c1       = i2c.addInstance();
const debug_log  = scripting.addModule("/kernel/dpl/debug_log");
const mmu_armv8  = scripting.addModule("/kernel/dpl/mmu_armv8", {}, false);
const mmu_armv81 = mmu_armv8.addInstance();
const mmu_armv82 = mmu_armv8.addInstance();
const mmu_armv83 = mmu_armv8.addInstance();
const enet_cpsw  = scripting.addModule("/networking/enet_cpsw/enet_cpsw", {}, false);
const enet_cpsw1 = enet_cpsw.addInstance();

/**
 * Write custom configuration values to the imported modules.
 */
eeprom1.$name = "CONFIG_EEPROM0";

i2c1.$name               = "CONFIG_I2C0";
eeprom1.peripheralDriver = i2c1;
i2c1.I2C.$assign         = "I2C0";
i2c1.I2C.SCL.$assign     = "I2C0_SCL";
i2c1.I2C.SDA.$assign     = "I2C0_SDA";

debug_log.enableUartLog        = true;
debug_log.enableCssLog         = true;
debug_log.uartLog.$name        = "CONFIG_UART_CONSOLE";
debug_log.uartLog.UART.$assign = "USART0";

mmu_armv81.size  = 0x80000000;
mmu_armv81.$name = "SOC_MEM_REGION";

mmu_armv82.vAddr     = 0x70000000;
mmu_armv82.pAddr     = 0x70000000;
mmu_armv82.size      = 0x200000;
mmu_armv82.$name     = "SHM_MEM_REGION";
mmu_armv82.attribute = "MAIR7";

mmu_armv83.vAddr     = 0x80000000;
mmu_armv83.pAddr     = 0x80000000;
mmu_armv83.size      = 0x80000000;
mmu_armv83.$name     = "DDR_REGION";
mmu_armv83.attribute = "MAIR7";

enet_cpsw1.$name                           = "CONFIG_ENET_CPSW0";
enet_cpsw1.PktInfoOnlyEnable               = true;
enet_cpsw1.LargePoolPktCount               = 32;
enet_cpsw1.cptstsGenfClrEn                 = true;
enet_cpsw1.txDmaChannel[0].$name           = "ENET_DMA_TX_CH0";
enet_cpsw1.rxDmaChannel[0].$name           = "ENET_DMA_RX_CH0";
enet_cpsw1.pinmux[0].$name                 = "ENET_CPSW_PINMUX0";
enet_cpsw1.pinmux[0].MDIO.$assign          = "MDIO0";
enet_cpsw1.pinmux[0].MDIO.MDC.$assign      = "MDIO0_MDC";
enet_cpsw1.pinmux[0].MDIO.MDIO.$assign     = "MDIO0_MDIO";
enet_cpsw1.pinmux[0].RGMII1.$assign        = "RGMII1";
enet_cpsw1.pinmux[0].RGMII1.RD0.$assign    = "RGMII1_RD0";
enet_cpsw1.pinmux[0].RGMII1.RD1.$assign    = "RGMII1_RD1";
enet_cpsw1.pinmux[0].RGMII1.RD2.$assign    = "RGMII1_RD2";
enet_cpsw1.pinmux[0].RGMII1.RD3.$assign    = "RGMII1_RD3";
enet_cpsw1.pinmux[0].RGMII1.RX_CTL.$assign = "RGMII1_RX_CTL";
enet_cpsw1.pinmux[0].RGMII1.RXC.$assign    = "RGMII1_RXC";
enet_cpsw1.pinmux[0].RGMII1.TD0.$assign    = "RGMII1_TD0";
enet_cpsw1.pinmux[0].RGMII1.TD1.$assign    = "RGMII1_TD1";
enet_cpsw1.pinmux[0].RGMII1.TD2.$assign    = "RGMII1_TD2";
enet_cpsw1.pinmux[0].RGMII1.TD3.$assign    = "RGMII1_TD3";
enet_cpsw1.pinmux[0].RGMII1.TX_CTL.$assign = "RGMII1_TX_CTL";
enet_cpsw1.pinmux[0].RGMII1.TXC.$assign    = "RGMII1_TXC";
enet_cpsw1.pinmux[0].RGMII2.$assign        = "RGMII2";
enet_cpsw1.pinmux[0].RGMII2.RD0.$assign    = "RGMII2_RD0";
enet_cpsw1.pinmux[0].RGMII2.RD1.$assign    = "RGMII2_RD1";
enet_cpsw1.pinmux[0].RGMII2.RD2.$assign    = "RGMII2_RD2";
enet_cpsw1.pinmux[0].RGMII2.RD3.$assign    = "RGMII2_RD3";
enet_cpsw1.pinmux[0].RGMII2.RX_CTL.$assign = "RGMII2_RX_CTL";
enet_cpsw1.pinmux[0].RGMII2.RXC.$assign    = "RGMII2_RXC";
enet_cpsw1.pinmux[0].RGMII2.TD0.$assign    = "RGMII2_TD0";
enet_cpsw1.pinmux[0].RGMII2.TD1.$assign    = "RGMII2_TD1";
enet_cpsw1.pinmux[0].RGMII2.TD2.$assign    = "RGMII2_TD2";
enet_cpsw1.pinmux[0].RGMII2.TD3.$assign    = "RGMII2_TD3";
enet_cpsw1.pinmux[0].RGMII2.TX_CTL.$assign = "RGMII2_TX_CTL";
enet_cpsw1.pinmux[0].RGMII2.TXC.$assign    = "RGMII2_TXC";
enet_cpsw1.netifInstance.create(1);
enet_cpsw1.netifInstance[0].$name          = "NETIF_INST_ID0";

const udma         = scripting.addModule("/drivers/udma/udma", {}, false);
const udma1        = udma.addInstance({}, false);
enet_cpsw1.udmaDrv = udma1;

/**
 * Pinmux solution for unlocked pins/peripherals. This ensures that minor changes to the automatic solver in a future
 * version of the tool will not impact the pinmux you originally saw.  These lines can be completely deleted in order to
 * re-solve from scratch.
 */
debug_log.uartLog.UART.RXD.$suggestSolution = "UART0_RXD";
debug_log.uartLog.UART.TXD.$suggestSolution = "UART0_TXD";
