/**
 * @cliArgs --device "AM275x" --part "AM2754" --package "ANJ" --context "r5fss0-0" --product "MCU_PLUS_SDK@07.03.01"
 * @versions {"tool":"1.21.0+3721"}
 */

/**
 * Import the modules used in this configuration.
 */
const addr_translate  = scripting.addModule("/kernel/dpl/addr_translate", {}, false);
const addr_translate1 = addr_translate.addInstance();
const debug_log       = scripting.addModule("/kernel/dpl/debug_log");
const mpu_armv7       = scripting.addModule("/kernel/dpl/mpu_armv7", {}, false);
const mpu_armv71      = mpu_armv7.addInstance();
const mpu_armv72      = mpu_armv7.addInstance();
const mpu_armv73      = mpu_armv7.addInstance();
const mpu_armv74      = mpu_armv7.addInstance();
const mpu_armv75      = mpu_armv7.addInstance();
const mpu_armv76      = mpu_armv7.addInstance();

/**
 * Write custom configuration values to the imported modules.
 */
addr_translate1.$name     = "CONFIG_ADDR_TRANSLATE_REGION0";
addr_translate1.size      = 12;
addr_translate1.localAddr = 0x80000000;

debug_log.enableUartLog        = true;
debug_log.uartLog.$name        = "CONFIG_UART0";
debug_log.uartLog.UART.$assign = "UART0";

mpu_armv71.size         = 31;
mpu_armv71.attributes   = "Device";
mpu_armv71.allowExecute = false;
mpu_armv71.$name        = "REGISTERS";

mpu_armv72.size  = 15;
mpu_armv72.$name = "TCMA";

mpu_armv73.baseAddr = 0x41010000;
mpu_armv73.size     = 15;
mpu_armv73.$name    = "TCMB";

mpu_armv74.size     = 22;
mpu_armv74.baseAddr = 0x72000000;
mpu_armv74.$name    = "MSRAM_BANK0_TO_BANK3";

mpu_armv75.baseAddr = 0x72400000;
mpu_armv75.size     = 21;
mpu_armv75.$name    = "MSRAM_BANK4_TO_BANK5";

mpu_armv76.$name      = "CONFIG_MPU_REGION0";
mpu_armv76.baseAddr   = 0x80000000;
mpu_armv76.size       = 10;
mpu_armv76.attributes = "NonCached";

/**
 * Pinmux solution for unlocked pins/peripherals. This ensures that minor changes to the automatic solver in a future
 * version of the tool will not impact the pinmux you originally saw.  These lines can be completely deleted in order to
 * re-solve from scratch.
 */
debug_log.uartLog.UART.RXD.$suggestSolution = "MCASP4_AXR0";
debug_log.uartLog.UART.TXD.$suggestSolution = "MLB0_MLBCLK";
