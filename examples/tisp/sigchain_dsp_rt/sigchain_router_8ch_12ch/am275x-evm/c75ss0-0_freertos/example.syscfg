/**
 * @cliArgs --device "AM275x" --part "AM2754" --package "ANJ" --context "c75ss0-0" --product "MCU_PLUS_SDK@07.03.01"
 * @versions {"tool":"1.24.2+4234"}
 */

/**
 * Import the modules used in this configuration.
 */
const ipc         = scripting.addModule("/drivers/ipc/ipc");
const mcasp       = scripting.addModule("/drivers/mcasp/mcasp", {}, false);
const mcasp1      = mcasp.addInstance();
const udma        = scripting.addModule("/drivers/udma/udma", {}, false);
const udma1       = udma.addInstance();
const debug_log   = scripting.addModule("/kernel/dpl/debug_log");
const mmu_armv8   = scripting.addModule("/kernel/dpl/mmu_armv8", {}, false);
const mmu_armv81  = mmu_armv8.addInstance();
const mmu_armv82  = mmu_armv8.addInstance();
const mmu_armv83  = mmu_armv8.addInstance();
const mmu_armv84  = mmu_armv8.addInstance();
const mmu_armv85  = mmu_armv8.addInstance();
const mmu_armv86  = mmu_armv8.addInstance();
const mmu_armv87  = mmu_armv8.addInstance();
const mmu_armv88  = mmu_armv8.addInstance();
const mmu_armv89  = mmu_armv8.addInstance();
const mmu_armv810 = mmu_armv8.addInstance();
const mmu_armv811 = mmu_armv8.addInstance();
const mmu_armv812 = mmu_armv8.addInstance();

/**
 * Write custom configuration values to the imported modules.
 */
ipc.wkup_r5fss0_0 = "NONE";
ipc.r5fss0_1      = "NONE";
ipc.r5fss1_0      = "NONE";
ipc.r5fss1_1      = "NONE";
ipc.c75ss1_0      = "NONE";

mcasp1.$name                                   = "CONFIG_MCASP0";
mcasp1.txDataMask                              = 0xFFFFFFFF;
mcasp1.rxDataMask                              = 0xFFFFFFFF;
mcasp1.enableLoopback                          = false;
mcasp1.skipDriverOpen                          = true;
mcasp1.clkSyncMode                             = "ASYNC";
mcasp1.txCallbackFxn                           = "mcasp1_txcb";
mcasp1.rxCallbackFxn                           = "mcasp1_rxcb";
mcasp1.TxMode                                  = "TDM";
mcasp1.NumTxSlots                              = 8;
mcasp1.txFsWidth                               = 0;
mcasp1.txFsPolarity                            = 0;
mcasp1.RxMode                                  = "TDM";
mcasp1.NumRxSlots                              = 8;
mcasp1.rxFsWidth                               = 0;
mcasp1.rxActiveSlotMask                        = 0xFF;
mcasp1.txActiveSlotMask                        = 0xFF;
mcasp1.txHclkSource                            = 0;
mcasp1.txHclkSourceMux                         = 4;
mcasp1.rxHclkSource                            = 0;
mcasp1.rxHclkSourceMux                         = 4;
mcasp1.rxFsPolarity                            = 0;
mcasp1.rxBitClkPolarity                        = 0;
mcasp1.txLoopjobBufLength                      = 2048;
mcasp1.rxLoopjobBufLength                      = 2048;
mcasp1.txLoopjobBufExtern                      = "uint8_t gMcaspAudioBufferTx[][]";
mcasp1.txHclkExpected                          = 24576000;
mcasp1.txHclkDiv                               = 1;
mcasp1.txClkDiv                                = 2;
mcasp1.txBclkCalculated                        = 12288000;
mcasp1.txClkApplyAlert                         = false;
mcasp1.rxHclkExpected                          = 24576000;
mcasp1.rxHclkDiv                               = 1;
mcasp1.rxClkDiv                                = 2;
mcasp1.rxBclkCalculated                        = 12288000;
mcasp1.rxClkApplyAlert                         = false;
mcasp1.MCASP.$assignAllowConflicts             = "MCASP1";
mcasp1.mcaspSer.create(2);
mcasp1.mcaspSer[0].$name                       = "CONFIG_MCASP_SER1";
mcasp1.mcaspSer[0].dataDir                     = "Receive";
mcasp1.mcaspSer[0].MCASP.$assignAllowConflicts = "MCASP1";
mcasp1.mcaspSer[1].$name                       = "CONFIG_MCASP_SER0";
mcasp1.mcaspSer[1].serNum                      = 1;
mcasp1.mcaspSer[1].MCASP.$assignAllowConflicts = "MCASP1";
mcasp1.CLOCKING.$assign                        = "CLOCKING";
scripting.suppress("Resource conflict,MCASP1 is also in use by @@@.+?@@@, @@@.+?@@@", mcasp1.MCASP, "$assign");
scripting.suppress("Resource conflict,MCASP1 is also in use by @@@.+?@@@, @@@.+?@@@", mcasp1.mcaspSer[0].MCASP, "$assign");
scripting.suppress("Resource conflict,MCASP1 is also in use by @@@.+?@@@, @@@.+?@@@", mcasp1.mcaspSer[1].MCASP, "$assign");

mcasp1.bcDmaDriver = udma1;
udma1.$name        = "CONFIG_UDMA0";

debug_log.enableSharedMemLog = true;
debug_log.enableCssLog       = false;

mmu_armv81.size  = 0x20000000;
mmu_armv81.$name = "REGISTERS_REGION0";

mmu_armv82.vAddr = 0x20000000;
mmu_armv82.pAddr = 0x20000000;
mmu_armv82.size  = 0x20000000;
mmu_armv82.$name = "REGISTERS_REGION1";

mmu_armv83.vAddr = 0x40000000;
mmu_armv83.pAddr = 0x40000000;
mmu_armv83.size  = 0x20000000;
mmu_armv83.$name = "REGISTERS_REGION2";

mmu_armv84.vAddr = 0x7C200000;
mmu_armv84.pAddr = 0x7C200000;
mmu_armv84.$name = "CLEC";
mmu_armv84.size  = 0x100000;

mmu_armv85.$name = "DRU";
mmu_armv85.vAddr = 0x7C400000;
mmu_armv85.pAddr = 0x7C400000;
mmu_armv85.size  = 0x300000;

mmu_armv86.$name       = "MCASP";
mmu_armv86.vAddr       = 0x2B10000;
mmu_armv86.pAddr       = 0x2B10000;
mmu_armv86.size        = 0x2000000;
mmu_armv86.privExecute = false;

mmu_armv87.attribute = "MAIR7";
mmu_armv87.vAddr     = 0x7E000000;
mmu_armv87.pAddr     = 0x7E000000;
mmu_armv87.size      = 0x200000;
mmu_armv87.$name     = "L2SRAM";

mmu_armv88.attribute = "MAIR7";
mmu_armv88.$name     = "L2SRAM_AUX";
mmu_armv88.vAddr     = 0x7E200000;
mmu_armv88.pAddr     = 0x7E200000;
mmu_armv88.size      = 0x40000;

mmu_armv89.$name       = "MSRAM_BANK0_TO_BANK3";
mmu_armv89.vAddr       = 0x80000000;
mmu_armv89.pAddr       = 0x80000000;
mmu_armv89.size        = 0x400000;
mmu_armv89.attribute   = "MAIR7";
mmu_armv89.userExecute = true;

mmu_armv810.attribute   = "MAIR7";
mmu_armv810.$name       = "MSRAM_BANK4_TO_BANK5";
mmu_armv810.vAddr       = 0x80400000;
mmu_armv810.pAddr       = 0x80400000;
mmu_armv810.size        = 0x200000;
mmu_armv810.userExecute = true;

mmu_armv811.vAddr     = 0x80380000;
mmu_armv811.pAddr     = 0x80380000;
mmu_armv811.size      = 0x40000;
mmu_armv811.attribute = "MAIR4";
mmu_armv811.$name     = "LOG_SHM_MEM";

mmu_armv812.$name     = "IPC_RTOS_VRING";
mmu_armv812.pAddr     = 0x803C0000;
mmu_armv812.attribute = "MAIR4";
mmu_armv812.vAddr     = 0x723C0000;
mmu_armv812.size      = 0xC000;

/**
 * Pinmux solution for unlocked pins/peripherals. This ensures that minor changes to the automatic solver in a future
 * version of the tool will not impact the pinmux you originally saw.  These lines can be completely deleted in order to
 * re-solve from scratch.
 */
mcasp1.MCASP.AFSX.$suggestSolution                 = "MCASP1_AFSX";
mcasp1.MCASP.ACLKX.$suggestSolution                = "MCASP1_ACLKX";
mcasp1.MCASP.AFSR.$suggestSolution                 = "MCASP0_AXR15";
mcasp1.MCASP.ACLKR.$suggestSolution                = "MCASP0_AXR14";
mcasp1.mcaspSer[0].MCASP.AXR0.$suggestSolution     = "MCASP1_AXR0";
mcasp1.mcaspSer[1].MCASP.AXR1.$suggestSolution     = "MCASP1_AXR1";
mcasp1.CLOCKING.AUDIO_EXT_REFCLK2.$suggestSolution = "GPIO1_72";
