/**
 * @cliArgs --device "AM62Dx" --part "AM62D24-G" --package "ANF" --context "mcu-r5fss0-0" --product "MCU_PLUS_SDK@07.03.01"
 * @versions {"tool":"1.24.0+4150"}
 */

/**
 * Import the modules used in this configuration.
 */
const i2c        = scripting.addModule("/drivers/i2c/i2c", {}, false);
const i2c1       = i2c.addInstance();
const ipc        = scripting.addModule("/drivers/ipc/ipc");
const uart       = scripting.addModule("/drivers/uart/uart", {}, false);
const uart1      = uart.addInstance();
const debug_log  = scripting.addModule("/kernel/dpl/debug_log");
const mpu_armv7  = scripting.addModule("/kernel/dpl/mpu_armv7", {}, false);
const mpu_armv71 = mpu_armv7.addInstance();
const mpu_armv72 = mpu_armv7.addInstance();
const mpu_armv73 = mpu_armv7.addInstance();
const mpu_armv74 = mpu_armv7.addInstance();
const mpu_armv75 = mpu_armv7.addInstance();
const mpu_armv76 = mpu_armv7.addInstance();
const mpu_armv77 = mpu_armv7.addInstance();
const mpu_armv78 = mpu_armv7.addInstance();

/**
 * Write custom configuration values to the imported modules.
 */
i2c1.$name                   = "CONFIG_I2C0";
i2c1.useMcuDomainPeripherals = false;
i2c1.I2C_child.$name         = "drivers_i2c_v0_i2c_v0_template0";
i2c1.I2C.$assign             = "I2C0";
i2c1.I2C.SCL.$assign         = "I2C0_SCL";
i2c1.I2C.SDA.$assign         = "I2C0_SDA";

ipc.enableLinuxIpc     = false;
ipc.r5fss0_0           = "NONE";
ipc.vringAllocationPDK = false;

uart1.$name                   = "CONFIG_UART_TUNER";
uart1.readMode                = "CALLBACK";
uart1.writeMode               = "CALLBACK";
uart1.writeCallbackFxn        = "SigchainGatewayUART_txCB";
uart1.readCallbackFxn         = "SigchainGatewayUART_rxCB";
uart1.baudRate                = 921600;
uart1.operMode                = "13X";
uart1.useMcuDomainPeripherals = false;
uart1.UART.$assign            = "USART0";
uart1.UART.RXD.$assign        = "UART0_RXD";
uart1.UART.TXD.$assign        = "UART0_TXD";

debug_log.enableCssLog                    = false;
debug_log.enableUartLog                   = true;
debug_log.enableSharedMemLogReader        = true;
debug_log.uartLog.$name                   = "CONFIG_UART_CONSOLE";
debug_log.uartLog.useMcuDomainPeripherals = true;
debug_log.uartLog.MCU_UART.$assign        = "MCU_USART0";
debug_log.uartLog.MCU_UART.RXD.$assign    = "MCU_UART0_RXD";
debug_log.uartLog.MCU_UART.TXD.$assign    = "MCU_UART0_TXD";

mpu_armv71.$name             = "CONFIG_MPU_REGION0";
mpu_armv71.size              = 31;
mpu_armv71.attributes        = "Device";
mpu_armv71.accessPermissions = "Supervisor RD+WR, User RD";
mpu_armv71.allowExecute      = false;

mpu_armv72.$name             = "CONFIG_MPU_REGION1";
mpu_armv72.size              = 15;
mpu_armv72.accessPermissions = "Supervisor RD+WR, User RD";

mpu_armv73.$name             = "CONFIG_MPU_REGION2";
mpu_armv73.baseAddr          = 0x41010000;
mpu_armv73.size              = 15;
mpu_armv73.accessPermissions = "Supervisor RD+WR, User RD";

mpu_armv74.$name             = "CONFIG_MPU_REGION3";
mpu_armv74.accessPermissions = "Supervisor RD+WR, User RD";
mpu_armv74.baseAddr          = 0x79100000;
mpu_armv74.size              = 19;

mpu_armv75.$name             = "CONFIG_MPU_REGION4";
mpu_armv75.baseAddr          = 0x60000000;
mpu_armv75.size              = 28;
mpu_armv75.accessPermissions = "Supervisor RD, User RD";

mpu_armv76.allowExecute = false;
mpu_armv76.attributes   = "NonCached";
mpu_armv76.baseAddr     = 0xA0400000;
mpu_armv76.size         = 22;
mpu_armv76.$name        = "RTOS_NORTOS_IPC_VRING";

mpu_armv77.$name      = "LOG_SHM_MEM";
mpu_armv77.baseAddr   = 0xA1000000;
mpu_armv77.size       = 18;
mpu_armv77.attributes = "NonCached";

mpu_armv78.$name    = "DDR";
mpu_armv78.baseAddr = 0x80000000;
mpu_armv78.size     = 23;
