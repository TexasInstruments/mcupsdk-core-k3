/**
 * @cliArgs --device "AM62Ax" --package "AMB" --part "Default" --context "r5fss0-0" --product "MCU_PLUS_SDK@07.03.01"
 * @versions {"tool":"1.15.0+2826"}
 */

/**
 * Import the modules used in this configuration.
 */
const bootloader  = scripting.addModule("/drivers/bootloader/bootloader", {}, false);
const bootloader1 = bootloader.addInstance();
const bootloader2 = bootloader.addInstance();
const bootloader3 = bootloader.addInstance();
const bootloader4 = bootloader.addInstance();
const gtc         = scripting.addModule("/drivers/gtc/gtc");
const mmcsd       = scripting.addModule("/drivers/mmcsd/mmcsd", {}, false);
const mmcsd1      = mmcsd.addInstance();
const clock       = scripting.addModule("/kernel/dpl/clock");
const debug_log   = scripting.addModule("/kernel/dpl/debug_log");
const mpu_armv7   = scripting.addModule("/kernel/dpl/mpu_armv7", {}, false);
const mpu_armv71  = mpu_armv7.addInstance();
const mpu_armv72  = mpu_armv7.addInstance();
const mpu_armv73  = mpu_armv7.addInstance();
const mpu_armv74  = mpu_armv7.addInstance();
const mpu_armv75  = mpu_armv7.addInstance();
const mpu_armv76  = mpu_armv7.addInstance();
const mpu_armv77  = mpu_armv7.addInstance();
const mpu_armv78  = mpu_armv7.addInstance();
const mpu_armv79  = mpu_armv7.addInstance();

/**
 * Write custom configuration values to the imported modules.
 */
bootloader1.bootMedia          = "EMMC";
bootloader1.$name              = "CONFIG_BOOTLOADER_EMMC_HSM";
bootloader1.EMMCAppImageOffset = "0x240000";

bootloader2.bootMedia          = "EMMC";
bootloader2.$name              = "CONFIG_BOOTLOADER_EMMC_DM";
bootloader2.EMMCAppImageOffset = "0xC0000";

bootloader3.$name              = "CONFIG_BOOTLOADER_EMMC_LINUX";
bootloader3.bootMedia          = "EMMC";
bootloader3.EMMCAppImageOffset = "0x800000";

bootloader4.$name              = "CONFIG_BOOTLOADER_EMMC_DSP";
bootloader4.bootMedia          = "EMMC";
bootloader4.EMMCAppImageOffset = "0x700000";

mmcsd1.$name            = "CONFIG_MMCSD0";
bootloader1.MMCSDDriver = mmcsd1;
bootloader2.MMCSDDriver = mmcsd1;
bootloader3.MMCSDDriver = mmcsd1;
bootloader4.MMCSDDriver = mmcsd1;
mmcsd1.MMC0.$assign     = "MMC0";

debug_log.enableUartLog                      = true;
debug_log.enableCssLog                       = false;
debug_log.uartLog.$name                      = "CONFIG_UART0";
debug_log.uartLog.useWakeupDomainPeripherals = false;
debug_log.uartLog.intrEnable                 = "DISABLE";

mpu_armv71.accessPermissions = "Supervisor RD+WR, User RD";
mpu_armv71.allowExecute      = false;
mpu_armv71.attributes        = "NonCached";
mpu_armv71.$name             = "REGISTERS_BASE";

mpu_armv72.accessPermissions = "Supervisor RD+WR, User RD";
mpu_armv72.size              = 7;
mpu_armv72.$name             = "VECTORS";

mpu_armv73.baseAddr = 0x80000000;
mpu_armv73.size     = 31;
mpu_armv73.$name    = "DDR";

mpu_armv74.baseAddr   = 0x41010000;
mpu_armv74.size       = 15;
mpu_armv74.attributes = "NonCached";
mpu_armv74.$name      = "TCMB";

mpu_armv75.size       = 15;
mpu_armv75.attributes = "NonCached";
mpu_armv75.$name      = "TCMA";

mpu_armv76.baseAddr = 0x43C00000;
mpu_armv76.size     = 18;
mpu_armv76.$name    = "HSM";

mpu_armv77.size         = 9;
mpu_armv77.baseAddr     = 0x2800000;
mpu_armv77.attributes   = "Device";
mpu_armv77.allowExecute = false;
mpu_armv77.$name        = "UART0_BASE";

mpu_armv78.$name        = "MMCSD0_CTL_CFG_REGISTERS";
mpu_armv78.baseAddr     = 0xFA10000;
mpu_armv78.size         = 12;
mpu_armv78.attributes   = "Device";
mpu_armv78.allowExecute = false;

mpu_armv79.$name        = "MMCSD0_SS_CFG_REGISTERS";
mpu_armv79.baseAddr     = 0xFA18000;
mpu_armv79.size         = 10;
mpu_armv79.attributes   = "Device";
mpu_armv79.allowExecute = false;

/**
 * Pinmux solution for unlocked pins/peripherals. This ensures that minor changes to the automatic solver in a future
 * version of the tool will not impact the pinmux you originally saw.  These lines can be completely deleted in order to
 * re-solve from scratch.
 */
mmcsd1.MMC0.CLK.$suggestSolution            = "ball.AB7";
mmcsd1.MMC0.CMD.$suggestSolution            = "ball.Y6";
mmcsd1.MMC0.DAT0.$suggestSolution           = "ball.AA6";
mmcsd1.MMC0.DAT1.$suggestSolution           = "ball.AB6";
mmcsd1.MMC0.DAT2.$suggestSolution           = "ball.Y7";
mmcsd1.MMC0.DAT3.$suggestSolution           = "ball.AA7";
mmcsd1.MMC0.DAT4.$suggestSolution           = "ball.Y8";
mmcsd1.MMC0.DAT5.$suggestSolution           = "ball.W7";
mmcsd1.MMC0.DAT6.$suggestSolution           = "ball.W9";
mmcsd1.MMC0.DAT7.$suggestSolution           = "ball.AB8";
debug_log.uartLog.UART.$suggestSolution     = "USART0";
debug_log.uartLog.UART.RXD.$suggestSolution = "ball.E14";
debug_log.uartLog.UART.TXD.$suggestSolution = "ball.D15";
