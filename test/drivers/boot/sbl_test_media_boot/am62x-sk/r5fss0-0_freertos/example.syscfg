/**
 * @cliArgs --device "AM62x" --package "ALW" --part "Default" --context "r5fss0-0" --product "MCU_PLUS_SDK@07.03.01"
 * @versions {"tool":"1.18.0+3266"}
 */

/**
 * Import the modules used in this configuration.
 */
const flash         = scripting.addModule("/board/flash/flash", {}, false);
const flash1        = flash.addInstance();
const bootloader    = scripting.addModule("/drivers/bootloader/bootloader", {}, false);
const bootloader1   = bootloader.addInstance();
const bootloader2   = bootloader.addInstance();
const bootloader3   = bootloader.addInstance();
const bootloader4   = bootloader.addInstance();
const bootloader5   = bootloader.addInstance();
const bootloader6   = bootloader.addInstance();
const bootloader7   = bootloader.addInstance();
const bootloader8   = bootloader.addInstance();
const bootloader9   = bootloader.addInstance();
const bootloader10  = bootloader.addInstance();
const bootloader11  = bootloader.addInstance();
const ipc           = scripting.addModule("/drivers/ipc/ipc");
const mmcsd         = scripting.addModule("/drivers/mmcsd/mmcsd", {}, false);
const mmcsd1        = mmcsd.addInstance();
const freertos_fat  = scripting.addModule("/fs/freertos_fat/freertos_fat", {}, false);
const freertos_fat1 = freertos_fat.addInstance();
const clock         = scripting.addModule("/kernel/dpl/clock");
const debug_log     = scripting.addModule("/kernel/dpl/debug_log");
const mpu_armv7     = scripting.addModule("/kernel/dpl/mpu_armv7", {}, false);
const mpu_armv71    = mpu_armv7.addInstance();
const mpu_armv72    = mpu_armv7.addInstance();
const mpu_armv73    = mpu_armv7.addInstance();
const mpu_armv74    = mpu_armv7.addInstance();
const mpu_armv75    = mpu_armv7.addInstance();
const mpu_armv76    = mpu_armv7.addInstance();
const mpu_armv77    = mpu_armv7.addInstance();
const mpu_armv78    = mpu_armv7.addInstance();
const mpu_armv79    = mpu_armv7.addInstance();
const mpu_armv710   = mpu_armv7.addInstance();

/**
 * Write custom configuration values to the imported modules.
 */
bootloader1.bootMedia          = "EMMC";
bootloader1.$name              = "CONFIG_BOOTLOADER_EMMC_MCU";
bootloader1.EMMCAppImageOffset = "0x800000";

bootloader2.$name          = "CONFIG_BOOTLOADER_FLASH_DSP";
bootloader2.appImageOffset = "0xA00000";

bootloader3.$name     = "CONFIG_BOOTLOADER_SD_A53";
bootloader3.bootMedia = "MEM";

bootloader4.$name              = "CONFIG_BOOTLOADER_EMMC_SMP";
bootloader4.bootMedia          = "EMMC";
bootloader4.EMMCAppImageOffset = "0xA00000";

bootloader5.$name          = "CONFIG_BOOTLOADER_FLASH_SMP";
bootloader5.appImageOffset = "0x800000";

bootloader6.$name     = "CONFIG_BOOTLOADER_SD_SMP";
bootloader6.bootMedia = "MEM";

bootloader7.$name     = "CONFIG_BOOTLOADER_SD_MULTICORE";
bootloader7.bootMedia = "MEM";

bootloader8.appImageOffset = "0x1200000";
bootloader8.$name          = "CONFIG_BOOTLOADER_FLASH_MULTICORE";

bootloader2.flashDriver                         = flash1;
flash1.$name                                    = "CONFIG_FLASH_SBL";
bootloader5.flashDriver                         = flash1;
bootloader8.flashDriver                         = flash1;
flash1.serialFlashDriver.$name                           = "board_flash_serialFlash_serialflash0";
flash1.serialFlashDriver.peripheralDriver.$name          = "CONFIG_OSPI_SBL";
flash1.serialFlashDriver.peripheralDriver.dmaEnable      = true;
flash1.serialFlashDriver.peripheralDriver.phyEnable      = true;

bootloader9.$name              = "CONFIG_BOOTLOADER_EMMC_MULTICORE";
bootloader9.appImageOffset     = "0x1200000";
bootloader9.bootMedia          = "EMMC";
bootloader9.EMMCAppImageOffset = "0x1200000";

bootloader10.$name              = "CONFIG_BOOTLOADER_EMMC_A53";
bootloader10.bootMedia          = "EMMC";
bootloader10.EMMCAppImageOffset = "0xC00000";

bootloader11.$name              = "CONFIG_BOOTLOADER_EMMC_HSM";
bootloader11.bootMedia          = "EMMC";
bootloader11.EMMCAppImageOffset = "0x1400000";

ipc.a53ss0_0 = "notify_rpmsg";

bootloader1.MMCSDDriver  = mmcsd1;
mmcsd1.$name             = "CONFIG_MMCSD_SBL";
bootloader4.MMCSDDriver  = mmcsd1;
bootloader9.MMCSDDriver  = mmcsd1;
bootloader10.MMCSDDriver = mmcsd1;
bootloader11.MMCSDDriver = mmcsd1;

const udma             = scripting.addModule("/drivers/udma/udma", {}, false);
const udma1            = udma.addInstance({}, false);
udma1.$name            = "CONFIG_UDMA0";
bootloader1.udmaDriver  = udma1;
bootloader2.udmaDriver  = udma1;
bootloader3.udmaDriver  = udma1;
bootloader4.udmaDriver  = udma1;
bootloader5.udmaDriver  = udma1;
bootloader6.udmaDriver  = udma1;
bootloader7.udmaDriver  = udma1;
bootloader8.udmaDriver  = udma1;
bootloader9.udmaDriver  = udma1;
bootloader10.udmaDriver = udma1;
bootloader11.udmaDriver = udma1;

const udma_blkcopy_channel     = scripting.addModule("/drivers/udma/udma_blkcopy_channel", {}, false);
const udma_blkcopy_channel1    = udma_blkcopy_channel.addInstance({}, false);
udma_blkcopy_channel1.$name    = "CONFIG_UDMA_BLKCOPY_CH0";
bootloader1.udmaBlkCopyChannel  = udma_blkcopy_channel1;
bootloader2.udmaBlkCopyChannel  = udma_blkcopy_channel1;
bootloader3.udmaBlkCopyChannel  = udma_blkcopy_channel1;
bootloader4.udmaBlkCopyChannel  = udma_blkcopy_channel1;
bootloader5.udmaBlkCopyChannel  = udma_blkcopy_channel1;
bootloader6.udmaBlkCopyChannel  = udma_blkcopy_channel1;
bootloader7.udmaBlkCopyChannel  = udma_blkcopy_channel1;
bootloader8.udmaBlkCopyChannel  = udma_blkcopy_channel1;
bootloader9.udmaBlkCopyChannel  = udma_blkcopy_channel1;
bootloader10.udmaBlkCopyChannel = udma_blkcopy_channel1;
bootloader11.udmaBlkCopyChannel = udma_blkcopy_channel1;
flash1.serialFlashDriver.peripheralDriver.udmaDriver         = udma1;
flash1.serialFlashDriver.peripheralDriver.udmaBlkCopyChannel = udma_blkcopy_channel1;

freertos_fat1.$name                  = "CONFIG_FREERTOS_FAT0";
freertos_fat1.peripheralDriver.$name = "CONFIG_MMCSD0";

debug_log.enableUartLog            = true;
debug_log.enableSharedMemLog       = true;
debug_log.enableSharedMemLogReader = true;
debug_log.uartTrace                = true;
debug_log.enableCssLog             = false;
debug_log.uartLog.$name            = "CONFIG_UART0";

mpu_armv71.accessPermissions = "Supervisor RD+WR, User RD";
mpu_armv71.allowExecute      = false;
mpu_armv71.size              = 31;
mpu_armv71.attributes        = "Device";
mpu_armv71.$name             = "REGISTER_REGION";

mpu_armv72.accessPermissions = "Supervisor RD+WR, User RD";
mpu_armv72.size              = 7;
mpu_armv72.$name             = "TCMA_VEC";

mpu_armv73.$name             = "CONFIG_MPU_REGION2";
mpu_armv73.accessPermissions = "Supervisor RD+WR, User RD";
mpu_armv73.baseAddr          = 0x41C00000;
mpu_armv73.size              = 19;

mpu_armv74.$name             = "CONFIG_MPU_REGION3";
mpu_armv74.accessPermissions = "Supervisor RD+WR, User RD";
mpu_armv74.baseAddr          = 0x70000000;
mpu_armv74.size              = 16;

mpu_armv75.$name    = "DDR";
mpu_armv75.baseAddr = 0x80000000;
mpu_armv75.size     = 31;

mpu_armv76.$name      = "TCMB";
mpu_armv76.baseAddr   = 0x41010000;
mpu_armv76.size       = 15;
mpu_armv76.attributes = "NonCached";

mpu_armv77.size       = 15;
mpu_armv77.attributes = "NonCached";
mpu_armv77.$name      = "TCMA";

mpu_armv78.baseAddr = 0x43C00000;
mpu_armv78.size     = 18;
mpu_armv78.$name    = "HSM_RAM";

mpu_armv79.$name        = "RTOS_NORTOS_IPC_VRING";
mpu_armv79.allowExecute = false;
mpu_armv79.attributes   = "NonCached";
mpu_armv79.baseAddr     = 0xA0400000;
mpu_armv79.size         = 22;

mpu_armv710.$name      = "LOG_SHM_MEM";
mpu_armv710.baseAddr   = 0xA1000000;
mpu_armv710.size       = 18;
mpu_armv710.attributes = "NonCached";

/**
 * Pinmux solution for unlocked pins/peripherals.
 */
flash1.serialFlashDriver.peripheralDriver.OSPI.$suggestSolution      = "OSPI0";
flash1.serialFlashDriver.peripheralDriver.OSPI.CLK.$suggestSolution  = "OSPI0_CLK";
flash1.serialFlashDriver.peripheralDriver.OSPI.CSn0.$suggestSolution = "OSPI0_CSn0";
flash1.serialFlashDriver.peripheralDriver.OSPI.DQS.$suggestSolution  = "OSPI0_DQS";
flash1.serialFlashDriver.peripheralDriver.OSPI.D7.$suggestSolution   = "OSPI0_D7";
flash1.serialFlashDriver.peripheralDriver.OSPI.D6.$suggestSolution   = "OSPI0_D6";
flash1.serialFlashDriver.peripheralDriver.OSPI.D5.$suggestSolution   = "OSPI0_D5";
flash1.serialFlashDriver.peripheralDriver.OSPI.D4.$suggestSolution   = "OSPI0_D4";
flash1.serialFlashDriver.peripheralDriver.OSPI.D3.$suggestSolution   = "OSPI0_D3";
flash1.serialFlashDriver.peripheralDriver.OSPI.D2.$suggestSolution   = "OSPI0_D2";
flash1.serialFlashDriver.peripheralDriver.OSPI.D1.$suggestSolution   = "OSPI0_D1";
flash1.serialFlashDriver.peripheralDriver.OSPI.D0.$suggestSolution   = "OSPI0_D0";
mmcsd1.MMC0.$suggestSolution                                         = "MMC0";
mmcsd1.MMC0.CLK.$suggestSolution                                     = "MMC0_CLK";
mmcsd1.MMC0.CMD.$suggestSolution                                     = "MMC0_CMD";
mmcsd1.MMC0.DAT0.$suggestSolution                                    = "MMC0_DAT0";
mmcsd1.MMC0.DAT1.$suggestSolution                                    = "MMC0_DAT1";
mmcsd1.MMC0.DAT2.$suggestSolution                                    = "MMC0_DAT2";
mmcsd1.MMC0.DAT3.$suggestSolution                                    = "MMC0_DAT3";
mmcsd1.MMC0.DAT4.$suggestSolution                                    = "MMC0_DAT4";
mmcsd1.MMC0.DAT5.$suggestSolution                                    = "MMC0_DAT5";
mmcsd1.MMC0.DAT6.$suggestSolution                                    = "MMC0_DAT6";
mmcsd1.MMC0.DAT7.$suggestSolution                                    = "MMC0_DAT7";
freertos_fat1.peripheralDriver.MMC1.$suggestSolution                 = "MMC1";
freertos_fat1.peripheralDriver.MMC1.CLK.$suggestSolution             = "MMC1_CLK";
freertos_fat1.peripheralDriver.MMC1.CMD.$suggestSolution             = "MMC1_CMD";
freertos_fat1.peripheralDriver.MMC1.DAT0.$suggestSolution            = "MMC1_DAT0";
freertos_fat1.peripheralDriver.MMC1.DAT1.$suggestSolution            = "MMC1_DAT1";
freertos_fat1.peripheralDriver.MMC1.DAT2.$suggestSolution            = "MMC1_DAT2";
freertos_fat1.peripheralDriver.MMC1.DAT3.$suggestSolution            = "MMC1_DAT3";
freertos_fat1.peripheralDriver.MMC1.SDCD.$suggestSolution            = "MMC1_SDCD";
debug_log.uartLog.WKUP_UART.$suggestSolution                         = "WKUP_USART0";
debug_log.uartLog.WKUP_UART.RXD.$suggestSolution                     = "WKUP_UART0_RXD";
debug_log.uartLog.WKUP_UART.TXD.$suggestSolution                     = "WKUP_UART0_TXD";
