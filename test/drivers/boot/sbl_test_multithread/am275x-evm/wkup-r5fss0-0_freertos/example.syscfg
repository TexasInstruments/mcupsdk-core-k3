/**
 * @cliArgs --device "AM275x" --part "AM2754" --package "ANJ" --context "wkup-r5fss0-0" --product "MCU_PLUS_SDK@07.03.01"
 * @versions {"tool":"1.24.2+4234"}
 */

/**
 * Import the modules used in this configuration.
 */
const flash         = scripting.addModule("/board/flash/flash", {}, false);
const flash1        = flash.addInstance();
const hyperRam      = scripting.addModule("/board/hyperRam/hyperRam", {}, false);
const hyperRam1     = hyperRam.addInstance();
const bootloader    = scripting.addModule("/drivers/bootloader/bootloader", {}, false);
const bootloader1   = bootloader.addInstance();
const bootloader2   = bootloader.addInstance();
const bootloader3   = bootloader.addInstance();
const bootloader4   = bootloader.addInstance();
const bootloader5   = bootloader.addInstance();
const bootloader6   = bootloader.addInstance();
const bootloader7   = bootloader.addInstance();
const bootloader8   = bootloader.addInstance();
const bootloader9   = bootloader.addInstance();
const ipc           = scripting.addModule("/drivers/ipc/ipc");
const mmcsd         = scripting.addModule("/drivers/mmcsd/mmcsd", {}, false);
const mmcsd1        = mmcsd.addInstance();
const debug_log     = scripting.addModule("/kernel/dpl/debug_log");
const mpu_armv7     = scripting.addModule("/kernel/dpl/mpu_armv7", {}, false);
const mpu_armv71    = mpu_armv7.addInstance();
const mpu_armv72    = mpu_armv7.addInstance();
const mpu_armv73    = mpu_armv7.addInstance();
const mpu_armv74    = mpu_armv7.addInstance();
const mpu_armv75    = mpu_armv7.addInstance();
const mpu_armv76    = mpu_armv7.addInstance();
const mpu_armv77    = mpu_armv7.addInstance();
const mpu_armv78    = mpu_armv7.addInstance();
const mpu_armv79    = mpu_armv7.addInstance();
const mpu_armv710   = mpu_armv7.addInstance();

/**
 * Write custom configuration values to the imported modules.
 */
hyperRam1.$name                       = "CONFIG_HYPERRAM0";
hyperRam1.addedByBootloader           = true;
hyperRam1.peripheralDriver.$name      = "CONFIG_HYPERBUS0";
hyperRam1.peripheralDriver.deviceSize = 0x4000000;

bootloader1.bootMedia          = "EMMC";
bootloader1.$name              = "CONFIG_BOOTLOADER_EMMC_MCU";
bootloader1.EMMCAppImageOffset = "0x800000";

bootloader2.$name          = "CONFIG_BOOTLOADER_FLASH_DSP";
bootloader2.appImageOffset = "0xA00000";

bootloader3.$name     = "CONFIG_BOOTLOADER_MEM_R5FSS0_0";
bootloader3.bootMedia = "MEM";

bootloader4.$name              = "CONFIG_BOOTLOADER_EMMC_SMP";
bootloader4.bootMedia          = "EMMC";
bootloader4.EMMCAppImageOffset = "0xA00000";

bootloader5.$name          = "CONFIG_BOOTLOADER_FLASH_SMP";
bootloader5.appImageOffset = "0x800000";

bootloader6.$name     = "CONFIG_BOOTLOADER_MEM_R5FSS1_0";
bootloader6.bootMedia = "MEM";

bootloader7.$name     = "CONFIG_BOOTLOADER_MEM_C75SS0_0";
bootloader7.bootMedia = "MEM";

bootloader8.appImageOffset = "0x1200000";
bootloader8.$name          = "CONFIG_BOOTLOADER_FLASH_MULTICORE";

bootloader2.flashDriver                         = flash1;
flash1.$name                                    = "CONFIG_FLASH_SBL";
bootloader5.flashDriver                         = flash1;
bootloader8.flashDriver                         = flash1;
flash1.serialFlashDriver.$name                  = "board_flash_serialFlash_serialflash0";
flash1.serialFlashDriver.peripheralDriver.$name = "CONFIG_OSPI_SBL";

bootloader9.$name              = "CONFIG_BOOTLOADER_EMMC_MULTICORE";
bootloader9.appImageOffset     = "0x1200000";
bootloader9.bootMedia          = "EMMC";
bootloader9.EMMCAppImageOffset = "0x1200000";

ipc.r5fss0_0 = "notify_rpmsg";
ipc.r5fss1_0 = "notify_rpmsg";
ipc.c75ss0_0 = "notify_rpmsg";

bootloader1.MMCSDDriver = mmcsd1;
mmcsd1.$name            = "CONFIG_MMCSD_SBL";
bootloader4.MMCSDDriver = mmcsd1;
bootloader9.MMCSDDriver = mmcsd1;

const udma             = scripting.addModule("/drivers/udma/udma", {}, false);
const udma1            = udma.addInstance({}, false);
udma1.$name            = "CONFIG_UDMA0";
bootloader1.udmaDriver = udma1;
bootloader2.udmaDriver = udma1;
bootloader3.udmaDriver = udma1;
bootloader4.udmaDriver = udma1;
bootloader5.udmaDriver = udma1;
bootloader6.udmaDriver = udma1;
bootloader7.udmaDriver = udma1;
bootloader8.udmaDriver = udma1;
bootloader9.udmaDriver = udma1;

const udma_blkcopy_channel     = scripting.addModule("/drivers/udma/udma_blkcopy_channel", {}, false);
const udma_blkcopy_channel1    = udma_blkcopy_channel.addInstance({}, false);
udma_blkcopy_channel1.$name    = "CONFIG_UDMA_BLKCOPY_CH0";
bootloader1.udmaBlkCopyChannel = udma_blkcopy_channel1;
bootloader2.udmaBlkCopyChannel = udma_blkcopy_channel1;
bootloader3.udmaBlkCopyChannel = udma_blkcopy_channel1;
bootloader4.udmaBlkCopyChannel = udma_blkcopy_channel1;
bootloader5.udmaBlkCopyChannel = udma_blkcopy_channel1;
bootloader6.udmaBlkCopyChannel = udma_blkcopy_channel1;
bootloader7.udmaBlkCopyChannel = udma_blkcopy_channel1;
bootloader8.udmaBlkCopyChannel = udma_blkcopy_channel1;
bootloader9.udmaBlkCopyChannel = udma_blkcopy_channel1;

debug_log.enableUartLog                      = true;
debug_log.enableSharedMemLog                 = true;
debug_log.enableSharedMemLogReader           = true;
debug_log.uartTrace                          = true;
debug_log.enableCssLog                       = false;
debug_log.uartLog.$name                      = "CONFIG_UART0";
debug_log.uartLog.useWakeupDomainPeripherals = true;
debug_log.uartLog.intrEnable                 = "DISABLE";

mpu_armv71.size         = 31;
mpu_armv71.attributes   = "Device";
mpu_armv71.allowExecute = false;
mpu_armv71.$name        = "REGISTERS";

mpu_armv72.size       = 15;
mpu_armv72.attributes = "NonCached";
mpu_armv72.$name      = "TCMA";

mpu_armv73.baseAddr   = 0x41010000;
mpu_armv73.size       = 15;
mpu_armv73.attributes = "NonCached";
mpu_armv73.$name      = "TCMB";

mpu_armv74.$name    = "MSRAM_BANK0_TO_BANK3";
mpu_armv74.baseAddr = 0x72000000;
mpu_armv74.size     = 22;

mpu_armv75.$name    = "MSRAM_BANK4_TO_BANK5";
mpu_armv75.baseAddr = 0x72400000;
mpu_armv75.size     = 21;

mpu_armv76.$name             = "RESET_VECTORS";
mpu_armv76.size              = 7;
mpu_armv76.accessPermissions = "Supervisor RD+WR, User RD";

mpu_armv77.$name      = "HYPERRAM";
mpu_armv77.baseAddr   = 0x68000000;
mpu_armv77.attributes = "CUSTOM";
mpu_armv77.size       = 26;
mpu_armv77.tex        = 5;

mpu_armv78.$name        = "HYPERRAM_CR0_CR1";
mpu_armv78.baseAddr     = 0x68001000;
mpu_armv78.size         = 5;
mpu_armv78.attributes   = "Device";
mpu_armv78.allowExecute = false;

mpu_armv79.size         = 5;
mpu_armv79.attributes   = "Device";
mpu_armv79.allowExecute = false;
mpu_armv79.$name        = "HYPERRAM_ID0_ID1";
mpu_armv79.baseAddr     = 0x68000000;

mpu_armv710.$name    = "ATCM_SOC";
mpu_armv710.baseAddr = 0x78000000;
mpu_armv710.size     = 15;

/**
 * Pinmux solution for unlocked pins/peripherals. This ensures that minor changes to the automatic solver in a future
 * version of the tool will not impact the pinmux you originally saw.  These lines can be completely deleted in order to
 * re-solve from scratch.
 */
hyperRam1.peripheralDriver.HYPERBUS.$suggestSolution         = "HYPERBUS";
hyperRam1.peripheralDriver.HYPERBUS.CK.$suggestSolution      = "OSPI1_CLK";
hyperRam1.peripheralDriver.HYPERBUS.CKn.$suggestSolution     = "OSPI1_LBCLKO";
hyperRam1.peripheralDriver.HYPERBUS.CSn0.$suggestSolution    = "OSPI1_CSn0";
hyperRam1.peripheralDriver.HYPERBUS.RWDS.$suggestSolution    = "OSPI1_DQS";
hyperRam1.peripheralDriver.HYPERBUS.WPn.$suggestSolution     = "OSPI0_CSn2";
hyperRam1.peripheralDriver.HYPERBUS.RESETn.$suggestSolution  = "OSPI1_CSn1";
hyperRam1.peripheralDriver.HYPERBUS.RESETOn.$suggestSolution = "OSPI0_LBCLKO";
hyperRam1.peripheralDriver.HYPERBUS.INTn.$suggestSolution    = "OSPI0_CSn3";
hyperRam1.peripheralDriver.HYPERBUS.DQ7.$suggestSolution     = "OSPI1_D7";
hyperRam1.peripheralDriver.HYPERBUS.DQ6.$suggestSolution     = "OSPI1_D6";
hyperRam1.peripheralDriver.HYPERBUS.DQ5.$suggestSolution     = "OSPI1_D5";
hyperRam1.peripheralDriver.HYPERBUS.DQ4.$suggestSolution     = "OSPI1_D4";
hyperRam1.peripheralDriver.HYPERBUS.DQ3.$suggestSolution     = "OSPI1_D3";
hyperRam1.peripheralDriver.HYPERBUS.DQ2.$suggestSolution     = "OSPI1_D2";
hyperRam1.peripheralDriver.HYPERBUS.DQ1.$suggestSolution     = "OSPI1_D1";
hyperRam1.peripheralDriver.HYPERBUS.DQ0.$suggestSolution     = "OSPI1_D0";
flash1.serialFlashDriver.peripheralDriver.OSPI.$suggestSolution      = "OSPI0";
flash1.serialFlashDriver.peripheralDriver.OSPI.CLK.$suggestSolution  = "OSPI0_CLK";
flash1.serialFlashDriver.peripheralDriver.OSPI.CSn0.$suggestSolution = "OSPI0_CSn0";
flash1.serialFlashDriver.peripheralDriver.OSPI.DQS.$suggestSolution  = "OSPI0_DQS";
flash1.serialFlashDriver.peripheralDriver.OSPI.D7.$suggestSolution   = "OSPI0_D7";
flash1.serialFlashDriver.peripheralDriver.OSPI.D6.$suggestSolution   = "OSPI0_D6";
flash1.serialFlashDriver.peripheralDriver.OSPI.D5.$suggestSolution   = "OSPI0_D5";
flash1.serialFlashDriver.peripheralDriver.OSPI.D4.$suggestSolution   = "OSPI0_D4";
flash1.serialFlashDriver.peripheralDriver.OSPI.D3.$suggestSolution   = "OSPI0_D3";
flash1.serialFlashDriver.peripheralDriver.OSPI.D2.$suggestSolution   = "OSPI0_D2";
flash1.serialFlashDriver.peripheralDriver.OSPI.D1.$suggestSolution   = "OSPI0_D1";
flash1.serialFlashDriver.peripheralDriver.OSPI.D0.$suggestSolution   = "OSPI0_D0";
mmcsd1.MMC.$suggestSolution          = "MMC0";
mmcsd1.MMC.MMC_CLK.$suggestSolution  = "MMC0_CLK";
mmcsd1.MMC.MMC_CMD.$suggestSolution  = "MMC0_CMD";
mmcsd1.MMC.MMC_DAT0.$suggestSolution = "MMC0_DAT0";
mmcsd1.MMC.MMC_DAT1.$suggestSolution = "MMC0_DAT1";
mmcsd1.MMC.MMC_DAT2.$suggestSolution = "MMC0_DAT2";
mmcsd1.MMC.MMC_DAT3.$suggestSolution = "MMC0_DAT3";
mmcsd1.MMC.MMC_DAT4.$suggestSolution = "MMC0_DAT4";
mmcsd1.MMC.MMC_DAT5.$suggestSolution = "MMC0_DAT5";
mmcsd1.MMC.MMC_DAT6.$suggestSolution = "MMC0_DAT6";
mmcsd1.MMC.MMC_DAT7.$suggestSolution = "MMC0_DAT7";
debug_log.uartLog.WKUP_UART.$suggestSolution     = "WKUP_UART";
debug_log.uartLog.WKUP_UART.RXD.$suggestSolution = "WKUP_UART0_RXD";
debug_log.uartLog.WKUP_UART.TXD.$suggestSolution = "WKUP_UART0_TXD";
