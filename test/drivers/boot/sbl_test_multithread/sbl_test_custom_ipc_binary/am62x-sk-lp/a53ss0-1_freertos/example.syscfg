/**
 * @cliArgs --device "AM62x" --part "Default" --package "AMC" --context "a53ss0-1" --product "MCU_PLUS_SDK@07.03.01"
 * @versions {"tool":"1.22.0+3893"}
 */

/**
 * Import the modules used in this configuration.
 */
const ipc        = scripting.addModule("/drivers/ipc/ipc");
const debug_log  = scripting.addModule("/kernel/dpl/debug_log");
const mmu_armv8  = scripting.addModule("/kernel/dpl/mmu_armv8", {}, false);
const mmu_armv81 = mmu_armv8.addInstance();
const mmu_armv82 = mmu_armv8.addInstance();
const mmu_armv83 = mmu_armv8.addInstance();
const mmu_armv84 = mmu_armv8.addInstance();
const mmu_armv85 = mmu_armv8.addInstance();
const mmu_armv86 = mmu_armv8.addInstance();

/**
 * Write custom configuration values to the imported modules.
 */
ipc.enableLinuxIpc = false;

debug_log.enableSharedMemLog = true;

mmu_armv81.size  = 0x80000000;
mmu_armv81.$name = "SOC_MEM_REGION";

mmu_armv82.attribute = "MAIR7";
mmu_armv82.$name     = "DDR_REGION";
mmu_armv82.size      = 0x2000000;
mmu_armv82.vAddr     = 0x8E000000;
mmu_armv82.pAddr     = 0x8E000000;

mmu_armv83.$name     = "LOG_SHM_MEM";
mmu_armv83.vAddr     = 0xA1000000;
mmu_armv83.pAddr     = 0xA1000000;
mmu_armv83.size      = 0x40000;
mmu_armv83.attribute = "MAIR4";

mmu_armv84.$name     = "AMP_SHM";
mmu_armv84.vAddr     = 0x99000000;
mmu_armv84.pAddr     = 0x99000000;
mmu_armv84.size      = 0x4000;
mmu_armv84.attribute = "MAIR7";

mmu_armv85.vAddr             = 0x82080000;
mmu_armv85.pAddr             = 0x82080000;
mmu_armv85.size              = 0x80000;
mmu_armv85.$name             = "ATF_REGION";
mmu_armv85.accessPermissions = "Privilege RO, User None";
mmu_armv85.shareable         = "Non Shareable";

mmu_armv86.size      = 0x300000;
mmu_armv86.vAddr     = 0x9C800000;
mmu_armv86.pAddr     = 0x9C800000;
mmu_armv86.$name     = "RTOS_NORTOS_IPC_SHM_MEM";
mmu_armv86.attribute = "MAIR4";
