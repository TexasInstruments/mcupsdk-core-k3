/**
 * @cliArgs --device "AM275x" --part "AM2754" --package "ANJ" --context "wkup-r5fss0-0" --product "MCU_PLUS_SDK@07.03.01"
 * @versions {"tool":"1.24.2+4234"}
 */

/**
 * Import the modules used in this configuration.
 */
const bootloader  = scripting.addModule("/drivers/bootloader/bootloader", {}, false);
const bootloader1 = bootloader.addInstance();
const ipc         = scripting.addModule("/drivers/ipc/ipc");
const uart        = scripting.addModule("/drivers/uart/uart", {}, false);
const uart1       = uart.addInstance();
const clock       = scripting.addModule("/kernel/dpl/clock");
const debug_log   = scripting.addModule("/kernel/dpl/debug_log");
const mpu_armv7   = scripting.addModule("/kernel/dpl/mpu_armv7", {}, false);
const mpu_armv71  = mpu_armv7.addInstance();
const mpu_armv72  = mpu_armv7.addInstance();
const mpu_armv73  = mpu_armv7.addInstance();
const mpu_armv74  = mpu_armv7.addInstance();
const mpu_armv75  = mpu_armv7.addInstance();
const mpu_armv76  = mpu_armv7.addInstance();
const mpu_armv77  = mpu_armv7.addInstance();
const mpu_armv78  = mpu_armv7.addInstance();
const mpu_armv79  = mpu_armv7.addInstance();
const mpu_armv710 = mpu_armv7.addInstance();

/**
 * Write custom configuration values to the imported modules.
 */
bootloader1.$name     = "CONFIG_BOOTLOADER0";
bootloader1.bootMedia = "MEM";

ipc.r5fss0_0 = "notify_rpmsg";
ipc.r5fss1_0 = "notify_rpmsg";
ipc.c75ss0_0 = "notify_rpmsg";

uart1.$name            = "CONFIG_UART0";
uart1.intrEnable       = "DISABLE";
uart1.UART.$assign     = "UART0";
uart1.UART.RXD.$assign = "UART0_RXD";
uart1.UART.TXD.$assign = "UART0_TXD";

const udma             = scripting.addModule("/drivers/udma/udma", {}, false);
const udma1            = udma.addInstance({}, false);
udma1.$name            = "CONFIG_UDMA0";
bootloader1.udmaDriver = udma1;

const udma_blkcopy_channel     = scripting.addModule("/drivers/udma/udma_blkcopy_channel", {}, false);
const udma_blkcopy_channel1    = udma_blkcopy_channel.addInstance({}, false);
udma_blkcopy_channel1.$name    = "CONFIG_UDMA_BLKCOPY_CH0";
bootloader1.udmaBlkCopyChannel = udma_blkcopy_channel1;

debug_log.enableUartLog                      = true;
debug_log.uartTrace                          = true;
debug_log.uartLog.$name                      = "CONFIG_UART1";
debug_log.uartLog.useWakeupDomainPeripherals = true;
debug_log.uartLog.intrEnable                 = "DISABLE";

mpu_armv71.size         = 31;
mpu_armv71.attributes   = "Device";
mpu_armv71.allowExecute = false;
mpu_armv71.$name        = "REGISTERS";

mpu_armv72.size       = 15;
mpu_armv72.attributes = "NonCached";
mpu_armv72.$name      = "TCMA";

mpu_armv73.baseAddr   = 0x41010000;
mpu_armv73.size       = 15;
mpu_armv73.attributes = "NonCached";
mpu_armv73.$name      = "TCMB";

mpu_armv74.$name    = "MSRAM_BANK0_TO_BANK3";
mpu_armv74.baseAddr = 0x72000000;
mpu_armv74.size     = 22;

mpu_armv75.$name    = "MSRAM_BANK4_TO_BANK5";
mpu_armv75.baseAddr = 0x72400000;
mpu_armv75.size     = 21;

mpu_armv76.$name             = "RESET_VECTORS";
mpu_armv76.size              = 7;
mpu_armv76.accessPermissions = "Supervisor RD+WR, User RD";

mpu_armv77.$name      = "HYPERRAM";
mpu_armv77.baseAddr   = 0x68000000;
mpu_armv77.attributes = "CUSTOM";
mpu_armv77.size       = 26;
mpu_armv77.tex        = 5;

mpu_armv78.$name        = "HYPERRAM_CR0_CR1";
mpu_armv78.baseAddr     = 0x68001000;
mpu_armv78.size         = 5;
mpu_armv78.attributes   = "Device";
mpu_armv78.allowExecute = false;

mpu_armv79.size         = 5;
mpu_armv79.attributes   = "Device";
mpu_armv79.allowExecute = false;
mpu_armv79.$name        = "HYPERRAM_ID0_ID1";
mpu_armv79.baseAddr     = 0x68000000;

mpu_armv710.$name    = "ATCM_SOC";
mpu_armv710.baseAddr = 0x78000000;
mpu_armv710.size     = 15;

/**
 * Pinmux solution for unlocked pins/peripherals. This ensures that minor changes to the automatic solver in a future
 * version of the tool will not impact the pinmux you originally saw.  These lines can be completely deleted in order to
 * re-solve from scratch.
 */
debug_log.uartLog.WKUP_UART.$suggestSolution     = "WKUP_UART";
debug_log.uartLog.WKUP_UART.RXD.$suggestSolution = "WKUP_UART0_RXD";
debug_log.uartLog.WKUP_UART.TXD.$suggestSolution = "WKUP_UART0_TXD";
