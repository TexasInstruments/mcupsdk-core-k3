/**
 * @cliArgs --device "AM62x" --package "ALW" --part "Default" --context "r5fss0-0" --product "MCU_PLUS_SDK@07.03.01"
 * @versions {"tool":"1.18.0+3266"}
 */

/**
 * Import the modules used in this configuration.
 */
const flash       = scripting.addModule("/board/flash/flash", {}, false);
const flash1      = flash.addInstance();
const bootloader  = scripting.addModule("/drivers/bootloader/bootloader", {}, false);
const bootloader1 = bootloader.addInstance();
const mmcsd       = scripting.addModule("/drivers/mmcsd/mmcsd", {}, false);
const mmcsd1      = mmcsd.addInstance();
const uart        = scripting.addModule("/drivers/uart/uart", {}, false);
const uart1       = uart.addInstance();
const clock       = scripting.addModule("/kernel/dpl/clock");
const debug_log   = scripting.addModule("/kernel/dpl/debug_log");

/**
 * Write custom configuration values to the imported modules.
 */
flash1.$name                                           = "CONFIG_FLASH0";
flash1.serialFlashDriver.$name                         = "board_flash_serialFlash_serialflash0";
flash1.serialFlashDriver.peripheralDriver.$name        = "CONFIG_OSPI0";
flash1.serialFlashDriver.peripheralDriver.dmaEnable    = true;
flash1.serialFlashDriver.peripheralDriver.phyEnable    = true;
flash1.serialFlashDriver.peripheralDriver.inputClkFreq = 200000000;

bootloader1.$name     = "CONFIG_BOOTLOADER_MEM";
bootloader1.bootMedia = "MEM";

mmcsd1.$name        = "CONFIG_MMCSD";
mmcsd1.MMC0.$assign = "MMC0";

uart1.$name                      = "CONFIG_UART0";
uart1.useWakeupDomainPeripherals = false;
uart1.intrEnable                 = "DISABLE";
uart1.UART.$assign               = "USART0";

/* Unity output goes to the wakeup UART (debug_log), visible independently
 * of any XMODEM channel on the main UART. */
debug_log.enableUartLog            = true;
debug_log.uartTrace                = true;
debug_log.uartLog.$name            = "CONFIG_UART1";
debug_log.uartLog.useWakeupDomainPeripherals = true;

/**
 * Pinmux solution for unlocked pins/peripherals.
 */
flash1.serialFlashDriver.peripheralDriver.OSPI.$suggestSolution      = "OSPI0";
flash1.serialFlashDriver.peripheralDriver.OSPI.CLK.$suggestSolution  = "OSPI0_CLK";
flash1.serialFlashDriver.peripheralDriver.OSPI.CSn0.$suggestSolution = "OSPI0_CSn0";
flash1.serialFlashDriver.peripheralDriver.OSPI.DQS.$suggestSolution  = "OSPI0_DQS";
flash1.serialFlashDriver.peripheralDriver.OSPI.D7.$suggestSolution   = "OSPI0_D7";
flash1.serialFlashDriver.peripheralDriver.OSPI.D6.$suggestSolution   = "OSPI0_D6";
flash1.serialFlashDriver.peripheralDriver.OSPI.D5.$suggestSolution   = "OSPI0_D5";
flash1.serialFlashDriver.peripheralDriver.OSPI.D4.$suggestSolution   = "OSPI0_D4";
flash1.serialFlashDriver.peripheralDriver.OSPI.D3.$suggestSolution   = "OSPI0_D3";
flash1.serialFlashDriver.peripheralDriver.OSPI.D2.$suggestSolution   = "OSPI0_D2";
flash1.serialFlashDriver.peripheralDriver.OSPI.D1.$suggestSolution   = "OSPI0_D1";
flash1.serialFlashDriver.peripheralDriver.OSPI.D0.$suggestSolution   = "OSPI0_D0";
mmcsd1.MMC0.CLK.$suggestSolution                                     = "MMC0_CLK";
mmcsd1.MMC0.CMD.$suggestSolution                                     = "MMC0_CMD";
mmcsd1.MMC0.DAT0.$suggestSolution                                    = "MMC0_DAT0";
mmcsd1.MMC0.DAT1.$suggestSolution                                    = "MMC0_DAT1";
mmcsd1.MMC0.DAT2.$suggestSolution                                    = "MMC0_DAT2";
mmcsd1.MMC0.DAT3.$suggestSolution                                    = "MMC0_DAT3";
mmcsd1.MMC0.DAT4.$suggestSolution                                    = "MMC0_DAT4";
mmcsd1.MMC0.DAT5.$suggestSolution                                    = "MMC0_DAT5";
mmcsd1.MMC0.DAT6.$suggestSolution                                    = "MMC0_DAT6";
mmcsd1.MMC0.DAT7.$suggestSolution                                    = "MMC0_DAT7";
debug_log.uartLog.WKUP_UART.$suggestSolution     = "WKUP_USART0";
debug_log.uartLog.WKUP_UART.RXD.$suggestSolution = "WKUP_UART0_RXD";
debug_log.uartLog.WKUP_UART.TXD.$suggestSolution = "WKUP_UART0_TXD";
uart1.UART.RXD.$suggestSolution                  = "UART0_RXD";
uart1.UART.TXD.$suggestSolution                  = "UART0_TXD";
