/**
 * @cliArgs --device "AM62x" --package "ALW" --part "Default" --context "a53ss0-0" --product "MCU_PLUS_SDK@07.03.01"
 * @versions {"tool":"1.20.0+3587"}
 */

/**
 * Import the modules used in this configuration.
 */
const debug_log  = scripting.addModule("/kernel/dpl/debug_log");
const mmu_armv8  = scripting.addModule("/kernel/dpl/mmu_armv8", {}, false);
const mmu_armv81 = mmu_armv8.addInstance();
const mmu_armv82 = mmu_armv8.addInstance();
const mmu_armv83 = mmu_armv8.addInstance();
const mmu_armv84 = mmu_armv8.addInstance();
const mmu_armv85 = mmu_armv8.addInstance();

/**
 * Write custom configuration values to the imported modules.
 */
debug_log.enableUartLog            = true;
debug_log.uartTrace                = true;
debug_log.enableSharedMemLogReader = true;
debug_log.uartLog.$name            = "CONFIG_UART_CONSOLE";
debug_log.uartLog.UART.$assign     = "USART0";

mmu_armv81.size  = 0x80000000;
mmu_armv81.$name = "SOC_MEM_REGION";

mmu_armv82.attribute = "MAIR7";
mmu_armv82.$name     = "DDR_REGION";
mmu_armv82.vAddr     = 0x80080000;
mmu_armv82.pAddr     = 0x80080000;
mmu_armv82.size      = 0x2000000;

mmu_armv83.$name     = "LOG_SHM_MEM";
mmu_armv83.vAddr     = 0xA1000000;
mmu_armv83.pAddr     = 0xA1000000;
mmu_armv83.size      = 0x40000;
mmu_armv83.attribute = "MAIR4";

mmu_armv84.vAddr     = 0x99000000;
mmu_armv84.pAddr     = 0x99000000;
mmu_armv84.size      = 0x4000;
mmu_armv84.attribute = "MAIR7";
mmu_armv84.$name     = "AMP_SHM";

mmu_armv85.vAddr             = 0x80000000;
mmu_armv85.pAddr             = 0x80000000;
mmu_armv85.size              = 0x80000;
mmu_armv85.accessPermissions = "Privilege RO, User None";
mmu_armv85.shareable         = "Non Shareable";
mmu_armv85.$name             = "ATF_REGION";

/**
 * Pinmux solution for unlocked pins/peripherals. This ensures that minor changes to the automatic solver in a future
 * version of the tool will not impact the pinmux you originally saw.  These lines can be completely deleted in order to
 * re-solve from scratch.
 */
debug_log.uartLog.UART.RXD.$suggestSolution = "UART0_RXD";
debug_log.uartLog.UART.TXD.$suggestSolution = "UART0_TXD";
