/**
 * @cliArgs --device "AM62Px" --package "AMH" --part "Default" --context "wkup-r5fss0-0" --product "MCU_PLUS_SDK@07.03.01"
 * @versions {"tool":"1.18.0+3266"}
 */

/**
 * Import the modules used in this configuration.
 *
 * NOTE: flash / bootloader / udma modules removed intentionally.
 * This binary is loaded by SBL UART — it does not boot Linux or load from
 * flash.  Keeping those modules caused SysConfig to add A53SS0_0 as an IPC
 * notify peer, which made the test framework time out waiting for a result
 * from Linux (which does not participate in the bare-metal test).
 */
const gtc       = scripting.addModule("/drivers/gtc/gtc");
const ipc       = scripting.addModule("/drivers/ipc/ipc");
const clock     = scripting.addModule("/kernel/dpl/clock");
const debug_log = scripting.addModule("/kernel/dpl/debug_log");
const mpu_armv7   = scripting.addModule("/kernel/dpl/mpu_armv7", {}, false);
const mpu_armv71  = mpu_armv7.addInstance();
const mpu_armv72  = mpu_armv7.addInstance();
const mpu_armv73  = mpu_armv7.addInstance();
const mpu_armv74  = mpu_armv7.addInstance();
const mpu_armv75  = mpu_armv7.addInstance();
const mpu_armv76  = mpu_armv7.addInstance();
const mpu_armv77  = mpu_armv7.addInstance();
const mpu_armv78  = mpu_armv7.addInstance();
const mpu_armv79  = mpu_armv7.addInstance();
const mpu_armv710 = mpu_armv7.addInstance();

/**
 * Write custom configuration values to the imported modules.
 */

/* IPC: only MCU R5F participates in the system test (notify only, no Linux). */
ipc.vringAllocationPDK = false;
ipc.enableLinuxIpc     = false;
ipc.mcu_r5fss0_0       = "notify";

debug_log.enableUartLog      = true;
debug_log.uartTrace          = true;
debug_log.uartLog.intrEnable = "DISABLE";
debug_log.uartLog.$name      = "CONFIG_UART_APP";

mpu_armv71.accessPermissions = "Supervisor RD+WR, User RD";
mpu_armv71.allowExecute      = false;
mpu_armv71.size              = 31;
mpu_armv71.attributes        = "Device";
mpu_armv71.$name             = "REGISTER_REGION";

mpu_armv72.accessPermissions = "Supervisor RD+WR, User RD";
mpu_armv72.size              = 7;
mpu_armv72.$name             = "TCMA_VEC";

mpu_armv73.$name    = "DDR";
mpu_armv73.baseAddr = 0x80000000;
mpu_armv73.size     = 31;

mpu_armv74.baseAddr   = 0x41010000;
mpu_armv74.size       = 15;
mpu_armv74.attributes = "NonCached";
mpu_armv74.$name      = "TCMB";

mpu_armv75.size       = 15;
mpu_armv75.attributes = "NonCached";
mpu_armv75.$name      = "TCMA";

mpu_armv76.baseAddr = 0x43C00000;
mpu_armv76.size     = 18;
mpu_armv76.$name    = "HSM_RAM";

mpu_armv77.$name        = "RTOS_NORTOS_IPC_VRING1";
mpu_armv77.baseAddr     = 0x9B500000;
mpu_armv77.allowExecute = false;
mpu_armv77.attributes   = "NonCached";
mpu_armv77.size         = 20;

mpu_armv78.$name        = "RTOS_NORTOS_IPC_VRING2";
mpu_armv78.baseAddr     = 0x9B600000;
mpu_armv78.size         = 21;
mpu_armv78.allowExecute = false;
mpu_armv78.attributes   = "NonCached";

mpu_armv79.$name        = "UART0_REG";
mpu_armv79.baseAddr     = 0x2800000;
mpu_armv79.size         = 9;
mpu_armv79.attributes   = "Device";
mpu_armv79.allowExecute = false;

mpu_armv710.$name        = "WKUP_UART0_REG";
mpu_armv710.baseAddr     = 0x2B00000;
mpu_armv710.size         = 9;
mpu_armv710.attributes   = "Device";
mpu_armv710.allowExecute = false;

/**
 * Pinmux solution for unlocked pins/peripherals.
 */
debug_log.uartLog.WKUP_UART.$suggestSolution     = "WKUP_USART0";
debug_log.uartLog.WKUP_UART.RXD.$suggestSolution = "WKUP_UART0_RXD";
debug_log.uartLog.WKUP_UART.TXD.$suggestSolution = "WKUP_UART0_TXD";
