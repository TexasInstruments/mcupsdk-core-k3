/**
 * @cliArgs --device "AM275x" --part "AM2754" --package "ANJ" --context "r5fss0-1" --product "MCU_PLUS_SDK@07.03.01"
 * @versions {"tool":"1.22.0+3893"}
 */

/**
 * Import the modules used in this configuration.
 */
const ecap       = scripting.addModule("/drivers/ecap/ecap", {}, false);
const ecap1      = ecap.addInstance();
const ecap2      = ecap.addInstance();
const ecap3      = ecap.addInstance();
const epwm       = scripting.addModule("/drivers/epwm/epwm", {}, false);
const epwm1      = epwm.addInstance();
const epwm2      = epwm.addInstance();
const ipc        = scripting.addModule("/drivers/ipc/ipc");
const debug_log  = scripting.addModule("/kernel/dpl/debug_log");
const mpu_armv7  = scripting.addModule("/kernel/dpl/mpu_armv7", {}, false);
const mpu_armv71 = mpu_armv7.addInstance();
const mpu_armv72 = mpu_armv7.addInstance();
const mpu_armv73 = mpu_armv7.addInstance();
const mpu_armv74 = mpu_armv7.addInstance();
const mpu_armv75 = mpu_armv7.addInstance();
const mpu_armv76 = mpu_armv7.addInstance();
const mpu_armv77 = mpu_armv7.addInstance();

/**
 * Write custom configuration values to the imported modules.
 */
ecap1.$name                    = "CONFIG_ECAP1";
ecap1.ECAP.IN_APWM_OUT.$assign = "SPI1_D0";

ecap2.$name                    = "CONFIG_ECAP0";
ecap2.ECAP.$assign             = "ECAP1";
ecap2.ECAP.IN_APWM_OUT.$assign = "SPI2_D0";

ecap3.$name                    = "CONFIG_ECAP2";
ecap3.ECAP.$assign             = "ECAP3";
ecap3.ECAP.IN_APWM_OUT.$assign = "SPI1_D1";

epwm1.$name            = "CONFIG_EPWM0";
epwm1.EPWM.$assign     = "EPWM0";
epwm1.EPWM.A.$assign   = "SPI0_CS0";
epwm1.EPWM.B.$used     = false;
epwm1.EPWM.SYNCO.$used = false;
epwm1.EPWM.SYNCI.$used = false;

epwm2.$name            = "CONFIG_EPWM1";
epwm2.EPWM.$assign     = "EPWM1";
epwm2.EPWM.A.$assign   = "SPI0_CLK";
epwm2.EPWM.B.$used     = false;
epwm2.EPWM.SYNCO.$used = false;
epwm2.EPWM.SYNCI.$used = false;

ipc.wkup_r5fss0_0 = "NONE";
ipc.r5fss0_0      = "notify";
ipc.r5fss1_0      = "notify";
ipc.r5fss1_1      = "notify";
ipc.c75ss0_0      = "notify";
ipc.c75ss1_0      = "notify";

debug_log.enableSharedMemLog = true;

mpu_armv71.size         = 31;
mpu_armv71.attributes   = "Device";
mpu_armv71.allowExecute = false;
mpu_armv71.$name        = "REGISTERS";

mpu_armv72.size  = 15;
mpu_armv72.$name = "TCMA";

mpu_armv73.baseAddr = 0x41010000;
mpu_armv73.size     = 15;
mpu_armv73.$name    = "TCMB";

mpu_armv74.$name    = "MSRAM_BANK0_TO_BANK3";
mpu_armv74.baseAddr = 0x72000000;
mpu_armv74.size     = 22;

mpu_armv75.$name    = "MSRAM_BANK4_TO_BANK5";
mpu_armv75.baseAddr = 0x72400000;
mpu_armv75.size     = 21;

mpu_armv76.$name        = "LOG_SHM_MEM";
mpu_armv76.baseAddr     = 0x72380000;
mpu_armv76.size         = 18;
mpu_armv76.allowExecute = false;
mpu_armv76.attributes   = "NonCached";

mpu_armv77.$name      = "IPC_VRING_RTOS";
mpu_armv77.baseAddr   = 0x723C0000;
mpu_armv77.size       = 16;
mpu_armv77.attributes = "NonCached";

ecap1.ECAP.$suggestSolution                 = "ECAP2";
