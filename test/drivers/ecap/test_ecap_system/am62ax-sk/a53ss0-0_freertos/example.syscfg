/**
 * @cliArgs --device "AM62Ax" --part "Default" --package "AMB" --context "a53ss0-0" --product "MCU_PLUS_SDK@07.03.01"
 * @versions {"tool":"1.24.0+4150"}
 */

/**
 * Import the modules used in this configuration.
 */
const ecap       = scripting.addModule("/drivers/ecap/ecap", {}, false);
const ecap1      = ecap.addInstance();
const ecap2      = ecap.addInstance();
const ecap3      = ecap.addInstance();
const epwm       = scripting.addModule("/drivers/epwm/epwm", {}, false);
const epwm1      = epwm.addInstance();
const epwm2      = epwm.addInstance();
const ipc        = scripting.addModule("/drivers/ipc/ipc");
const debug_log  = scripting.addModule("/kernel/dpl/debug_log");
const mmu_armv8  = scripting.addModule("/kernel/dpl/mmu_armv8", {}, false);
const mmu_armv81 = mmu_armv8.addInstance();
const mmu_armv82 = mmu_armv8.addInstance();
const mmu_armv83 = mmu_armv8.addInstance();
const mmu_armv84 = mmu_armv8.addInstance();

/**
 * Write custom configuration values to the imported modules.
 */
ecap1.$name                    = "CONFIG_ECAP1";
ecap1.ECAP.IN_APWM_OUT.$assign = "EXT_REFCLK1";

ecap2.$name                    = "CONFIG_ECAP0";
ecap2.ECAP.$assign             = "ECAP1";
ecap2.ECAP.IN_APWM_OUT.$assign = "I2C0_SCL";

ecap3.$name                    = "CONFIG_ECAP2";
ecap3.ECAP.IN_APWM_OUT.$assign = "MMC1_DAT0";

epwm1.$name            = "CONFIG_EPWM1";
epwm1.EPWM.A.rx        = true;
epwm1.EPWM.A.$assign   = "SPI0_CS0";
epwm1.EPWM.B.$used     = false;
epwm1.EPWM.SYNCO.$used = false;
epwm1.EPWM.SYNCI.rx    = false;
epwm1.EPWM.SYNCI.$used = false;

epwm2.$name            = "CONFIG_EPWM0";
epwm2.EPWM.A.$assign   = "SPI0_CLK";
epwm2.EPWM.B.$used     = false;
epwm2.EPWM.SYNCO.$used = false;
epwm2.EPWM.SYNCI.$used = false;

ipc.enableLinuxIpc = false;
ipc.r5fss0_0       = "notify";
ipc.mcu_r5fss0_0   = "notify";
ipc.c75ss0_0       = "notify";

debug_log.enableSharedMemLog = true;

mmu_armv81.$name = "CONFIG_MMU_REGION0";
mmu_armv81.size  = 0x80000000;

mmu_armv82.$name     = "CONFIG_MMU_REGION1";
mmu_armv82.vAddr     = 0x70000000;
mmu_armv82.pAddr     = 0x70000000;
mmu_armv82.size      = 0x200000;
mmu_armv82.attribute = "MAIR7";

mmu_armv83.$name     = "CONFIG_MMU_REGION2";
mmu_armv83.vAddr     = 0x80000000;
mmu_armv83.pAddr     = 0x80000000;
mmu_armv83.size      = 0x80000000;
mmu_armv83.attribute = "MAIR7";

mmu_armv84.$name     = "CONFIG_MMU_REGION3";
mmu_armv84.vAddr     = 0xA1000000;
mmu_armv84.pAddr     = 0xA1000000;
mmu_armv84.size      = 0x40000;
mmu_armv84.attribute = "MAIR4";

/**
 * Pinmux solution for unlocked pins/peripherals. This ensures that minor changes to the automatic solver in a future
 * version of the tool will not impact the pinmux you originally saw.  These lines can be completely deleted in order to
 * re-solve from scratch.
 */
ecap1.ECAP.$suggestSolution                 = "ECAP0";
ecap3.ECAP.$suggestSolution                 = "ECAP2";
epwm1.EPWM.$suggestSolution                 = "EHRPWM0";
epwm2.EPWM.$suggestSolution                 = "EHRPWM1";
