/**
 * These arguments were used when this file was generated. They will be automatically applied on subsequent loads
 * via the GUI or CLI. Run CLI with '--help' for additional information on how to override these arguments.
 * @cliArgs --device "AM62Dx" --package "AMB" --part "Default" --context "a53ss0-0" --product "MCU_PLUS_SDK@07.03.01"
 * @versions {"tool":"1.18.0+3266"}
 */

/**
 * Import the modules used in this configuration.
 */
const eqep            = scripting.addModule("/drivers/eqep/eqep", {}, false);
const eqep1           = eqep.addInstance();
const eqep2           = eqep.addInstance();
const eqep3           = eqep.addInstance();
const gpio            = scripting.addModule("/drivers/gpio/gpio", {}, false);
const gpio1           = gpio.addInstance();
const gpio2           = gpio.addInstance();
const gpio3           = gpio.addInstance();
const gpio4           = gpio.addInstance();
const addr_translate  = scripting.addModule("/kernel/dpl/addr_translate", {}, false);
const addr_translate1 = addr_translate.addInstance();
const clock           = scripting.addModule("/kernel/dpl/clock");
const debug_log       = scripting.addModule("/kernel/dpl/debug_log");
const mmu_armv8       = scripting.addModule("/kernel/dpl/mmu_armv8", {}, false);
const mmu_armv81      = mmu_armv8.addInstance();
const mmu_armv82      = mmu_armv8.addInstance();

/**
 * Write custom configuration values to the imported modules.
 */
eqep1.$name          = "CONFIG_EQEP0";
eqep1.EQEP.$assign   = "EQEP2";
eqep1.EQEP.S.$assign = "MCAN0_RX";

eqep2.$name = "CONFIG_EQEP1";

eqep3.$name = "CONFIG_EQEP2";

gpio1.$name        = "CONFIG_GPIO0";
gpio1.pinDir       = "OUTPUT";
gpio1.GPIO.$assign = "GPMC0_WAIT1";

gpio2.$name        = "CONFIG_GPIO1";
gpio2.pinDir       = "OUTPUT";
gpio2.GPIO.$assign = "GPMC0_WPn";

gpio3.$name        = "CONFIG_GPIO2";
gpio3.pinDir       = "OUTPUT";
gpio3.GPIO.$assign = "GPMC0_ADVn_ALE";

gpio4.$name        = "CONFIG_GPIO3";
gpio4.pinDir       = "OUTPUT";
gpio4.GPIO.$assign = "GPMC0_OEn_REn";

addr_translate1.$name = "CONFIG_ADDR_TRANSLATE_REGION0";

debug_log.enableUartLog        = true;
debug_log.uartLog.$name        = "CONFIG_UART0";
debug_log.uartLog.UART.$assign = "USART0";

mmu_armv81.size  = 0x80000000;
mmu_armv81.$name = "SOC_MEM_REGION";

mmu_armv82.$name     = "DDR_REGION";
mmu_armv82.vAddr     = 0x80000000;
mmu_armv82.pAddr     = 0x80000000;
mmu_armv82.size      = 0x80000000;
mmu_armv82.attribute = "MAIR7";

/**
 * Pinmux solution for unlocked pins/peripherals. This ensures that minor changes to the automatic solver in a future
 * version of the tool will not impact the pinmux you originally saw.  These lines can be completely deleted in order to
 * re-solve from scratch.
 */
eqep1.EQEP.A.$suggestSolution               = "I2C0_SCL";
eqep1.EQEP.B.$suggestSolution               = "I2C0_SDA";
eqep1.EQEP.I.$suggestSolution               = "MCAN0_TX";
eqep2.EQEP.$suggestSolution                 = "EQEP1";
eqep2.EQEP.A.$suggestSolution               = "MCASP0_ACLKX";
eqep2.EQEP.B.$suggestSolution               = "MCASP0_AFSX";
eqep2.EQEP.I.$suggestSolution               = "MCASP0_ACLKR";
eqep2.EQEP.S.$suggestSolution               = "MCASP0_AFSR";
eqep3.EQEP.$suggestSolution                 = "EQEP0";
eqep3.EQEP.A.$suggestSolution               = "MCASP0_AXR3";
eqep3.EQEP.B.$suggestSolution               = "MCASP0_AXR2";
eqep3.EQEP.I.$suggestSolution               = "MCASP0_AXR0";
eqep3.EQEP.S.$suggestSolution               = "MCASP0_AXR1";
debug_log.uartLog.UART.RXD.$suggestSolution = "UART0_RXD";
debug_log.uartLog.UART.TXD.$suggestSolution = "UART0_TXD";
