/**
 * @cliArgs --device "AM62Lx" --part "AM62L32-G-ANB" --package "ANB" --context "a53ss0-0" --product "MCU_PLUS_SDK@07.03.01"
 * @versions {"tool":"1.21.999+170"}
 */

/**
 * Import the modules used in this configuration.
 */
const eqep       = scripting.addModule("/drivers/eqep/eqep", {}, false);
const eqep1      = eqep.addInstance();
const eqep2      = eqep.addInstance();
const eqep3      = eqep.addInstance();
const gpio       = scripting.addModule("/drivers/gpio/gpio", {}, false);
const gpio1      = gpio.addInstance();
const gpio2      = gpio.addInstance();
const gpio3      = gpio.addInstance();
const gpio4      = gpio.addInstance();
const i2c        = scripting.addModule("/drivers/i2c/i2c", {}, false);
const i2c1       = i2c.addInstance();
const clock      = scripting.addModule("/kernel/dpl/clock");
const debug_log  = scripting.addModule("/kernel/dpl/debug_log");
const mmu_armv8  = scripting.addModule("/kernel/dpl/mmu_armv8", {}, false);
const mmu_armv81 = mmu_armv8.addInstance();
const mmu_armv82 = mmu_armv8.addInstance();

/**
 * Write custom configuration values to the imported modules.
 */
eqep1.$name          = "CONFIG_EQEP0";
eqep1.EQEP.$assign   = "EQEP0";
eqep1.EQEP.A.$assign = "GPMC0_BE0n_CLE";
eqep1.EQEP.B.$assign = "GPMC0_BE1n";
eqep1.EQEP.I.$assign = "GPMC0_WAIT1";
eqep1.EQEP.S.$assign = "GPMC0_WAIT0";

eqep2.$name          = "CONFIG_EQEP1";
eqep2.EQEP.$assign   = "EQEP1";
eqep2.EQEP.A.$assign = "GPMC0_WPn";
eqep2.EQEP.B.$assign = "GPMC0_DIR";
eqep2.EQEP.I.$assign = "GPMC0_CSn1";
eqep2.EQEP.S.$assign = "GPMC0_CSn0";

eqep3.$name        = "CONFIG_EQEP2";
eqep3.EQEP.$assign = "EQEP2";

gpio1.$name        = "CONFIG_GPIO0";
gpio1.pinDir       = "OUTPUT";
gpio1.GPIO.$assign = "GPMC0_AD3";

gpio2.$name        = "CONFIG_GPIO1";
gpio2.pinDir       = "OUTPUT";
gpio2.GPIO.$assign = "GPMC0_AD4";

gpio3.$name        = "CONFIG_GPIO2";
gpio3.pinDir       = "OUTPUT";
gpio3.GPIO.$assign = "GPMC0_AD5";

gpio4.$name        = "CONFIG_GPIO3";
gpio4.pinDir       = "OUTPUT";
gpio4.GPIO.$assign = "GPMC0_AD6";

i2c1.$name           = "CONFIG_I2C0";
i2c1.I2C.$assign     = "I2C1";
i2c1.I2C_child.$name = "drivers_i2c_v0_i2c_v0_template0";

debug_log.enableUartLog        = true;
debug_log.uartLog.$name        = "CONFIG_UART0";
debug_log.uartLog.UART.$assign = "USART0";

mmu_armv81.size  = 0x80000000;
mmu_armv81.$name = "SOC_MEM_REGION";

mmu_armv82.$name     = "DDR_REGION";
mmu_armv82.vAddr     = 0x80000000;
mmu_armv82.pAddr     = 0x80000000;
mmu_armv82.size      = 0x80000000;
mmu_armv82.attribute = "MAIR7";

/**
 * Pinmux solution for unlocked pins/peripherals. This ensures that minor changes to the automatic solver in a future
 * version of the tool will not impact the pinmux you originally saw.  These lines can be completely deleted in order to
 * re-solve from scratch.
 */
eqep3.EQEP.A.$suggestSolution               = "I2C0_SCL";
eqep3.EQEP.B.$suggestSolution               = "I2C0_SDA";
eqep3.EQEP.I.$suggestSolution               = "MCAN0_TX";
eqep3.EQEP.S.$suggestSolution               = "MCAN0_RX";
i2c1.I2C.SCL.$suggestSolution               = "I2C1_SCL";
i2c1.I2C.SDA.$suggestSolution               = "I2C1_SDA";
debug_log.uartLog.UART.RXD.$suggestSolution = "UART0_RXD";
debug_log.uartLog.UART.TXD.$suggestSolution = "UART0_TXD";
