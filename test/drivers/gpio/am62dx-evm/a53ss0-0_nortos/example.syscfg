/**
 * @cliArgs --device "AM62Dx" --part "AM62D24-G" --package "ANF" --context "a53ss0-0" --product "MCU_PLUS_SDK@07.03.01"
 * @versions {"tool":"1.24.2+4234"}
 */

/**
 * Import the modules used in this configuration.
 */
const gpio       = scripting.addModule("/drivers/gpio/gpio", {}, false);
const gpio1      = gpio.addInstance();
const gpio2      = gpio.addInstance();
const gpio3      = gpio.addInstance();
const gpio4      = gpio.addInstance();
const gpio5      = gpio.addInstance();
const gpio6      = gpio.addInstance();
const gpio7      = gpio.addInstance();
const gpio8      = gpio.addInstance();
const debug_log  = scripting.addModule("/kernel/dpl/debug_log");
const mmu_armv8  = scripting.addModule("/kernel/dpl/mmu_armv8", {}, false);
const mmu_armv81 = mmu_armv8.addInstance();
const mmu_armv82 = mmu_armv8.addInstance();

/**
 * Write custom configuration values to the imported modules.
 */
gpio1.$name        = "GPIO_LED";
gpio1.pinDir       = "OUTPUT";
gpio1.trigType     = "RISE_EDGE";
gpio1.rx           = true;
gpio1.GPIO.$assign = "MMC1_SDWP";

gpio2.$name        = "GPIO_PUSH_BUTTON";
gpio2.trigType     = "RISE_EDGE";
gpio2.rx           = true;
gpio2.GPIO.$assign = "UART0_RTSn";

gpio3.$name        = "GPIO_I2C";
gpio3.pinDir       = "OUTPUT";
gpio3.trigType     = "FALL_EDGE";
gpio3.rx           = true;
gpio3.GPIO.$assign = "I2C0_SCL";

gpio4.$name        = "GPIO_MCAN";
gpio4.pinDir       = "OUTPUT";
gpio4.trigType     = "BOTH_EDGE";
gpio4.rx           = true;
gpio4.GPIO.$assign = "MCAN0_RX";

gpio5.$name        = "GPIO_OSPI_D1";
gpio5.pinDir       = "OUTPUT";
gpio5.trigType     = "RISE_EDGE";
gpio5.GPIO.$assign = "OSPI0_D1";

gpio6.$name        = "GPIO_OSPI_D2";
gpio6.pinDir       = "OUTPUT";
gpio6.trigType     = "FALL_EDGE";
gpio6.GPIO.$assign = "OSPI0_D2";

gpio7.$name        = "GPIO_INPUT";
gpio7.trigType     = "RISE_EDGE";
gpio7.rx           = true;
gpio7.GPIO.$assign = "GPIO0_57";

gpio8.$name        = "GPIO_OUTPUT";
gpio8.pinDir       = "OUTPUT";
gpio8.trigType     = "RISE_EDGE";
gpio8.GPIO.$assign = "GPIO0_58";

debug_log.enableUartLog        = true;
debug_log.uartLog.$name        = "CONFIG_UART_CONSOLE";
debug_log.uartLog.UART.$assign = "USART0";

mmu_armv81.size  = 0x80000000;
mmu_armv81.$name = "REGISTER_REGION";

mmu_armv82.vAddr     = 0x80000000;
mmu_armv82.pAddr     = 0x80000000;
mmu_armv82.size      = 0x80000000;
mmu_armv82.attribute = "MAIR7";
mmu_armv82.$name     = "DDR";

/**
 * Pinmux solution for unlocked pins/peripherals. This ensures that minor changes to the automatic solver in a future
 * version of the tool will not impact the pinmux you originally saw.  These lines can be completely deleted in order to
 * re-solve from scratch.
 */
debug_log.uartLog.UART.RXD.$suggestSolution = "UART0_RXD";
debug_log.uartLog.UART.TXD.$suggestSolution = "UART0_TXD";
