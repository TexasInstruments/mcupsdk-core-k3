/**
 * @cliArgs --device "AM62x" --part "Default" --package "ALW" --context "a53ss0-0" --product "MCU_PLUS_SDK@07.03.01"
 * @versions {"tool":"1.26.2+4477"}
 */

/**
 * Import the modules used in this configuration.
 */
const gpio       = scripting.addModule("/drivers/gpio/gpio", {}, false);
const gpio1      = gpio.addInstance();
const gpio2      = gpio.addInstance();
const gpio3      = gpio.addInstance();
const gpio4      = gpio.addInstance();
const gpio5      = gpio.addInstance();
const gpio6      = gpio.addInstance();
const gpio7      = gpio.addInstance();
const gpio8      = gpio.addInstance();
const gpio9      = gpio.addInstance();
const gpio10     = gpio.addInstance();
const debug_log  = scripting.addModule("/kernel/dpl/debug_log");
const mmu_armv8  = scripting.addModule("/kernel/dpl/mmu_armv8", {}, false);
const mmu_armv81 = mmu_armv8.addInstance();
const mmu_armv82 = mmu_armv8.addInstance();
const mmu_armv83 = mmu_armv8.addInstance();
const mmu_armv84 = mmu_armv8.addInstance();
const mmu_armv85 = mmu_armv8.addInstance();

/**
 * Write custom configuration values to the imported modules.
 */
gpio1.$name  = "GPIO_LED";
gpio1.pinDir = "OUTPUT";
scripting.suppress("Solution may have changed,No suggested solution was provided, so this value may differ from the last time this tool was run", gpio1.GPIO, "$assign");
scripting.suppress("Solution may have changed,No suggested solution was provided, so this value may differ from the last time this tool was run", gpio1.GPIO, "gpioPin");

gpio2.$name    = "GPIO_PUSH_BUTTON";
gpio2.trigType = "RISE_EDGE";
scripting.suppress("Solution may have changed,No suggested solution was provided, so this value may differ from the last time this tool was run", gpio2.GPIO, "$assign");
scripting.suppress("Solution may have changed,No suggested solution was provided, so this value may differ from the last time this tool was run", gpio2.GPIO, "gpioPin");

gpio3.$name    = "GPIO_I2C";
gpio3.pinDir   = "OUTPUT";
gpio3.trigType = "FALL_EDGE";
scripting.suppress("Solution may have changed,No suggested solution was provided, so this value may differ from the last time this tool was run", gpio3.GPIO, "$assign");
scripting.suppress("Solution may have changed,No suggested solution was provided, so this value may differ from the last time this tool was run", gpio3.GPIO, "gpioPin");

gpio4.$name    = "GPIO_MCAN";
gpio4.pinDir   = "OUTPUT";
gpio4.trigType = "BOTH_EDGE";
scripting.suppress("Solution may have changed,No suggested solution was provided, so this value may differ from the last time this tool was run", gpio4.GPIO, "$assign");
scripting.suppress("Solution may have changed,No suggested solution was provided, so this value may differ from the last time this tool was run", gpio4.GPIO, "gpioPin");

gpio5.$name    = "GPIO_OSPI_D1";
gpio5.pinDir   = "OUTPUT";
gpio5.trigType = "RISE_EDGE";
scripting.suppress("Solution may have changed,No suggested solution was provided, so this value may differ from the last time this tool was run", gpio5.GPIO, "$assign");
scripting.suppress("Solution may have changed,No suggested solution was provided, so this value may differ from the last time this tool was run", gpio5.GPIO, "gpioPin");

gpio6.$name    = "GPIO_OSPI_D2";
gpio6.pinDir   = "OUTPUT";
gpio6.trigType = "FALL_EDGE";
scripting.suppress("Solution may have changed,No suggested solution was provided, so this value may differ from the last time this tool was run", gpio6.GPIO, "$assign");
scripting.suppress("Solution may have changed,No suggested solution was provided, so this value may differ from the last time this tool was run", gpio6.GPIO, "gpioPin");

gpio7.$name    = "GPIO_INPUT";
gpio7.trigType = "RISE_EDGE";
scripting.suppress("Solution may have changed,No suggested solution was provided, so this value may differ from the last time this tool was run", gpio7.GPIO, "$assign");
scripting.suppress("Solution may have changed,No suggested solution was provided, so this value may differ from the last time this tool was run", gpio7.GPIO, "gpioPin");

gpio8.$name    = "GPIO_OUTPUT";
gpio8.pinDir   = "OUTPUT";
gpio8.trigType = "RISE_EDGE";
scripting.suppress("Solution may have changed,No suggested solution was provided, so this value may differ from the last time this tool was run", gpio8.GPIO, "$assign");
scripting.suppress("Solution may have changed,No suggested solution was provided, so this value may differ from the last time this tool was run", gpio8.GPIO, "gpioPin");

gpio9.$name = "CONFIG_GPIO0";
scripting.suppress("Solution may have changed,No suggested solution was provided, so this value may differ from the last time this tool was run", gpio9.GPIO, "$assign");
scripting.suppress("Solution may have changed,No suggested solution was provided, so this value may differ from the last time this tool was run", gpio9.GPIO, "gpioPin");

gpio10.$name = "CONFIG_GPIO1";
scripting.suppress("Solution may have changed,No suggested solution was provided, so this value may differ from the last time this tool was run", gpio10.GPIO, "$assign");
scripting.suppress("Solution may have changed,No suggested solution was provided, so this value may differ from the last time this tool was run", gpio10.GPIO, "gpioPin");

debug_log.enableUartLog            = true;
debug_log.enableSharedMemLogReader = true;
debug_log.uartTrace                = true;
debug_log.uartLog.$name            = "CONFIG_UART_CONSOLE";
debug_log.uartLog.UART.$assign     = "USART0";

mmu_armv81.size  = 0x80000000;
mmu_armv81.$name = "SOC_MEM_REGION";

mmu_armv82.attribute = "MAIR7";
mmu_armv82.$name     = "DDR_REGION";
mmu_armv82.size      = 0x2000000;
mmu_armv82.vAddr     = 0x80080000;
mmu_armv82.pAddr     = 0x80080000;

mmu_armv83.$name     = "LOG_SHM_MEM";
mmu_armv83.vAddr     = 0xA1000000;
mmu_armv83.pAddr     = 0xA1000000;
mmu_armv83.size      = 0x40000;
mmu_armv83.attribute = "MAIR4";

mmu_armv84.$name     = "AMP_SHM";
mmu_armv84.vAddr     = 0x99000000;
mmu_armv84.pAddr     = 0x99000000;
mmu_armv84.size      = 0x4000;
mmu_armv84.attribute = "MAIR7";

mmu_armv85.vAddr             = 0x80000000;
mmu_armv85.pAddr             = 0x80000000;
mmu_armv85.size              = 0x80000;
mmu_armv85.$name             = "ATF_REGION";
mmu_armv85.accessPermissions = "Privilege RO, User None";
mmu_armv85.shareable         = "Non Shareable";

/**
 * Pinmux solution for unlocked pins/peripherals. This ensures that minor changes to the automatic solver in a future
 * version of the tool will not impact the pinmux you originally saw.  These lines can be completely deleted in order to
 * re-solve from scratch.
 */
gpio1.GPIO.$suggestSolution                 = "GPIO1";
gpio1.GPIO.gpioPin.$suggestSolution         = "RGMII2_TD3";
gpio2.GPIO.$suggestSolution                 = "GPIO1";
gpio2.GPIO.gpioPin.$suggestSolution         = "MCASP0_AXR1";
gpio3.GPIO.$suggestSolution                 = "GPIO1";
gpio3.GPIO.gpioPin.$suggestSolution         = "MCASP0_AXR2";
gpio4.GPIO.$suggestSolution                 = "GPIO1";
gpio4.GPIO.gpioPin.$suggestSolution         = "MCASP0_AXR3";
gpio5.GPIO.$suggestSolution                 = "GPIO1";
gpio5.GPIO.gpioPin.$suggestSolution         = "RGMII2_RD3";
gpio6.GPIO.$suggestSolution                 = "GPIO1";
gpio6.GPIO.gpioPin.$suggestSolution         = "RGMII2_RD2";
gpio7.GPIO.$suggestSolution                 = "GPIO1";
gpio7.GPIO.gpioPin.$suggestSolution         = "RGMII2_RD1";
gpio8.GPIO.$suggestSolution                 = "GPIO1";
gpio8.GPIO.gpioPin.$suggestSolution         = "RGMII2_RD0";
gpio9.GPIO.$suggestSolution                 = "GPIO1";
gpio9.GPIO.gpioPin.$suggestSolution         = "RGMII2_RXC";
gpio10.GPIO.$suggestSolution                = "GPIO1";
gpio10.GPIO.gpioPin.$suggestSolution        = "RGMII2_RX_CTL";
debug_log.uartLog.UART.RXD.$suggestSolution = "UART0_RXD";
debug_log.uartLog.UART.TXD.$suggestSolution = "UART0_TXD";
