/**
 * @cliArgs --device "AM62Ax" --package "ANF" --part "AM62D24-G" --context "r5fss0-0" --product "MCU_PLUS_SDK@07.03.01"
 * @versions {"tool":"1.24.2+4234"}
 */

/**
 * Import the modules used in this configuration.
 */
const gpio       = scripting.addModule("/drivers/gpio/gpio", {}, false);
const gpio1      = gpio.addInstance();
const gpio2      = gpio.addInstance();
const gpio3      = gpio.addInstance();
const gpio4      = gpio.addInstance();
const gpio5      = gpio.addInstance();
const gpio6      = gpio.addInstance();
const gpio7      = gpio.addInstance();
const gpio8      = gpio.addInstance();
const ipc         = scripting.addModule("/drivers/ipc/ipc");
const uart        = scripting.addModule("/drivers/uart/uart", {}, false);
const uart1       = uart.addInstance();
const clock       = scripting.addModule("/kernel/dpl/clock");
const debug_log   = scripting.addModule("/kernel/dpl/debug_log");
const mpu_armv7   = scripting.addModule("/kernel/dpl/mpu_armv7", {}, false);
const mpu_armv71  = mpu_armv7.addInstance();
const mpu_armv72  = mpu_armv7.addInstance();
const mpu_armv73  = mpu_armv7.addInstance();
const mpu_armv74  = mpu_armv7.addInstance();
const mpu_armv75  = mpu_armv7.addInstance();
const mpu_armv76  = mpu_armv7.addInstance();
const mpu_armv77  = mpu_armv7.addInstance();
const mpu_armv78  = mpu_armv7.addInstance();
const mpu_armv79  = mpu_armv7.addInstance();
const mpu_armv710 = mpu_armv7.addInstance();
const mpu_armv711 = mpu_armv7.addInstance();
const mpu_armv712 = mpu_armv7.addInstance();

/**
 * Write custom configuration values to the imported modules.
 */
gpio1.$name        = "GPIO_LED";
gpio1.pinDir       = "OUTPUT";
gpio1.trigType     = "RISE_EDGE";
gpio1.rx           = true;
gpio1.GPIO.$assign = "MMC1_SDWP";

gpio2.$name        = "GPIO_PUSH_BUTTON";
gpio2.trigType     = "RISE_EDGE";
gpio2.rx           = true;
gpio2.GPIO.$assign = "UART0_RTSn";

gpio3.$name        = "GPIO_I2C";
gpio3.trigType     = "FALL_EDGE";
gpio3.pinDir       = "OUTPUT";
gpio3.rx           = true;
gpio3.GPIO.$assign = "I2C0_SCL";

gpio4.$name        = "GPIO_MCAN";
gpio4.pinDir       = "OUTPUT";
gpio4.trigType     = "BOTH_EDGE";
gpio4.rx           = true;
gpio4.GPIO.$assign = "MCAN0_RX";

gpio5.$name    = "GPIO_OSPI_D1";
gpio5.pinDir   = "OUTPUT";
gpio5.trigType = "RISE_EDGE";

gpio6.$name    = "GPIO_OSPI_D2";
gpio6.pinDir   = "OUTPUT";
gpio6.trigType = "FALL_EDGE";

gpio7.$name        = "GPIO_INPUT";
gpio7.trigType     = "RISE_EDGE";
gpio7.rx           = true;
gpio7.GPIO.$assign = "GPIO0_57";

gpio8.$name        = "GPIO_OUTPUT";
gpio8.pinDir       = "OUTPUT";
gpio8.trigType     = "RISE_EDGE";
gpio8.GPIO.$assign = "GPIO0_58";
ipc.mcu_r5fss0_0   = "notify";
ipc.enableLinuxIpc = false;
ipc.a53ss0_0       = "notify";
ipc.c75ss0_0       = "notify";
uart1.$name                      = "CONFIG_UART_SBL";
uart1.useWakeupDomainPeripherals = false;
uart1.intrEnable                 = "DISABLE";

debug_log.enableUartLog            = true;
debug_log.enableSharedMemLog       = true;
debug_log.enableSharedMemLogReader = true;
debug_log.enableCssLog             = false;
debug_log.uartTrace                = true;
debug_log.uartLog.$name            = "CONFIG_UART0";

mpu_armv71.accessPermissions = "Supervisor RD+WR, User RD";
mpu_armv71.allowExecute      = false;
mpu_armv71.size              = 31;
mpu_armv71.attributes        = "Device";
mpu_armv71.$name             = "REGISTER_REGION";

mpu_armv72.accessPermissions = "Supervisor RD+WR, User RD";
mpu_armv72.size              = 7;
mpu_armv72.$name             = "TCMA_VEC";

mpu_armv73.$name             = "CONFIG_MPU_REGION2";
mpu_armv73.accessPermissions = "Supervisor RD+WR, User RD";
mpu_armv73.baseAddr          = 0x41C00000;
mpu_armv73.size              = 19;

mpu_armv74.$name             = "CONFIG_MPU_REGION3";
mpu_armv74.accessPermissions = "Supervisor RD+WR, User RD";
mpu_armv74.baseAddr          = 0x70000000;
mpu_armv74.size              = 16;

mpu_armv75.$name    = "DDR";
mpu_armv75.baseAddr = 0x80000000;
mpu_armv75.size     = 31;

mpu_armv76.baseAddr   = 0x41010000;
mpu_armv76.size       = 15;
mpu_armv76.attributes = "NonCached";
mpu_armv76.$name      = "TCMB";

mpu_armv77.size       = 15;
mpu_armv77.attributes = "NonCached";
mpu_armv77.$name      = "TCMA";

mpu_armv78.baseAddr = 0x43C00000;
mpu_armv78.size     = 18;
mpu_armv78.$name    = "HSM_RAM";

mpu_armv79.$name      = "RING_BUFFER";
mpu_armv79.baseAddr   = 0x9C800000;
mpu_armv79.attributes = "NonCached";
mpu_armv79.size       = 21;

mpu_armv710.attributes   = "NonCached";
mpu_armv710.size         = 20;
mpu_armv710.allowExecute = false;
mpu_armv710.$name        = "RESOURCE_TABLE";
mpu_armv710.baseAddr     = 0x9D900000;

mpu_armv711.$name        = "RTOS_NORTOS_IPC_VRING";
mpu_armv711.baseAddr     = 0xA0000000;
mpu_armv711.size         = 23;
mpu_armv711.allowExecute = false;
mpu_armv711.attributes   = "NonCached";

mpu_armv712.$name      = "LOG_SHM_MEM";
mpu_armv712.baseAddr   = 0xA1000000;
mpu_armv712.attributes = "NonCached";
mpu_armv712.size       = 18;

/**
 * Pinmux solution for unlocked pins/peripherals. This ensures that minor changes to the automatic solver in a future
 * version of the tool will not impact the pinmux you originally saw.  These lines can be completely deleted in order to
 * re-solve from scratch.
 */
gpio5.GPIO.$suggestSolution                      = "OSPI0_CLK";
gpio6.GPIO.$suggestSolution                      = "OSPI0_LBCLKO";
uart1.UART.$suggestSolution                                          = "USART0";
uart1.UART.RXD.$suggestSolution                                      = "UART0_RXD";
uart1.UART.TXD.$suggestSolution                                      = "UART0_TXD";
debug_log.uartLog.WKUP_UART.$suggestSolution     = "WKUP_USART0";
debug_log.uartLog.WKUP_UART.RXD.$suggestSolution = "WKUP_UART0_RXD";
debug_log.uartLog.WKUP_UART.TXD.$suggestSolution = "WKUP_UART0_TXD";
