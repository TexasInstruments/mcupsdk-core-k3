/**
 * @cliArgs --device "AM62x" --package "AMC" --part "Default" --context "r5fss0-0" --product "MCU_PLUS_SDK@07.03.01"
 * @versions {"tool":"1.18.0+3266"}
 */

/**
 * Import the modules used in this configuration.
 */
const flash      = scripting.addModule("/board/flash/flash", {}, false);
const flash1     = flash.addInstance();
const clock      = scripting.addModule("/kernel/dpl/clock");
const debug_log  = scripting.addModule("/kernel/dpl/debug_log");
const mpu_armv7  = scripting.addModule("/kernel/dpl/mpu_armv7", {}, false);
const mpu_armv71 = mpu_armv7.addInstance();
const mpu_armv72 = mpu_armv7.addInstance();
const mpu_armv73 = mpu_armv7.addInstance();
const mpu_armv74 = mpu_armv7.addInstance();
const mpu_armv75 = mpu_armv7.addInstance();
const mpu_armv76 = mpu_armv7.addInstance();
const mpu_armv77 = mpu_armv7.addInstance();
const mpu_armv78 = mpu_armv7.addInstance();

/**
 * Write custom configuration values to the imported modules.
 */
flash1.$name                                      = "CONFIG_FLASH0";
flash1.flashTopology                              = "parallelFlash";
flash1.parallelFlashDriver.$name                  = "board_flash_parallelFlash_parallelflash0";
flash1.parallelFlashDriver.peripheralDriver.$name = "CONFIG_GPMC0";

const udma                                             = scripting.addModule("/drivers/udma/udma", {}, false);
const udma1                                            = udma.addInstance({}, false);
udma1.$name                                            = "CONFIG_UDMA0";
flash1.parallelFlashDriver.peripheralDriver.udmaDriver = udma1;

const udma_blkcopy_channel                                     = scripting.addModule("/drivers/udma/udma_blkcopy_channel", {}, false);
const udma_blkcopy_channel1                                    = udma_blkcopy_channel.addInstance({}, false);
udma_blkcopy_channel1.$name                                    = "CONFIG_UDMA_BLKCOPY_CH0";
flash1.parallelFlashDriver.peripheralDriver.udmaBlkCopyChannel = udma_blkcopy_channel1;

clock.instance = "TIMER1";

debug_log.enableUartLog      = true;
debug_log.uartTrace          = true;
debug_log.uartLog.$name      = "CONFIG_UART0";
debug_log.uartLog.intrEnable = "DISABLE";

mpu_armv71.allowExecute = false;
mpu_armv71.size         = 31;
mpu_armv71.attributes   = "Device";
mpu_armv71.$name        = "REGISTER_REGION";

mpu_armv72.accessPermissions = "Supervisor RD+WR, User RD";
mpu_armv72.size              = 7;
mpu_armv72.$name             = "TCMA_VEC";

mpu_armv73.$name             = "CONFIG_MPU_REGION2";
mpu_armv73.accessPermissions = "Supervisor RD+WR, User RD";
mpu_armv73.baseAddr          = 0x41C00000;
mpu_armv73.size              = 19;

mpu_armv74.$name             = "CONFIG_MPU_REGION3";
mpu_armv74.accessPermissions = "Supervisor RD+WR, User RD";
mpu_armv74.baseAddr          = 0x70000000;
mpu_armv74.size              = 16;

mpu_armv75.baseAddr = 0x80000000;
mpu_armv75.size     = 31;
mpu_armv75.$name    = "DDR";

mpu_armv76.baseAddr   = 0x41010000;
mpu_armv76.size       = 15;
mpu_armv76.attributes = "NonCached";
mpu_armv76.$name      = "TCMB";

mpu_armv77.size       = 15;
mpu_armv77.attributes = "NonCached";
mpu_armv77.$name      = "TCMA";

mpu_armv78.baseAddr = 0x43C00000;
mpu_armv78.size     = 18;
mpu_armv78.$name    = "HSM_RAM";

/**
 * Pinmux solution for unlocked pins/peripherals. This ensures that minor changes to the automatic solver in a future
 * version of the tool will not impact the pinmux you originally saw.  These lines can be completely deleted in order to
 * re-solve from scratch.
 */
flash1.parallelFlashDriver.peripheralDriver.GPMC.$suggestSolution          = "GPMC0";
flash1.parallelFlashDriver.peripheralDriver.GPMC.OEn_REn.$suggestSolution  = "GPMC0_OEn_REn";
flash1.parallelFlashDriver.peripheralDriver.GPMC.ADVn_ALE.$suggestSolution = "GPMC0_ADVn_ALE";
flash1.parallelFlashDriver.peripheralDriver.GPMC.WEn.$suggestSolution      = "GPMC0_WEn";
flash1.parallelFlashDriver.peripheralDriver.GPMC.BE0n_CLE.$suggestSolution = "GPMC0_BE0n_CLE";
flash1.parallelFlashDriver.peripheralDriver.GPMC.CSn0.$suggestSolution     = "GPMC0_CSn0";
flash1.parallelFlashDriver.peripheralDriver.GPMC.AD0.$suggestSolution      = "GPMC0_AD0";
flash1.parallelFlashDriver.peripheralDriver.GPMC.AD1.$suggestSolution      = "GPMC0_AD1";
flash1.parallelFlashDriver.peripheralDriver.GPMC.AD2.$suggestSolution      = "GPMC0_AD2";
flash1.parallelFlashDriver.peripheralDriver.GPMC.AD3.$suggestSolution      = "GPMC0_AD3";
flash1.parallelFlashDriver.peripheralDriver.GPMC.AD4.$suggestSolution      = "GPMC0_AD4";
flash1.parallelFlashDriver.peripheralDriver.GPMC.AD5.$suggestSolution      = "GPMC0_AD5";
flash1.parallelFlashDriver.peripheralDriver.GPMC.AD6.$suggestSolution      = "GPMC0_AD6";
flash1.parallelFlashDriver.peripheralDriver.GPMC.AD7.$suggestSolution      = "GPMC0_AD7";
flash1.parallelFlashDriver.peripheralDriver.GPMC.WAIT0.$suggestSolution    = "GPMC0_WAIT0";
debug_log.uartLog.WKUP_UART.$suggestSolution                               = "WKUP_USART0";
debug_log.uartLog.WKUP_UART.RXD.$suggestSolution                           = "WKUP_UART0_RXD";
debug_log.uartLog.WKUP_UART.TXD.$suggestSolution                           = "WKUP_UART0_TXD";
