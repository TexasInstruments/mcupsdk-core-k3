/**
 * @cliArgs --device "AM62Dx" --part "AM62D22-G" --package "ANF" --context "mcu-r5fss0-0" --product "MCU_PLUS_SDK@07.03.01"
 * @versions {"tool":"1.24.0+4150"}
 */

/**
 * Import the modules used in this configuration.
 */
const i2c             = scripting.addModule("/drivers/i2c/i2c", {}, false);
const i2c1            = i2c.addInstance();
const i2c2            = i2c.addInstance();
const i2c3            = i2c.addInstance();
const addr_translate  = scripting.addModule("/kernel/dpl/addr_translate", {}, false);
const addr_translate1 = addr_translate.addInstance();
const debug_log       = scripting.addModule("/kernel/dpl/debug_log");
const mpu_armv7       = scripting.addModule("/kernel/dpl/mpu_armv7", {}, false);
const mpu_armv71      = mpu_armv7.addInstance();
const mpu_armv72      = mpu_armv7.addInstance();
const mpu_armv73      = mpu_armv7.addInstance();
const mpu_armv74      = mpu_armv7.addInstance();
const mpu_armv75      = mpu_armv7.addInstance();
const mpu_armv76      = mpu_armv7.addInstance();

/**
 * Write custom configuration values to the imported modules.
 */
i2c1.$name                   = "CONFIG_I2C0";
i2c1.useMcuDomainPeripherals = false;
i2c1.I2C_child.$name         = "drivers_i2c_v0_i2c_v0_template0";
i2c1.I2C.$assign             = "I2C0";

i2c2.$name           = "CONFIG_I2C1";
i2c2.advanced        = true;
i2c2.ownTargetAddr1  = 0x10;
i2c2.ownTargetAddr2  = 0x10;
i2c2.ownTargetAddr3  = 0x10;
i2c2.ownTargetAddr4  = 0x10;
i2c2.I2C_child.$name = "drivers_i2c_v0_i2c_v0_template1";

i2c3.$name                   = "CONFIG_I2C2";
i2c3.useMcuDomainPeripherals = false;
i2c3.I2C_child.$name         = "drivers_i2c_v0_i2c_v0_template2";
i2c3.I2C.$assign             = "I2C1";

addr_translate1.$name      = "CONFIG_ADDR_TRANSLATE_REGION0";
addr_translate1.localAddr  = 0x2B200000;
addr_translate1.size       = 14;
addr_translate1.systemAddr = 0x2B200000;

debug_log.enableUartLog = true;
debug_log.uartLog.$name = "CONFIG_UART0";

mpu_armv71.$name             = "CONFIG_MPU_REGION0";
mpu_armv71.size              = 31;
mpu_armv71.attributes        = "Device";
mpu_armv71.accessPermissions = "Supervisor RD+WR, User RD";
mpu_armv71.allowExecute      = false;

mpu_armv72.$name             = "CONFIG_MPU_REGION1";
mpu_armv72.size              = 15;
mpu_armv72.accessPermissions = "Supervisor RD+WR, User RD";

mpu_armv73.$name             = "CONFIG_MPU_REGION2";
mpu_armv73.baseAddr          = 0x41010000;
mpu_armv73.size              = 15;
mpu_armv73.accessPermissions = "Supervisor RD+WR, User RD";

mpu_armv74.$name             = "CONFIG_MPU_REGION3";
mpu_armv74.accessPermissions = "Supervisor RD+WR, User RD";
mpu_armv74.baseAddr          = 0x79100000;
mpu_armv74.size              = 19;

mpu_armv75.$name             = "CONFIG_MPU_REGION4";
mpu_armv75.baseAddr          = 0x60000000;
mpu_armv75.size              = 28;
mpu_armv75.accessPermissions = "Supervisor RD, User RD";

mpu_armv76.$name    = "CONFIG_MPU_REGION5";
mpu_armv76.baseAddr = 0x80000000;
mpu_armv76.size     = 31;

/**
 * Pinmux solution for unlocked pins/peripherals. This ensures that minor changes to the automatic solver in a future
 * version of the tool will not impact the pinmux you originally saw.  These lines can be completely deleted in order to
 * re-solve from scratch.
 */
i2c1.I2C.SCL.$suggestSolution                   = "I2C0_SCL";
i2c1.I2C.SDA.$suggestSolution                   = "I2C0_SDA";
i2c2.MCU_I2C.$suggestSolution                   = "MCU_I2C0";
i2c2.MCU_I2C.SCL.$suggestSolution               = "MCU_I2C0_SCL";
i2c2.MCU_I2C.SDA.$suggestSolution               = "MCU_I2C0_SDA";
i2c3.I2C.SCL.$suggestSolution                   = "I2C1_SCL";
i2c3.I2C.SDA.$suggestSolution                   = "I2C1_SDA";
debug_log.uartLog.MCU_UART.$suggestSolution     = "MCU_USART0";
debug_log.uartLog.MCU_UART.RXD.$suggestSolution = "MCU_UART0_RXD";
debug_log.uartLog.MCU_UART.TXD.$suggestSolution = "MCU_UART0_TXD";
