/**
 * @cliArgs --device "AM62x" --part "Default" --package "ALW" --context "a53ss0-1" --product "MCU_PLUS_SDK@07.03.01"
 * @versions {"tool":"1.22.0+3893"}
 */

/**
 * Import the modules used in this configuration.
 */
const ipc        = scripting.addModule("/drivers/ipc/ipc");
const debug_log  = scripting.addModule("/kernel/dpl/debug_log");
const mmu_armv8  = scripting.addModule("/kernel/dpl/mmu_armv8", {}, false);
const mmu_armv81 = mmu_armv8.addInstance();
const mmu_armv82 = mmu_armv8.addInstance();
const mmu_armv83 = mmu_armv8.addInstance();

/**
 * Write custom configuration values to the imported modules.
 */
ipc.enableLinuxIpc     = false;
ipc.vringAllocationPDK = false;
ipc.a53ss0_0           = "NONE";
ipc.m4fss0_0           = "NONE";
ipc.r5fss0_0           = "NONE";
debug_log.enableUartLog = false;
debug_log.enableSharedMemLogReader = false;

mmu_armv81.size  = 0x80000000;
mmu_armv81.$name = "SOC_MEM_REGION";

mmu_armv82.attribute = "MAIR7";
mmu_armv82.$name     = "DDR_REGION";
mmu_armv82.size      = 0x2000000;
mmu_armv82.vAddr     = 0x8E000000;
mmu_armv82.pAddr     = 0x8E000000;

mmu_armv83.$name     = "RTOS_NORTOS_IPC_SHM_MEM";
mmu_armv83.vAddr     = 0x9C800000;
mmu_armv83.pAddr     = 0x9C800000;
mmu_armv83.size      = 0x300000;
mmu_armv83.attribute = "MAIR4";
