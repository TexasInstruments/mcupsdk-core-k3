/**
 * @cliArgs --device "AM62Px" --part "AM62P32-G" --package "AMH" --context "wkup-r5fss0-0" --product "MCU_PLUS_SDK@07.03.01"
 * @versions {"tool":"1.26.2+4477"}
 */

/**
 * Import the modules used in this configuration.
 */
const mcasp       = scripting.addModule("/drivers/mcasp/mcasp", {}, false);
const mcasp1      = mcasp.addInstance();
const mcasp2      = mcasp.addInstance();
const mcasp3      = mcasp.addInstance();
const debug_log   = scripting.addModule("/kernel/dpl/debug_log");
const mpu_armv7   = scripting.addModule("/kernel/dpl/mpu_armv7", {}, false);
const mpu_armv71  = mpu_armv7.addInstance();
const mpu_armv72  = mpu_armv7.addInstance();
const mpu_armv73  = mpu_armv7.addInstance();
const mpu_armv74  = mpu_armv7.addInstance();
const mpu_armv75  = mpu_armv7.addInstance();
const mpu_armv76  = mpu_armv7.addInstance();
const mpu_armv77  = mpu_armv7.addInstance();
const mpu_armv78  = mpu_armv7.addInstance();
const mpu_armv79  = mpu_armv7.addInstance();
const mpu_armv710 = mpu_armv7.addInstance();
const mpu_armv711 = mpu_armv7.addInstance();
const mpu_armv712 = mpu_armv7.addInstance();

/**
 * Write custom configuration values to the imported modules.
 */
mcasp1.$name                                   = "CONFIG_MCASP0";
mcasp1.txDataMask                              = 0xFFFFFFFF;
mcasp1.txActiveSlotMask                        = 0x3;
mcasp1.txCallbackFxn                           = "mcasp_txcb";
mcasp1.txLoopjobBufLength                      = 1280;
mcasp1.rxDataMask                              = 0xFFFFFFFF;
mcasp1.rxActiveSlotMask                        = 0x3;
mcasp1.rxCallbackFxn                           = "mcasp_rxcb";
mcasp1.rxLoopjobBufLength                      = 1280;
mcasp1.txClkApplyAlert                         = false;
mcasp1.rxClkApplyAlert                         = false;
mcasp1.MCASP.$assignAllowConflicts             = "MCASP0";
mcasp1.SYSTEM.$assignAllowConflicts            = "SYSTEM0";
mcasp1.mcaspSer.create(2);
mcasp1.mcaspSer[0].$name                       = "CONFIG_MCASP_SER0";
mcasp1.mcaspSer[0].MCASP.$assignAllowConflicts = "MCASP0";
mcasp1.mcaspSer[1].$name                       = "CONFIG_MCASP_SER1";
mcasp1.mcaspSer[1].dataDir                     = "Receive";
mcasp1.mcaspSer[1].serNum                      = 1;
mcasp1.mcaspSer[1].MCASP.$assignAllowConflicts = "MCASP0";
scripting.suppress("Resource conflict,MCASP0 is also in use by @@@.+?@@@, @@@.+?@@@", mcasp1.MCASP, "$assign");
scripting.suppress("Resource conflict,SYSTEM0 is also in use by @@@.+?@@@, @@@.+?@@@", mcasp1.SYSTEM, "$assign");
scripting.suppress("Resource conflict,MCASP0 is also in use by @@@.+?@@@, @@@.+?@@@", mcasp1.mcaspSer[0].MCASP, "$assign");
scripting.suppress("Resource conflict,MCASP0 is also in use by @@@.+?@@@, @@@.+?@@@", mcasp1.mcaspSer[1].MCASP, "$assign");

mcasp2.$name                                   = "CONFIG_MCASP1";
mcasp2.txDataMask                              = 0xFFFFFFFF;
mcasp2.txActiveSlotMask                        = 0x3;
mcasp2.txCallbackFxn                           = "mcasp_txcb";
mcasp2.txLoopjobBufLength                      = 1280;
mcasp2.rxDataMask                              = 0xFFFFFFFF;
mcasp2.rxActiveSlotMask                        = 0x3;
mcasp2.rxCallbackFxn                           = "mcasp_rxcb";
mcasp2.rxLoopjobBufLength                      = 1280;
mcasp2.txLoopjobBuf                            = "gTxLoopjobBuf1";
mcasp2.rxLoopjobBuf                            = "gRxLoopjobBuf1";
mcasp2.txHclkSource                            = 0;
mcasp2.txHclkSourceMux                         = 1;
mcasp2.rxHclkSource                            = 0;
mcasp2.rxHclkSourceMux                         = 1;
mcasp2.txHclkExpected                          = 24576000;
mcasp2.txBclkCalculated                        = 3072000;
mcasp2.txFsyncCalculated                       = 48000;
mcasp2.txClkApplyAlert                         = false;
mcasp2.rxHclkExpected                          = 24576000;
mcasp2.rxBclkCalculated                        = 3072000;
mcasp2.rxFsyncCalculated                       = 48000;
mcasp2.rxClkApplyAlert                         = false;
mcasp2.MCASP.$assignAllowConflicts             = "MCASP1";
mcasp2.mcaspSer.create(2);
mcasp2.mcaspSer[0].$name                       = "CONFIG_MCASP_SER2";
mcasp2.mcaspSer[0].MCASP.$assignAllowConflicts = "MCASP1";
mcasp2.mcaspSer[1].$name                       = "CONFIG_MCASP_SER3";
mcasp2.mcaspSer[1].dataDir                     = "Receive";
mcasp2.mcaspSer[1].serNum                      = 1;
mcasp2.mcaspSer[1].MCASP.$assignAllowConflicts = "MCASP1";
mcasp2.SYSTEM.$assignAllowConflicts            = "SYSTEM0";
mcasp2.SYSTEM.CLKOUT0.$assignAllowConflicts    = "EXT_REFCLK1";
scripting.suppress("Resource conflict,MCASP1 is also in use by @@@.+?@@@, @@@.+?@@@", mcasp2.MCASP, "$assign");
scripting.suppress("Resource conflict,MCASP1 is also in use by @@@.+?@@@, @@@.+?@@@", mcasp2.mcaspSer[0].MCASP, "$assign");
scripting.suppress("Resource conflict,MCASP1 is also in use by @@@.+?@@@, @@@.+?@@@", mcasp2.mcaspSer[1].MCASP, "$assign");
scripting.suppress("Resource conflict,SYSTEM0 is also in use by @@@.+?@@@, @@@.+?@@@", mcasp2.SYSTEM, "$assign");
scripting.suppress("Resource conflict,@@@.+?@@@ is also in use by @@@.+?@@@", mcasp2.SYSTEM, "CLKOUT0");

mcasp3.$name                                   = "CONFIG_MCASP2";
mcasp3.txDataMask                              = 0xFFFFFFFF;
mcasp3.txActiveSlotMask                        = 0x3;
mcasp3.txCallbackFxn                           = "mcasp_txcb";
mcasp3.txLoopjobBufLength                      = 1280;
mcasp3.rxDataMask                              = 0xFFFFFFFF;
mcasp3.rxActiveSlotMask                        = 0x3;
mcasp3.rxCallbackFxn                           = "mcasp_rxcb";
mcasp3.rxLoopjobBufLength                      = 1280;
mcasp3.txHclkSource                            = 0;
mcasp3.txHclkSourceMux                         = 1;
mcasp3.rxHclkSource                            = 0;
mcasp3.rxHclkSourceMux                         = 1;
mcasp3.txHclkExpected                          = 24576000;
mcasp3.txBclkCalculated                        = 3072000;
mcasp3.txFsyncCalculated                       = 48000;
mcasp3.txClkApplyAlert                         = false;
mcasp3.rxHclkExpected                          = 24576000;
mcasp3.rxBclkCalculated                        = 3072000;
mcasp3.rxFsyncCalculated                       = 48000;
mcasp3.rxClkApplyAlert                         = false;
mcasp3.txLoopjobBuf                            = "gTxLoopjobBuf2";
mcasp3.rxLoopjobBuf                            = "gRxLoopjobBuf2";
mcasp3.MCASP.$assignAllowConflicts             = "MCASP2";
mcasp3.mcaspSer.create(2);
mcasp3.mcaspSer[0].$name                       = "CONFIG_MCASP_SER4";
mcasp3.mcaspSer[0].MCASP.$assignAllowConflicts = "MCASP2";
mcasp3.mcaspSer[1].$name                       = "CONFIG_MCASP_SER5";
mcasp3.mcaspSer[1].dataDir                     = "Receive";
mcasp3.mcaspSer[1].serNum                      = 1;
mcasp3.mcaspSer[1].MCASP.$assignAllowConflicts = "MCASP2";
mcasp3.SYSTEM.$assignAllowConflicts            = "SYSTEM0";
mcasp3.SYSTEM.CLKOUT0.$assignAllowConflicts    = "EXT_REFCLK1";
scripting.suppress("Resource conflict,MCASP2 is also in use by @@@.+?@@@, @@@.+?@@@", mcasp3.MCASP, "$assign");
scripting.suppress("Resource conflict,MCASP2 is also in use by @@@.+?@@@, @@@.+?@@@", mcasp3.mcaspSer[0].MCASP, "$assign");
scripting.suppress("Resource conflict,MCASP2 is also in use by @@@.+?@@@, @@@.+?@@@", mcasp3.mcaspSer[1].MCASP, "$assign");
scripting.suppress("Resource conflict,SYSTEM0 is also in use by @@@.+?@@@, @@@.+?@@@", mcasp3.SYSTEM, "$assign");
scripting.suppress("Resource conflict,@@@.+?@@@ is also in use by @@@.+?@@@", mcasp3.SYSTEM, "CLKOUT0");

const udma         = scripting.addModule("/drivers/udma/udma", {}, false);
const udma1        = udma.addInstance({}, false);
udma1.$name        = "CONFIG_UDMA0";
mcasp1.bcDmaDriver = udma1;
mcasp2.bcDmaDriver = udma1;
mcasp3.bcDmaDriver = udma1;

debug_log.enableUartLog = true;
debug_log.uartTrace     = true;
debug_log.uartLog.$name = "CONFIG_UART0";

mpu_armv71.$name        = "REGISTER_REGION";
mpu_armv71.size         = 31;
mpu_armv71.attributes   = "Device";
mpu_armv71.allowExecute = false;

mpu_armv72.$name = "TMCA_VEC";
mpu_armv72.size  = 7;

mpu_armv73.$name             = "CONFIG_MPU_REGION2";
mpu_armv73.baseAddr          = 0x41C00000;
mpu_armv73.size              = 19;
mpu_armv73.accessPermissions = "Supervisor RD+WR, User RD";

mpu_armv74.$name             = "CONFIG_MPU_REGION3";
mpu_armv74.baseAddr          = 0x70000000;
mpu_armv74.size              = 16;
mpu_armv74.accessPermissions = "Supervisor RD+WR, User RD";

mpu_armv75.$name    = "DDR";
mpu_armv75.baseAddr = 0x80000000;
mpu_armv75.size     = 31;

mpu_armv76.$name      = "TCMB";
mpu_armv76.baseAddr   = 0x41010000;
mpu_armv76.size       = 15;
mpu_armv76.attributes = "NonCached";

mpu_armv77.$name      = "TCMA";
mpu_armv77.size       = 15;
mpu_armv77.attributes = "NonCached";

mpu_armv78.$name    = "HSM_RAM";
mpu_armv78.baseAddr = 0x43C00000;
mpu_armv78.size     = 18;

mpu_armv79.baseAddr     = 0x9C900000;
mpu_armv79.size         = 20;
mpu_armv79.attributes   = "NonCached";
mpu_armv79.allowExecute = false;
mpu_armv79.$name        = "RESOURCE_TABLE_TRACE";

mpu_armv710.$name        = "RTOS_NORTOS_VRING1";
mpu_armv710.baseAddr     = 0x9B500000;
mpu_armv710.size         = 20;
mpu_armv710.attributes   = "NonCached";
mpu_armv710.allowExecute = false;

mpu_armv711.$name        = "RTOS_NORTOS_VRING_2";
mpu_armv711.baseAddr     = 0x9B600000;
mpu_armv711.size         = 20;
mpu_armv711.attributes   = "NonCached";
mpu_armv711.allowExecute = false;

mpu_armv712.$name        = "LINUX_VRING";
mpu_armv712.baseAddr     = 0x9C800000;
mpu_armv712.size         = 20;
mpu_armv712.attributes   = "NonCached";
mpu_armv712.allowExecute = false;

/**
 * Pinmux solution for unlocked pins/peripherals. This ensures that minor changes to the automatic solver in a future
 * version of the tool will not impact the pinmux you originally saw.  These lines can be completely deleted in order to
 * re-solve from scratch.
 */
mcasp1.MCASP.AFSX.$suggestSolution               = "MCASP0_AFSX";
mcasp1.MCASP.ACLKX.$suggestSolution              = "MCASP0_ACLKX";
mcasp1.MCASP.AFSR.$suggestSolution               = "MCASP0_AFSR";
mcasp1.MCASP.ACLKR.$suggestSolution              = "MCASP0_ACLKR";
mcasp1.mcaspSer[0].MCASP.AXR0.$suggestSolution   = "MCASP0_AXR0";
mcasp1.mcaspSer[1].MCASP.AXR1.$suggestSolution   = "MCASP0_AXR1";
mcasp2.MCASP.AFSX.$suggestSolution               = "GPMC0_WAIT0";
mcasp2.MCASP.ACLKX.$suggestSolution              = "GPMC0_BE0n_CLE";
mcasp2.MCASP.AFSR.$suggestSolution               = "GPMC0_CSn2";
mcasp2.MCASP.ACLKR.$suggestSolution              = "GPMC0_CSn3";
mcasp2.mcaspSer[0].MCASP.AXR0.$suggestSolution   = "GPMC0_WEn";
mcasp2.mcaspSer[1].MCASP.AXR1.$suggestSolution   = "GPMC0_OEn_REn";
mcasp3.MCASP.AFSX.$suggestSolution               = "GPMC0_AD12";
mcasp3.MCASP.ACLKX.$suggestSolution              = "GPMC0_AD13";
mcasp3.MCASP.AFSR.$suggestSolution               = "GPMC0_AD14";
mcasp3.MCASP.ACLKR.$suggestSolution              = "GPMC0_AD15";
mcasp3.mcaspSer[0].MCASP.AXR0.$suggestSolution   = "GPMC0_AD8";
mcasp3.mcaspSer[1].MCASP.AXR1.$suggestSolution   = "GPMC0_AD9";
debug_log.uartLog.WKUP_UART.$suggestSolution     = "WKUP_USART0";
debug_log.uartLog.WKUP_UART.RXD.$suggestSolution = "WKUP_UART0_RXD";
debug_log.uartLog.WKUP_UART.TXD.$suggestSolution = "WKUP_UART0_TXD";
