/**
 * @cliArgs --device "AM62x" --package "ALW" --part "Default" --context "a53ss0-0" --product "MCU_PLUS_SDK@07.03.01"
 * @versions {"tool":"1.19.0+3426"}
 */

/**
 * Import the modules used in this configuration.
 */
const mcasp      = scripting.addModule("/drivers/mcasp/mcasp", {}, false);
const mcasp1     = mcasp.addInstance();
const mcasp2     = mcasp.addInstance();
const mcasp3     = mcasp.addInstance();
const debug_log  = scripting.addModule("/kernel/dpl/debug_log");
const mmu_armv8  = scripting.addModule("/kernel/dpl/mmu_armv8", {}, false);
const mmu_armv81 = mmu_armv8.addInstance();
const mmu_armv82 = mmu_armv8.addInstance();

/**
 * Write custom configuration values to the imported modules.
 */
mcasp1.$name                                   = "CONFIG_MCASP0";
mcasp1.txDataMask                              = 0xFFFFFFFF;
mcasp1.txActiveSlotMask                        = 0x3;
mcasp1.txCallbackFxn                           = "mcasp_loopback_txcb";
mcasp1.rxDataMask                              = 0xFFFFFFFF;
mcasp1.rxActiveSlotMask                        = 0x3;
mcasp1.rxCallbackFxn                           = "mcasp_loopback_rxcb";
mcasp1.MCASP.$assignAllowConflicts             = "MCASP0";
mcasp1.SYSTEM.$assignAllowConflicts            = "SYSTEM0";
mcasp1.mcaspSer.create(2);
mcasp1.mcaspSer[0].$name                       = "CONFIG_MCASP_SER0";
mcasp1.mcaspSer[0].MCASP.$assignAllowConflicts = "MCASP0";
mcasp1.mcaspSer[1].$name                       = "CONFIG_MCASP_SER1";
mcasp1.mcaspSer[1].serNum                      = 1;
mcasp1.mcaspSer[1].dataDir                     = "Receive";
mcasp1.mcaspSer[1].MCASP.$assignAllowConflicts = "MCASP0";
scripting.suppress("Resource conflict,MCASP0 is also in use by @@@.+?@@@, @@@.+?@@@", mcasp1.MCASP, "$assign");
scripting.suppress("Resource conflict,SYSTEM0 is also in use by @@@.+?@@@, @@@.+?@@@", mcasp1.SYSTEM, "$assign");
scripting.suppress("Resource conflict,MCASP0 is also in use by @@@.+?@@@, @@@.+?@@@", mcasp1.mcaspSer[0].MCASP, "$assign");
scripting.suppress("Resource conflict,MCASP0 is also in use by @@@.+?@@@, @@@.+?@@@", mcasp1.mcaspSer[1].MCASP, "$assign");

mcasp2.$name                                   = "CONFIG_MCASP1";
mcasp2.txCallbackFxn                           = "mcasp_loopback_txcb";
mcasp2.txDataMask                              = 0xFFFFFFFF;
mcasp2.txActiveSlotMask                        = 0x3;
mcasp2.rxCallbackFxn                           = "mcasp_loopback_rxcb";
mcasp2.rxDataMask                              = 0xFFFFFFFF;
mcasp2.rxActiveSlotMask                        = 0x3;
mcasp2.txLoopjobBuf                            = "gTxLoopjobBuf1";
mcasp2.rxLoopjobBuf                            = "gRxLoopjobBuf1";
mcasp2.MCASP.$assignAllowConflicts             = "MCASP1";
mcasp2.SYSTEM.$assignAllowConflicts            = "SYSTEM0";
mcasp2.mcaspSer.create(2);
mcasp2.mcaspSer[0].$name                       = "CONFIG_MCASP_SER2";
mcasp2.mcaspSer[0].MCASP.$assignAllowConflicts = "MCASP1";
mcasp2.mcaspSer[1].$name                       = "CONFIG_MCASP_SER3";
mcasp2.mcaspSer[1].serNum                      = 1;
mcasp2.mcaspSer[1].dataDir                     = "Receive";
mcasp2.mcaspSer[1].MCASP.$assignAllowConflicts = "MCASP1";
scripting.suppress("Resource conflict,MCASP1 is also in use by @@@.+?@@@, @@@.+?@@@", mcasp2.MCASP, "$assign");
scripting.suppress("Resource conflict,SYSTEM0 is also in use by @@@.+?@@@, @@@.+?@@@", mcasp2.SYSTEM, "$assign");
scripting.suppress("Resource conflict,MCASP1 is also in use by @@@.+?@@@, @@@.+?@@@", mcasp2.mcaspSer[0].MCASP, "$assign");
scripting.suppress("Resource conflict,MCASP1 is also in use by @@@.+?@@@, @@@.+?@@@", mcasp2.mcaspSer[1].MCASP, "$assign");

mcasp3.$name                                   = "CONFIG_MCASP2";
mcasp3.txDataMask                              = 0xFFFFFFFF;
mcasp3.txActiveSlotMask                        = 0x3;
mcasp3.txCallbackFxn                           = "mcasp_loopback_txcb";
mcasp3.txLoopjobBuf                            = "gTxLoopjobBuf2";
mcasp3.rxDataMask                              = 0xFFFFFFFF;
mcasp3.rxActiveSlotMask                        = 0x3;
mcasp3.rxCallbackFxn                           = "mcasp_loopback_rxcb";
mcasp3.rxLoopjobBuf                            = "gRxLoopjobBuf2";
mcasp3.MCASP.$assignAllowConflicts             = "MCASP2";
mcasp3.SYSTEM.$assignAllowConflicts            = "SYSTEM0";
mcasp3.mcaspSer.create(2);
mcasp3.mcaspSer[0].$name                       = "CONFIG_MCASP_SER4";
mcasp3.mcaspSer[0].MCASP.$assignAllowConflicts = "MCASP2";
mcasp3.mcaspSer[1].$name                       = "CONFIG_MCASP_SER5";
mcasp3.mcaspSer[1].serNum                      = 1;
mcasp3.mcaspSer[1].dataDir                     = "Receive";
mcasp3.mcaspSer[1].MCASP.$assignAllowConflicts = "MCASP2";
scripting.suppress("Resource conflict,MCASP2 is also in use by @@@.+?@@@, @@@.+?@@@", mcasp3.MCASP, "$assign");
scripting.suppress("Resource conflict,SYSTEM0 is also in use by @@@.+?@@@, @@@.+?@@@", mcasp3.SYSTEM, "$assign");
scripting.suppress("Resource conflict,MCASP2 is also in use by @@@.+?@@@, @@@.+?@@@", mcasp3.mcaspSer[0].MCASP, "$assign");
scripting.suppress("Resource conflict,MCASP2 is also in use by @@@.+?@@@, @@@.+?@@@", mcasp3.mcaspSer[1].MCASP, "$assign");

const udma         = scripting.addModule("/drivers/udma/udma", {}, false);
const udma1        = udma.addInstance({}, false);
udma1.$name        = "CONFIG_UDMA0";
mcasp1.bcDmaDriver = udma1;
mcasp2.bcDmaDriver = udma1;
mcasp3.bcDmaDriver = udma1;

const udma2         = udma.addInstance({}, false);
udma2.$name         = "CONFIG_UDMA1";
mcasp1.pktDmaDriver = udma2;
mcasp2.pktDmaDriver = udma2;
mcasp3.pktDmaDriver = udma2;

debug_log.enableUartLog        = true;
debug_log.uartLog.$name        = "CONFIG_UART_CONSOLE";
debug_log.uartLog.UART.$assign = "USART0";

mmu_armv81.size  = 0x80000000;
mmu_armv81.$name = "SOC_MEM_REGION";

mmu_armv82.vAddr     = 0x80000000;
mmu_armv82.pAddr     = 0x80000000;
mmu_armv82.size      = 0x80000000;
mmu_armv82.attribute = "MAIR7";
mmu_armv82.$name     = "DDR_REGION";

/**
 * Pinmux solution for unlocked pins/peripherals. This ensures that minor changes to the automatic solver in a future
 * version of the tool will not impact the pinmux you originally saw.  These lines can be completely deleted in order to
 * re-solve from scratch.
 */
mcasp1.MCASP.AFSX.$suggestSolution             = "MCASP0_AFSX";
mcasp1.MCASP.ACLKX.$suggestSolution            = "MCASP0_ACLKX";
mcasp1.MCASP.AFSR.$suggestSolution             = "MCASP0_AFSR";
mcasp1.MCASP.ACLKR.$suggestSolution            = "MCASP0_ACLKR";
mcasp1.mcaspSer[0].MCASP.AXR0.$suggestSolution = "MCASP0_AXR0";
mcasp1.mcaspSer[1].MCASP.AXR1.$suggestSolution = "MCASP0_AXR1";
mcasp2.MCASP.AFSX.$suggestSolution             = "GPMC0_WAIT0";
mcasp2.MCASP.ACLKX.$suggestSolution            = "GPMC0_BE0n_CLE";
mcasp2.MCASP.AFSR.$suggestSolution             = "GPMC0_CSn2";
mcasp2.MCASP.ACLKR.$suggestSolution            = "GPMC0_CSn3";
mcasp2.mcaspSer[0].MCASP.AXR0.$suggestSolution = "GPMC0_WEn";
mcasp2.mcaspSer[1].MCASP.AXR1.$suggestSolution = "GPMC0_OEn_REn";
mcasp3.MCASP.AFSX.$suggestSolution             = "GPMC0_AD12";
mcasp3.MCASP.ACLKX.$suggestSolution            = "GPMC0_AD13";
mcasp3.MCASP.AFSR.$suggestSolution             = "GPMC0_AD14";
mcasp3.MCASP.ACLKR.$suggestSolution            = "GPMC0_AD15";
mcasp3.mcaspSer[0].MCASP.AXR0.$suggestSolution = "GPMC0_AD8";
mcasp3.mcaspSer[1].MCASP.AXR1.$suggestSolution = "GPMC0_AD9";
debug_log.uartLog.UART.RXD.$suggestSolution    = "UART0_RXD";
debug_log.uartLog.UART.TXD.$suggestSolution    = "UART0_TXD";
