/**
 * @cliArgs --device "AM62Dx" --part "AM62D24-G" --package "ANF" --context "a53ss0-0" --product "MCU_PLUS_SDK@07.03.01"
 * @versions {"tool":"1.24.2+4234"}
 */

/**
 * Import the modules used in this configuration.
 */
const ipc        = scripting.addModule("/drivers/ipc/ipc");
const mcasp      = scripting.addModule("/drivers/mcasp/mcasp", {}, false);
const mcasp1     = mcasp.addInstance();
const debug_log  = scripting.addModule("/kernel/dpl/debug_log");
const mmu_armv8  = scripting.addModule("/kernel/dpl/mmu_armv8", {}, false);
const mmu_armv81 = mmu_armv8.addInstance();
const mmu_armv82 = mmu_armv8.addInstance();
const mmu_armv83 = mmu_armv8.addInstance();

/**
 * Write custom configuration values to the imported modules.
 */
ipc.r5fss0_0           = "NONE";
ipc.c75ss0_0           = "notify";
ipc.mcu_r5fss0_0       = "NONE";
ipc.enableLinuxIpc     = false;
ipc.vringAllocationPDK = false;

mcasp1.$name                                   = "CONFIG_MCASP0";
mcasp1.txBufferFormat                          = "MULTISER_MULTISLOT_SEMI_INTERLEAVED_1";
mcasp1.txDataMask                              = 0xFFFFFFFF;
mcasp1.txCallbackFxn                           = "mcasp_loopback_txcb";
mcasp1.rxDataMask                              = 0xFFFFFFFF;
mcasp1.rxActiveSlotMask                        = 0x3;
mcasp1.rxCallbackFxn                           = "mcasp_loopback_rxcb";
mcasp1.txLoopjobBufLength                      = 1280;
mcasp1.rxLoopjobBufLength                      = 1280;
mcasp1.afsx                                    = 96;
mcasp1.txFsyncCalculated                       = 93750;
mcasp1.rxClkDiv                                = 4;
mcasp1.rxBclkCalculated                        = 6000000;
mcasp1.rxFsyncCalculated                       = 93750;
mcasp1.afsr                                    = 96;
mcasp1.rxClkApplyAlert                         = false;
mcasp1.enableLoopback                          = false;
mcasp1.enableMcaspRx                           = false;
mcasp1.TxMode                                  = "TDM";
mcasp1.NumTxSlots                              = 4;
mcasp1.txActiveSlotMask                        = 0xF;
mcasp1.clkSyncMode                             = "ASYNC";
mcasp1.txClkDiv                                = 2;
mcasp1.txBclkCalculated                        = 12000000;
mcasp1.txClkApplyAlert                         = false;
mcasp1.mcaspSer.create(4);
mcasp1.mcaspSer[0].$name                       = "CONFIG_MCASP_SER0";
mcasp1.mcaspSer[0].MCASP.$assignAllowConflicts = "MCASP0";
mcasp1.mcaspSer[1].$name                       = "CONFIG_MCASP_SER1";
mcasp1.mcaspSer[1].serNum                      = 1;
mcasp1.mcaspSer[1].MCASP.$assignAllowConflicts = "MCASP0";
mcasp1.mcaspSer[2].$name                       = "CONFIG_MCASP_SER2";
mcasp1.mcaspSer[2].serNum                      = 2;
mcasp1.mcaspSer[2].MCASP.$assignAllowConflicts = "MCASP0";
mcasp1.mcaspSer[3].$name                       = "CONFIG_MCASP_SER3";
mcasp1.mcaspSer[3].serNum                      = 3;
mcasp1.mcaspSer[3].MCASP.$assignAllowConflicts = "MCASP0";
mcasp1.MCASP.$assignAllowConflicts             = "MCASP0";
scripting.suppress("Resource conflict,MCASP0 is also in use by @@@.+?@@@, @@@.+?@@@, @@@.+?@@@, @@@.+?@@@", mcasp1.mcaspSer[0].MCASP, "$assign");
scripting.suppress("Resource conflict,MCASP0 is also in use by @@@.+?@@@, @@@.+?@@@, @@@.+?@@@, @@@.+?@@@", mcasp1.mcaspSer[1].MCASP, "$assign");
scripting.suppress("Resource conflict,MCASP0 is also in use by @@@.+?@@@, @@@.+?@@@, @@@.+?@@@, @@@.+?@@@", mcasp1.mcaspSer[2].MCASP, "$assign");
scripting.suppress("Resource conflict,MCASP0 is also in use by @@@.+?@@@, @@@.+?@@@, @@@.+?@@@, @@@.+?@@@", mcasp1.mcaspSer[3].MCASP, "$assign");
scripting.suppress("Resource conflict,MCASP0 is also in use by @@@.+?@@@, @@@.+?@@@, @@@.+?@@@, @@@.+?@@@", mcasp1.MCASP, "$assign");

const udma         = scripting.addModule("/drivers/udma/udma", {}, false);
const udma1        = udma.addInstance({}, false);
udma1.$name        = "CONFIG_UDMA0";
mcasp1.bcDmaDriver = udma1;

debug_log.enableUartLog        = true;
debug_log.uartLog.$name        = "CONFIG_UART_CONSOLE";
debug_log.uartLog.UART.$assign = "USART0";

mmu_armv81.size  = 0x80000000;
mmu_armv81.$name = "SOC_MEM_REGION";

mmu_armv82.vAddr     = 0x70000000;
mmu_armv82.pAddr     = 0x70000000;
mmu_armv82.size      = 0x200000;
mmu_armv82.attribute = "MAIR7";
mmu_armv82.$name     = "SHM_MEM_REGION";

mmu_armv83.vAddr     = 0x80000000;
mmu_armv83.pAddr     = 0x80000000;
mmu_armv83.size      = 0x80000000;
mmu_armv83.attribute = "MAIR7";
mmu_armv83.$name     = "DDR_REGION";

/**
 * Pinmux solution for unlocked pins/peripherals. This ensures that minor changes to the automatic solver in a future
 * version of the tool will not impact the pinmux you originally saw.  These lines can be completely deleted in order to
 * re-solve from scratch.
 */
mcasp1.SYSTEM.$suggestSolution                 = "SYSTEM0";
mcasp1.mcaspSer[0].MCASP.AXR0.$suggestSolution = "MCASP0_AXR0";
mcasp1.mcaspSer[1].MCASP.AXR1.$suggestSolution = "MCASP0_AXR1";
mcasp1.mcaspSer[2].MCASP.AXR2.$suggestSolution = "MCASP0_AXR2";
mcasp1.mcaspSer[3].MCASP.AXR3.$suggestSolution = "MCASP0_AXR3";
mcasp1.MCASP.AFSX.$suggestSolution             = "MCASP0_AFSX";
mcasp1.MCASP.ACLKX.$suggestSolution            = "MCASP0_ACLKX";
debug_log.uartLog.UART.RXD.$suggestSolution    = "UART0_RXD";
debug_log.uartLog.UART.TXD.$suggestSolution    = "UART0_TXD";
