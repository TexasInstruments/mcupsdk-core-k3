/**
 * @cliArgs --device "AM275x" --part "AM2754" --package "ANJ" --context "c75ss1-0" --product "MCU_PLUS_SDK@07.03.01"
 * @versions {"tool":"1.26.2+4477"}
 */

/**
 * Import the modules used in this configuration.
 */
const ipc         = scripting.addModule("/drivers/ipc/ipc");
const mcasp       = scripting.addModule("/drivers/mcasp/mcasp", {}, false);
const mcasp1      = mcasp.addInstance();
const mcasp2      = mcasp.addInstance();
const mcasp3      = mcasp.addInstance();
const debug_log   = scripting.addModule("/kernel/dpl/debug_log");
const mmu_armv8   = scripting.addModule("/kernel/dpl/mmu_armv8", {}, false);
const mmu_armv81  = mmu_armv8.addInstance();
const mmu_armv82  = mmu_armv8.addInstance();
const mmu_armv83  = mmu_armv8.addInstance();
const mmu_armv84  = mmu_armv8.addInstance();
const mmu_armv85  = mmu_armv8.addInstance();
const mmu_armv86  = mmu_armv8.addInstance();
const mmu_armv87  = mmu_armv8.addInstance();
const mmu_armv88  = mmu_armv8.addInstance();
const mmu_armv89  = mmu_armv8.addInstance();
const mmu_armv810 = mmu_armv8.addInstance();
const mmu_armv811 = mmu_armv8.addInstance();
const mmu_armv812 = mmu_armv8.addInstance();

/**
 * Write custom configuration values to the imported modules.
 */
ipc.r5fss0_0      = "notify";
ipc.r5fss0_1      = "notify";
ipc.r5fss1_0      = "notify";
ipc.r5fss1_1      = "notify";
ipc.c75ss0_0      = "notify";
ipc.wkup_r5fss0_0 = "NONE";

mcasp1.$name                                   = "CONFIG_MCASP0";
mcasp1.txDataMask                              = 0xFFFFFFFF;
mcasp1.txActiveSlotMask                        = 0x3;
mcasp1.rxDataMask                              = 0xFFFFFFFF;
mcasp1.rxActiveSlotMask                        = 0x3;
mcasp1.txLoopjobBufLength                      = 1280;
mcasp1.rxLoopjobBufLength                      = 1280;
mcasp1.txCallbackFxn                           = "mcasp_txcb";
mcasp1.rxCallbackFxn                           = "mcasp_rxcb";
mcasp1.txClkApplyAlert                         = false;
mcasp1.rxClkApplyAlert                         = false;
mcasp1.MCASP.$assignAllowConflicts             = "MCASP0";
mcasp1.CLOCKING.$assignAllowConflicts          = "CLOCKING";
mcasp1.mcaspSer.create(2);
mcasp1.mcaspSer[0].$name                       = "CONFIG_MCASP_SER0";
mcasp1.mcaspSer[0].MCASP.$assignAllowConflicts = "MCASP0";
mcasp1.mcaspSer[1].$name                       = "CONFIG_MCASP_SER1";
mcasp1.mcaspSer[1].dataDir                     = "Receive";
mcasp1.mcaspSer[1].serNum                      = 1;
mcasp1.mcaspSer[1].MCASP.$assignAllowConflicts = "MCASP0";
scripting.suppress("Resource conflict,MCASP0 is also in use by @@@.+?@@@, @@@.+?@@@", mcasp1.MCASP, "$assign");
scripting.suppress("Resource conflict,CLOCKING is also in use by @@@.+?@@@, @@@.+?@@@", mcasp1.CLOCKING, "$assign");
scripting.suppress("Resource conflict,MCASP0 is also in use by @@@.+?@@@, @@@.+?@@@", mcasp1.mcaspSer[0].MCASP, "$assign");
scripting.suppress("Resource conflict,MCASP0 is also in use by @@@.+?@@@, @@@.+?@@@", mcasp1.mcaspSer[1].MCASP, "$assign");

mcasp2.$name                                   = "CONFIG_MCASP1";
mcasp2.txDataMask                              = 0xFFFFFFFF;
mcasp2.txActiveSlotMask                        = 0x3;
mcasp2.rxDataMask                              = 0xFFFFFFFF;
mcasp2.rxActiveSlotMask                        = 0x3;
mcasp2.txLoopjobBufLength                      = 1280;
mcasp2.rxLoopjobBufLength                      = 1280;
mcasp2.txCallbackFxn                           = "mcasp_txcb";
mcasp2.rxCallbackFxn                           = "mcasp_rxcb";
mcasp2.txLoopjobBuf                            = "gTxLoopjobBuf1";
mcasp2.rxLoopjobBuf                            = "gRxLoopjobBuf1";
mcasp2.rxHclkSource                            = 0;
mcasp2.rxHclkSourceMux                         = 1;
mcasp2.txHclkSource                            = 0;
mcasp2.txHclkSourceMux                         = 1;
mcasp2.txHclkExpected                          = 24576000;
mcasp2.txHclkDiv                               = 1;
mcasp2.rxHclkDiv                               = 1;
mcasp2.rxHclkExpected                          = 24576000;
mcasp2.txClkApplyAlert                         = false;
mcasp2.rxClkApplyAlert                         = false;
mcasp2.MCASP.$assignAllowConflicts             = "MCASP1";
mcasp2.mcaspSer.create(2);
mcasp2.mcaspSer[0].$name                       = "CONFIG_MCASP_SER2";
mcasp2.mcaspSer[0].MCASP.$assignAllowConflicts = "MCASP1";
mcasp2.mcaspSer[1].$name                       = "CONFIG_MCASP_SER3";
mcasp2.mcaspSer[1].dataDir                     = "Receive";
mcasp2.mcaspSer[1].serNum                      = 1;
mcasp2.mcaspSer[1].MCASP.$assignAllowConflicts = "MCASP1";
mcasp2.CLOCKING.$assignAllowConflicts          = "CLOCKING";
mcasp2.CLOCKING.CLKOUT0.$assignAllowConflicts  = "EXT_REFCLK1";
scripting.suppress("Resource conflict,MCASP1 is also in use by @@@.+?@@@, @@@.+?@@@", mcasp2.MCASP, "$assign");
scripting.suppress("Resource conflict,MCASP1 is also in use by @@@.+?@@@, @@@.+?@@@", mcasp2.mcaspSer[0].MCASP, "$assign");
scripting.suppress("Resource conflict,MCASP1 is also in use by @@@.+?@@@, @@@.+?@@@", mcasp2.mcaspSer[1].MCASP, "$assign");
scripting.suppress("Resource conflict,CLOCKING is also in use by @@@.+?@@@, @@@.+?@@@", mcasp2.CLOCKING, "$assign");
scripting.suppress("Resource conflict,@@@.+?@@@ is also in use by @@@.+?@@@", mcasp2.CLOCKING, "CLKOUT0");

mcasp3.$name                                   = "CONFIG_MCASP2";
mcasp3.txDataMask                              = 0xFFFFFFFF;
mcasp3.txActiveSlotMask                        = 0x3;
mcasp3.rxDataMask                              = 0xFFFFFFFF;
mcasp3.rxActiveSlotMask                        = 0x3;
mcasp3.txLoopjobBufLength                      = 1280;
mcasp3.rxLoopjobBufLength                      = 1280;
mcasp3.txCallbackFxn                           = "mcasp_txcb";
mcasp3.rxCallbackFxn                           = "mcasp_rxcb";
mcasp3.rxHclkSource                            = 0;
mcasp3.rxHclkSourceMux                         = 1;
mcasp3.txHclkSource                            = 0;
mcasp3.txHclkSourceMux                         = 1;
mcasp3.txLoopjobBuf                            = "gTxLoopjobBuf2";
mcasp3.rxLoopjobBuf                            = "gRxLoopjobBuf2";
mcasp3.txHclkExpected                          = 24576000;
mcasp3.txClkApplyAlert                         = false;
mcasp3.rxHclkExpected                          = 24576000;
mcasp3.rxClkApplyAlert                         = false;
mcasp3.MCASP.$assignAllowConflicts             = "MCASP2";
mcasp3.mcaspSer.create(2);
mcasp3.mcaspSer[0].$name                       = "CONFIG_MCASP_SER4";
mcasp3.mcaspSer[0].MCASP.$assignAllowConflicts = "MCASP2";
mcasp3.mcaspSer[1].$name                       = "CONFIG_MCASP_SER5";
mcasp3.mcaspSer[1].dataDir                     = "Receive";
mcasp3.mcaspSer[1].serNum                      = 1;
mcasp3.mcaspSer[1].MCASP.$assignAllowConflicts = "MCASP2";
mcasp3.CLOCKING.$assignAllowConflicts          = "CLOCKING";
mcasp3.CLOCKING.CLKOUT0.$assignAllowConflicts  = "EXT_REFCLK1";
scripting.suppress("Resource conflict,MCASP2 is also in use by @@@.+?@@@, @@@.+?@@@", mcasp3.MCASP, "$assign");
scripting.suppress("Resource conflict,MCASP2 is also in use by @@@.+?@@@, @@@.+?@@@", mcasp3.mcaspSer[0].MCASP, "$assign");
scripting.suppress("Resource conflict,MCASP2 is also in use by @@@.+?@@@, @@@.+?@@@", mcasp3.mcaspSer[1].MCASP, "$assign");
scripting.suppress("Resource conflict,CLOCKING is also in use by @@@.+?@@@, @@@.+?@@@", mcasp3.CLOCKING, "$assign");
scripting.suppress("Resource conflict,@@@.+?@@@ is also in use by @@@.+?@@@", mcasp3.CLOCKING, "CLKOUT0");

const udma         = scripting.addModule("/drivers/udma/udma", {}, false);
const udma1        = udma.addInstance({}, false);
udma1.$name        = "CONFIG_UDMA0";
mcasp1.bcDmaDriver = udma1;
mcasp2.bcDmaDriver = udma1;
mcasp3.bcDmaDriver = udma1;

debug_log.enableSharedMemLog = true;

mmu_armv81.size  = 0x20000000;
mmu_armv81.$name = "REGISTER_REGION0";

mmu_armv82.vAddr = 0x20000000;
mmu_armv82.pAddr = 0x20000000;
mmu_armv82.size  = 0x20000000;
mmu_armv82.$name = "REGISTER_REGION1";

mmu_armv83.vAddr = 0x40000000;
mmu_armv83.pAddr = 0x40000000;
mmu_armv83.size  = 0x20000000;
mmu_armv83.$name = "REGISTER_REGION2";

mmu_armv84.vAddr = 0x60000000;
mmu_armv84.pAddr = 0x60000000;
mmu_armv84.size  = 0x10000000;
mmu_armv84.$name = "FSS0_DAT_REGION";

mmu_armv85.$name = "CLEC";
mmu_armv85.vAddr = 0x7D200000;
mmu_armv85.pAddr = 0x7D200000;
mmu_armv85.size  = 0x100000;

mmu_armv86.$name = "DRU";
mmu_armv86.vAddr = 0x7D400000;
mmu_armv86.pAddr = 0x7D400000;
mmu_armv86.size  = 0x300000;

mmu_armv87.$name       = "MCASP";
mmu_armv87.vAddr       = 0x2B10000;
mmu_armv87.pAddr       = 0x2B10000;
mmu_armv87.size        = 0x2000000;
mmu_armv87.privExecute = false;

mmu_armv88.$name     = "MSRAM_BANK0_TO_BANK3";
mmu_armv88.vAddr     = 0x80000000;
mmu_armv88.pAddr     = 0x80000000;
mmu_armv88.size      = 0x400000;
mmu_armv88.attribute = "MAIR7";

mmu_armv89.$name     = "MSRAM_BANK4_TO_BANK5";
mmu_armv89.size      = 0x200000;
mmu_armv89.vAddr     = 0x80400000;
mmu_armv89.pAddr     = 0x80400000;
mmu_armv89.attribute = "MAIR7";

mmu_armv810.$name     = "CCS_DEBUG_LOG_MEM";
mmu_armv810.vAddr     = 0x8027F000;
mmu_armv810.pAddr     = 0x8027F000;
mmu_armv810.size      = 0x1000;
mmu_armv810.attribute = "MAIR4";

mmu_armv811.$name     = "L2SRAM_C75SS1";
mmu_armv811.vAddr     = 0x7F000000;
mmu_armv811.pAddr     = 0x7F000000;
mmu_armv811.size      = 0x200000;
mmu_armv811.attribute = "MAIR7";

mmu_armv812.$name     = "L2SRAM_AUX";
mmu_armv812.vAddr     = 0x7F200000;
mmu_armv812.pAddr     = 0x7F200000;
mmu_armv812.size      = 0x40000;
mmu_armv812.attribute = "MAIR7";

/**
 * Pinmux solution for unlocked pins/peripherals. This ensures that minor changes to the automatic solver in a future
 * version of the tool will not impact the pinmux you originally saw.  These lines can be completely deleted in order to
 * re-solve from scratch.
 */
mcasp1.MCASP.AFSX.$suggestSolution             = "MCASP0_AFSX";
mcasp1.MCASP.ACLKX.$suggestSolution            = "MCASP0_ACLKX";
mcasp1.MCASP.AFSR.$suggestSolution             = "MCASP0_AXR13";
mcasp1.MCASP.ACLKR.$suggestSolution            = "MCASP0_AXR12";
mcasp1.mcaspSer[0].MCASP.AXR0.$suggestSolution = "MCASP0_AXR0";
mcasp1.mcaspSer[1].MCASP.AXR1.$suggestSolution = "MCASP0_AXR1";
mcasp2.MCASP.AFSX.$suggestSolution             = "MCASP1_AFSX";
mcasp2.MCASP.ACLKX.$suggestSolution            = "MCASP1_ACLKX";
mcasp2.MCASP.AFSR.$suggestSolution             = "MCASP0_AXR15";
mcasp2.MCASP.ACLKR.$suggestSolution            = "MCASP0_AXR14";
mcasp2.mcaspSer[0].MCASP.AXR0.$suggestSolution = "MCASP1_AXR0";
mcasp2.mcaspSer[1].MCASP.AXR1.$suggestSolution = "MCASP1_AXR1";
mcasp3.MCASP.AFSX.$suggestSolution             = "MCASP2_AFSX";
mcasp3.MCASP.ACLKX.$suggestSolution            = "MCASP2_ACLKX";
mcasp3.MCASP.AFSR.$suggestSolution             = "MCASP4_AXR2";
mcasp3.MCASP.ACLKR.$suggestSolution            = "MCASP4_AXR1";
mcasp3.mcaspSer[0].MCASP.AXR0.$suggestSolution = "MCASP2_AXR0";
mcasp3.mcaspSer[1].MCASP.AXR1.$suggestSolution = "MCASP2_AXR1";
