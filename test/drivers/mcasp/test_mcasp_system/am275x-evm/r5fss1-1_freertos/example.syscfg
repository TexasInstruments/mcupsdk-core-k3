/**
 * @cliArgs --device "AM275x" --part "AM2754" --package "ANJ" --context "r5fss1-1" --product "MCU_PLUS_SDK@07.03.01"
 * @versions {"tool":"1.26.2+4477"}
 */

/**
 * Import the modules used in this configuration.
 */
const ipc        = scripting.addModule("/drivers/ipc/ipc");
const mcasp      = scripting.addModule("/drivers/mcasp/mcasp", {}, false);
const mcasp1     = mcasp.addInstance();
const mcasp2     = mcasp.addInstance();
const mcasp3     = mcasp.addInstance();
const debug_log  = scripting.addModule("/kernel/dpl/debug_log");
const mpu_armv7  = scripting.addModule("/kernel/dpl/mpu_armv7", {}, false);
const mpu_armv71 = mpu_armv7.addInstance();
const mpu_armv72 = mpu_armv7.addInstance();
const mpu_armv73 = mpu_armv7.addInstance();
const mpu_armv74 = mpu_armv7.addInstance();
const mpu_armv75 = mpu_armv7.addInstance();
const mpu_armv76 = mpu_armv7.addInstance();

/**
 * Write custom configuration values to the imported modules.
 */
ipc.wkup_r5fss0_0 = "NONE";
ipc.r5fss0_0      = "notify";
ipc.r5fss0_1      = "notify";
ipc.r5fss1_0      = "notify";
ipc.c75ss0_0      = "notify";
ipc.c75ss1_0      = "notify";

debug_log.enableSharedMemLog = true;

mcasp1.$name                                   = "CONFIG_MCASP0";
mcasp1.txDataMask                              = 0xFFFFFFFF;
mcasp1.txActiveSlotMask                        = 0x3;
mcasp1.rxDataMask                              = 0xFFFFFFFF;
mcasp1.rxActiveSlotMask                        = 0x3;
mcasp1.txLoopjobBufLength                      = 1280;
mcasp1.rxLoopjobBufLength                      = 1280;
mcasp1.txCallbackFxn                           = "mcasp_txcb";
mcasp1.rxCallbackFxn                           = "mcasp_rxcb";
mcasp1.txClkApplyAlert                         = false;
mcasp1.rxClkApplyAlert                         = false;
mcasp1.MCASP.$assignAllowConflicts             = "MCASP0";
mcasp1.CLOCKING.$assignAllowConflicts          = "CLOCKING";
mcasp1.mcaspSer.create(2);
mcasp1.mcaspSer[0].$name                       = "CONFIG_MCASP_SER0";
mcasp1.mcaspSer[0].MCASP.$assignAllowConflicts = "MCASP0";
mcasp1.mcaspSer[1].$name                       = "CONFIG_MCASP_SER1";
mcasp1.mcaspSer[1].serNum                      = 1;
mcasp1.mcaspSer[1].dataDir                     = "Receive";
mcasp1.mcaspSer[1].MCASP.$assignAllowConflicts = "MCASP0";
scripting.suppress("Resource conflict,MCASP0 is also in use by @@@.+?@@@, @@@.+?@@@", mcasp1.MCASP, "$assign");
scripting.suppress("Resource conflict,CLOCKING is also in use by @@@.+?@@@, @@@.+?@@@", mcasp1.CLOCKING, "$assign");
scripting.suppress("Resource conflict,MCASP0 is also in use by @@@.+?@@@, @@@.+?@@@", mcasp1.mcaspSer[0].MCASP, "$assign");
scripting.suppress("Resource conflict,MCASP0 is also in use by @@@.+?@@@, @@@.+?@@@", mcasp1.mcaspSer[1].MCASP, "$assign");

mcasp2.$name                                   = "CONFIG_MCASP1";
mcasp2.txDataMask                              = 0xFFFFFFFF;
mcasp2.txActiveSlotMask                        = 0x3;
mcasp2.rxDataMask                              = 0xFFFFFFFF;
mcasp2.rxActiveSlotMask                        = 0x3;
mcasp2.txLoopjobBufLength                      = 1280;
mcasp2.rxLoopjobBufLength                      = 1280;
mcasp2.txCallbackFxn                           = "mcasp_txcb";
mcasp2.rxCallbackFxn                           = "mcasp_rxcb";
mcasp2.txLoopjobBuf                            = "gTxLoopjobBuf1";
mcasp2.txHclkSource                            = 0;
mcasp2.txHclkSourceMux                         = 1;
mcasp2.rxLoopjobBuf                            = "gRxLoopjobBuf1";
mcasp2.rxHclkSource                            = 0;
mcasp2.rxHclkSourceMux                         = 1;
mcasp2.txHclkExpected                          = 24576000;
mcasp2.txClkApplyAlert                         = false;
mcasp2.rxHclkExpected                          = 24576000;
mcasp2.rxClkApplyAlert                         = false;
mcasp2.MCASP.$assignAllowConflicts             = "MCASP1";
mcasp2.mcaspSer.create(2);
mcasp2.mcaspSer[0].$name                       = "CONFIG_MCASP_SER2";
mcasp2.mcaspSer[0].MCASP.$assignAllowConflicts = "MCASP1";
mcasp2.mcaspSer[1].$name                       = "CONFIG_MCASP_SER3";
mcasp2.mcaspSer[1].serNum                      = 1;
mcasp2.mcaspSer[1].dataDir                     = "Receive";
mcasp2.mcaspSer[1].MCASP.$assignAllowConflicts = "MCASP1";
mcasp2.CLOCKING.$assignAllowConflicts          = "CLOCKING";
mcasp2.CLOCKING.CLKOUT0.$assignAllowConflicts  = "EXT_REFCLK1";
scripting.suppress("Resource conflict,MCASP1 is also in use by @@@.+?@@@, @@@.+?@@@", mcasp2.MCASP, "$assign");
scripting.suppress("Resource conflict,MCASP1 is also in use by @@@.+?@@@, @@@.+?@@@", mcasp2.mcaspSer[0].MCASP, "$assign");
scripting.suppress("Resource conflict,MCASP1 is also in use by @@@.+?@@@, @@@.+?@@@", mcasp2.mcaspSer[1].MCASP, "$assign");
scripting.suppress("Resource conflict,CLOCKING is also in use by @@@.+?@@@, @@@.+?@@@", mcasp2.CLOCKING, "$assign");
scripting.suppress("Resource conflict,@@@.+?@@@ is also in use by @@@.+?@@@", mcasp2.CLOCKING, "CLKOUT0");

mcasp3.$name                                   = "CONFIG_MCASP2";
mcasp3.txDataMask                              = 0xFFFFFFFF;
mcasp3.txActiveSlotMask                        = 0x3;
mcasp3.rxDataMask                              = 0xFFFFFFFF;
mcasp3.rxActiveSlotMask                        = 0x3;
mcasp3.txLoopjobBufLength                      = 1280;
mcasp3.rxLoopjobBufLength                      = 1280;
mcasp3.txCallbackFxn                           = "mcasp_txcb";
mcasp3.rxCallbackFxn                           = "mcasp_rxcb";
mcasp3.txHclkSource                            = 0;
mcasp3.txHclkSourceMux                         = 1;
mcasp3.rxHclkSource                            = 0;
mcasp3.rxHclkSourceMux                         = 1;
mcasp3.rxLoopjobBuf                            = "gRxLoopjobBuf2";
mcasp3.txLoopjobBuf                            = "gTxLoopjobBuf2";
mcasp3.txHclkExpected                          = 24576000;
mcasp3.txClkApplyAlert                         = false;
mcasp3.rxHclkExpected                          = 24576000;
mcasp3.rxClkApplyAlert                         = false;
mcasp3.MCASP.$assignAllowConflicts             = "MCASP2";
mcasp3.mcaspSer.create(2);
mcasp3.mcaspSer[0].$name                       = "CONFIG_MCASP_SER4";
mcasp3.mcaspSer[0].MCASP.$assignAllowConflicts = "MCASP2";
mcasp3.mcaspSer[1].$name                       = "CONFIG_MCASP_SER5";
mcasp3.mcaspSer[1].serNum                      = 1;
mcasp3.mcaspSer[1].dataDir                     = "Receive";
mcasp3.mcaspSer[1].MCASP.$assignAllowConflicts = "MCASP2";
mcasp3.CLOCKING.$assignAllowConflicts          = "CLOCKING";
mcasp3.CLOCKING.CLKOUT0.$assignAllowConflicts  = "EXT_REFCLK1";
scripting.suppress("Resource conflict,MCASP2 is also in use by @@@.+?@@@, @@@.+?@@@", mcasp3.MCASP, "$assign");
scripting.suppress("Resource conflict,MCASP2 is also in use by @@@.+?@@@, @@@.+?@@@", mcasp3.mcaspSer[0].MCASP, "$assign");
scripting.suppress("Resource conflict,MCASP2 is also in use by @@@.+?@@@, @@@.+?@@@", mcasp3.mcaspSer[1].MCASP, "$assign");
scripting.suppress("Resource conflict,CLOCKING is also in use by @@@.+?@@@, @@@.+?@@@", mcasp3.CLOCKING, "$assign");
scripting.suppress("Resource conflict,@@@.+?@@@ is also in use by @@@.+?@@@", mcasp3.CLOCKING, "CLKOUT0");

const udma         = scripting.addModule("/drivers/udma/udma", {}, false);
const udma1        = udma.addInstance({}, false);
udma1.$name        = "CONFIG_UDMA0";
mcasp1.bcDmaDriver = udma1;
mcasp2.bcDmaDriver = udma1;
mcasp3.bcDmaDriver = udma1;

debug_log.enableUartLog        = true;
debug_log.uartLog.$name        = "CONFIG_UART0";
debug_log.uartLog.UART.$assign = "UART0";

mpu_armv71.size         = 31;
mpu_armv71.attributes   = "Device";
mpu_armv71.allowExecute = false;
mpu_armv71.$name        = "REGISTERS";

mpu_armv72.size  = 15;
mpu_armv72.$name = "TCMA";

mpu_armv73.baseAddr = 0x41010000;
mpu_armv73.size     = 15;
mpu_armv73.$name    = "TCMB";

mpu_armv74.size     = 22;
mpu_armv74.baseAddr = 0x72000000;
mpu_armv74.$name    = "MSRAM_BANK0_TO_BANK3";

mpu_armv75.baseAddr = 0x72400000;
mpu_armv75.size     = 21;
mpu_armv75.$name    = "MSRAM_BANK4_TO_BANK5";

mpu_armv76.$name        = "LOG_SHM_MEM";
mpu_armv76.baseAddr     = 0x72380000;
mpu_armv76.size         = 18;
mpu_armv76.allowExecute = false;
mpu_armv76.attributes   = "NonCached";

/**
 * Pinmux solution for unlocked pins/peripherals. This ensures that minor changes to the automatic solver in a future
 * version of the tool will not impact the pinmux you originally saw.  These lines can be completely deleted in order to
 * re-solve from scratch.
 */
mcasp1.MCASP.AFSX.$suggestSolution             = "MCASP0_AFSX";
mcasp1.MCASP.ACLKX.$suggestSolution            = "MCASP0_ACLKX";
mcasp1.MCASP.AFSR.$suggestSolution             = "MCASP0_AXR13";
mcasp1.MCASP.ACLKR.$suggestSolution            = "MCASP0_AXR12";
mcasp1.mcaspSer[0].MCASP.AXR0.$suggestSolution = "MCASP0_AXR0";
mcasp1.mcaspSer[1].MCASP.AXR1.$suggestSolution = "MCASP0_AXR1";
mcasp2.MCASP.AFSX.$suggestSolution             = "MCASP1_AFSX";
mcasp2.MCASP.ACLKX.$suggestSolution            = "MCASP1_ACLKX";
mcasp2.MCASP.AFSR.$suggestSolution             = "MCASP0_AXR15";
mcasp2.MCASP.ACLKR.$suggestSolution            = "MCASP0_AXR14";
mcasp2.mcaspSer[0].MCASP.AXR0.$suggestSolution = "MCASP1_AXR0";
mcasp2.mcaspSer[1].MCASP.AXR1.$suggestSolution = "MCASP1_AXR1";
mcasp3.MCASP.AFSX.$suggestSolution             = "MCASP2_AFSX";
mcasp3.MCASP.ACLKX.$suggestSolution            = "MCASP2_ACLKX";
mcasp3.MCASP.AFSR.$suggestSolution             = "MCASP4_AXR2";
mcasp3.MCASP.ACLKR.$suggestSolution            = "MCASP4_AXR1";
mcasp3.mcaspSer[0].MCASP.AXR0.$suggestSolution = "MCASP2_AXR0";
mcasp3.mcaspSer[1].MCASP.AXR1.$suggestSolution = "MCASP2_AXR1";
debug_log.uartLog.UART.RXD.$suggestSolution    = "MCASP4_AXR0";
debug_log.uartLog.UART.TXD.$suggestSolution    = "MLB0_MLBCLK";
