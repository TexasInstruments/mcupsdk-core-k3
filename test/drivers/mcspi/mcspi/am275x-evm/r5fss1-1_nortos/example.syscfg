/**
 * @cliArgs --device "AM275x" --part "AM2754" --package "ANJ" --context "r5fss1-1_nortos" --product "MCU_PLUS_SDK@07.03.01"
 * @versions {"tool":"1.26.2+4477"}
 */

/**
 * Import the modules used in this configuration.
 */
const mcspi      = scripting.addModule("/drivers/mcspi/mcspi", {}, false);
const mcspi1     = mcspi.addInstance();
const mcspi2     = mcspi.addInstance();
const mcspi3     = mcspi.addInstance();
const mcspi4     = mcspi.addInstance();
const udma       = scripting.addModule("/drivers/udma/udma", {}, false);
const udma1      = udma.addInstance();
const debug_log  = scripting.addModule("/kernel/dpl/debug_log");
const mpu_armv7  = scripting.addModule("/kernel/dpl/mpu_armv7", {}, false);
const mpu_armv71 = mpu_armv7.addInstance();
const mpu_armv72 = mpu_armv7.addInstance();
const mpu_armv73 = mpu_armv7.addInstance();
const mpu_armv74 = mpu_armv7.addInstance();
const mpu_armv75 = mpu_armv7.addInstance();

/**
 * Write custom configuration values to the imported modules.
 */
mcspi1.$name                 = "CONFIG_MCSPI0";
mcspi1.inputSelect           = "0";
mcspi1.SPI.CLK.$assign       = "SPI0_CLK";
mcspi1.mcspiChannel[0].$name = "CONFIG_MCSPI_CH0";

mcspi2.$name                 = "CONFIG_MCSPI1";
mcspi2.SPI.CLK.$assign       = "OSPI0_D5";
mcspi2.mcspiChannel[0].$name = "CONFIG_MCSPI_CH1";

mcspi3.$name                 = "CONFIG_MCSPI3";
mcspi3.mode                  = "MULTI_MASTER";
mcspi3.intrEnable            = "DMA";
mcspi3.mcspiChannel[0].$name = "CONFIG_MCSPI_CH2";

mcspi4.$name                 = "CONFIG_MCSPI4";
mcspi4.SPI.$assign           = "SPI3";
mcspi4.mcspiChannel[0].$name = "CONFIG_MCSPI_CH3";

udma1.$name       = "CONFIG_UDMA0";
mcspi3.udmaDriver = udma1;
udma1.instance    = "PKTDMA_0";

debug_log.enableUartLog            = true;
debug_log.uartLog.$name            = "CONFIG_UART0";
debug_log.uartLog.UART.RXD.$assign = "UART0_RXD";
debug_log.uartLog.UART.TXD.$assign = "UART0_TXD";

mpu_armv71.size         = 31;
mpu_armv71.attributes   = "Device";
mpu_armv71.allowExecute = false;
mpu_armv71.$name        = "REGISTERS";

mpu_armv72.size  = 15;
mpu_armv72.$name = "TCMA";

mpu_armv73.baseAddr = 0x41010000;
mpu_armv73.size     = 15;
mpu_armv73.$name    = "TCMB";

mpu_armv74.size     = 22;
mpu_armv74.baseAddr = 0x72000000;
mpu_armv74.$name    = "MSRAM_BANK0_TO_BANK3";

mpu_armv75.baseAddr = 0x72400000;
mpu_armv75.size     = 21;
mpu_armv75.$name    = "MSRAM_BANK4_TO_BANK5";

/**
 * Pinmux solution for unlocked pins/peripherals. This ensures that minor changes to the automatic solver in a future
 * version of the tool will not impact the pinmux you originally saw.  These lines can be completely deleted in order to
 * re-solve from scratch.
 */
mcspi1.SPI.$suggestSolution                 = "SPI0";
mcspi1.SPI.D0.$suggestSolution              = "SPI0_D0";
mcspi1.SPI.D1.$suggestSolution              = "SPI0_D1";
mcspi1.mcspiChannel[0].CSn.$suggestSolution = "SPI0_CS0";
mcspi2.SPI.$suggestSolution                 = "SPI1";
mcspi2.SPI.D0.$suggestSolution              = "OSPI0_D6";
mcspi2.SPI.D1.$suggestSolution              = "OSPI0_D7";
mcspi2.mcspiChannel[0].CSn.$suggestSolution = "OSPI0_D4";
mcspi3.SPI.$suggestSolution                 = "SPI2";
mcspi3.SPI.CLK.$suggestSolution             = "SPI2_CLK";
mcspi3.SPI.D0.$suggestSolution              = "SPI2_D0";
mcspi3.SPI.D1.$suggestSolution              = "SPI2_D1";
mcspi3.mcspiChannel[0].CSn.$suggestSolution = "SPI2_CS0";
mcspi4.SPI.CLK.$suggestSolution             = "MMC0_DAT0";
mcspi4.SPI.D0.$suggestSolution              = "MMC0_DAT5";
mcspi4.SPI.D1.$suggestSolution              = "MMC0_DAT4";
mcspi4.mcspiChannel[0].CSn.$suggestSolution = "MMC0_DAT1";
debug_log.uartLog.UART.$suggestSolution     = "UART0";
