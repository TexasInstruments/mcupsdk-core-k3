/**
 * @cliArgs --device "AM62Ax" --package "AMB" --part "Default" --context "mcu-r5fss0-0" --product "MCU_PLUS_SDK@07.03.01"
 * @versions {"tool":"1.19.0+3426"}
 */

/**
 * Import the modules used in this configuration.
 */
const mcspi      = scripting.addModule("/drivers/mcspi/mcspi", {}, false);
const mcspi1     = mcspi.addInstance();
const mcspi2     = mcspi.addInstance();
const mcspi3     = mcspi.addInstance();
const mcspi4     = mcspi.addInstance();
const udma       = scripting.addModule("/drivers/udma/udma", {}, false);
const udma1      = udma.addInstance();
const clock      = scripting.addModule("/kernel/dpl/clock");
const debug_log  = scripting.addModule("/kernel/dpl/debug_log");
const mpu_armv7  = scripting.addModule("/kernel/dpl/mpu_armv7", {}, false);
const mpu_armv71 = mpu_armv7.addInstance();
const mpu_armv72 = mpu_armv7.addInstance();
const mpu_armv73 = mpu_armv7.addInstance();
const mpu_armv74 = mpu_armv7.addInstance();
const mpu_armv75 = mpu_armv7.addInstance();
const mpu_armv76 = mpu_armv7.addInstance();

/**
 * Write custom configuration values to the imported modules.
 */
mcspi1.$name                 = "CONFIG_MCSPI0";
mcspi1.mode                  = "MULTI_MASTER";
mcspi1.MCU_SPI.$assign       = "MCU_SPI0";
mcspi1.mcspiChannel[0].$name = "CONFIG_MCSPI_CH0";

mcspi2.$name                 = "CONFIG_MCSPI1";
mcspi2.MCU_SPI.$assign       = "MCU_SPI1";
mcspi2.mcspiChannel[0].$name = "CONFIG_MCSPI_CH1";

mcspi3.useMcuDomainPeripherals = false;
mcspi3.mode                    = "MULTI_MASTER";
mcspi3.intrEnable              = "DMA";
mcspi3.$name                   = "CONFIG_MCSPI3";
mcspi3.SPI.$assign             = "SPI1";
mcspi3.mcspiChannel[0].$name   = "CONFIG_MCSPI_CH2";

mcspi4.$name                   = "CONFIG_MCSPI4";
mcspi4.useMcuDomainPeripherals = false;
mcspi4.mcspiChannel[0].$name   = "CONFIG_MCSPI_CH3";
mcspi4.SPI.$assign             = "SPI2";

udma1.$name       = "CONFIG_UDMA0";
mcspi3.udmaDriver = udma1;
udma1.instance    = "PKTDMA_0";

debug_log.enableUartLog = true;
debug_log.uartTrace     = true;
debug_log.uartLog.$name = "CONFIG_UART0";

mpu_armv71.$name             = "CONFIG_MPU_REGION0";
mpu_armv71.size              = 31;
mpu_armv71.attributes        = "Device";
mpu_armv71.accessPermissions = "Supervisor RD+WR, User RD";
mpu_armv71.allowExecute      = false;

mpu_armv72.$name             = "CONFIG_MPU_REGION1";
mpu_armv72.size              = 15;
mpu_armv72.accessPermissions = "Supervisor RD+WR, User RD";

mpu_armv73.$name             = "CONFIG_MPU_REGION2";
mpu_armv73.baseAddr          = 0x41010000;
mpu_armv73.size              = 15;
mpu_armv73.accessPermissions = "Supervisor RD+WR, User RD";

mpu_armv74.$name             = "CONFIG_MPU_REGION3";
mpu_armv74.accessPermissions = "Supervisor RD+WR, User RD";
mpu_armv74.baseAddr          = 0x79100000;
mpu_armv74.size              = 19;

mpu_armv75.$name             = "CONFIG_MPU_REGION4";
mpu_armv75.baseAddr          = 0x60000000;
mpu_armv75.size              = 28;
mpu_armv75.accessPermissions = "Supervisor RD, User RD";

mpu_armv76.$name    = "CONFIG_MPU_REGION5";
mpu_armv76.baseAddr = 0x80000000;
mpu_armv76.size     = 31;

/**
 * Pinmux solution for unlocked pins/peripherals. This ensures that minor changes to the automatic solver in a future
 * version of the tool will not impact the pinmux you originally saw.  These lines can be completely deleted in order to
 * re-solve from scratch.
 */
mcspi1.MCU_SPI.CLK.$suggestSolution             = "MCU_SPI0_CLK";
mcspi1.MCU_SPI.D0.$suggestSolution              = "MCU_SPI0_D0";
mcspi1.MCU_SPI.D1.$suggestSolution              = "MCU_SPI0_D1";
mcspi1.mcspiChannel[0].MCU_CSn.$suggestSolution = "MCU_SPI0_CS0";
mcspi2.MCU_SPI.CLK.$suggestSolution             = "MCU_MCAN1_RX";
mcspi2.MCU_SPI.D0.$suggestSolution              = "MCU_UART0_CTSn";
mcspi2.MCU_SPI.D1.$suggestSolution              = "MCU_UART0_RTSn";
mcspi2.mcspiChannel[0].MCU_CSn.$suggestSolution = "WKUP_UART0_CTSn";
mcspi3.SPI.CLK.$suggestSolution                 = "MMC0_DAT2";
mcspi3.SPI.D0.$suggestSolution                  = "MMC0_DAT7";
mcspi3.SPI.D1.$suggestSolution                  = "MMC0_DAT6";
mcspi3.mcspiChannel[0].CSn.$suggestSolution     = "MMC0_DAT3";
mcspi4.mcspiChannel[0].CSn.$suggestSolution     = "MMC0_DAT1";
mcspi4.SPI.CLK.$suggestSolution                 = "MMC0_DAT0";
mcspi4.SPI.D0.$suggestSolution                  = "MMC0_DAT5";
mcspi4.SPI.D1.$suggestSolution                  = "MMC0_DAT4";
debug_log.uartLog.MCU_UART.$suggestSolution     = "MCU_USART0";
debug_log.uartLog.MCU_UART.RXD.$suggestSolution = "MCU_UART0_RXD";
debug_log.uartLog.MCU_UART.TXD.$suggestSolution = "MCU_UART0_TXD";
