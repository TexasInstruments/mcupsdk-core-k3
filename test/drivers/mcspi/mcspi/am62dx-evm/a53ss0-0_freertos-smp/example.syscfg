/**
 * @cliArgs --device "AM62Dx" --part "AM62D24-G" --package "ANF" --context "a53ss0-0" --product "MCU_PLUS_SDK@07.03.01"
 * @versions {"tool":"1.24.2+4234"}
 */

/**
 * Import the modules used in this configuration.
 */
const mcspi      = scripting.addModule("/drivers/mcspi/mcspi", {}, false);
const mcspi1     = mcspi.addInstance();
const mcspi2     = mcspi.addInstance();
const mcspi3     = mcspi.addInstance();
const mcspi4     = mcspi.addInstance();
const mcspi5     = mcspi.addInstance();
const udma       = scripting.addModule("/drivers/udma/udma", {}, false);
const udma1      = udma.addInstance();
const debug_log  = scripting.addModule("/kernel/dpl/debug_log");
const mmu_armv8  = scripting.addModule("/kernel/dpl/mmu_armv8", {}, false);
const mmu_armv81 = mmu_armv8.addInstance();
const mmu_armv82 = mmu_armv8.addInstance();
const mmu_armv83 = mmu_armv8.addInstance();

/**
 * Write custom configuration values to the imported modules.
 */
mcspi1.$name                   = "CONFIG_MCSPI0";
mcspi1.inputSelect             = "0";
mcspi1.useMcuDomainPeripherals = true;
mcspi1.mode                    = "MULTI_MASTER";
mcspi1.mcspiChannel[0].$name   = "CONFIG_MCSPI_CH0";

mcspi2.$name                   = "CONFIG_MCSPI1";
mcspi2.inputSelect             = "0";
mcspi2.useMcuDomainPeripherals = true;
mcspi2.mcspiChannel[0].$name   = "CONFIG_MCSPI_CH1";
mcspi2.MCU_SPI.$assign         = "MCU_SPI1";

mcspi3.$name                 = "CONFIG_MCSPI3";
mcspi3.mode                  = "MULTI_MASTER";
mcspi3.intrEnable            = "DMA";
mcspi3.dpe1                  = "ENABLE";
mcspi3.inputSelect           = "0";
mcspi3.SPI.$assign           = "SPI1";
mcspi3.mcspiChannel[0].$name = "CONFIG_MCSPI_CH2";

mcspi4.$name                 = "CONFIG_MCSPI4";
mcspi4.inputSelect           = "0";
mcspi4.mcspiChannel[0].$name = "CONFIG_MCSPI_CH3";
mcspi4.SPI.$assign           = "SPI2";

mcspi5.$name                 = "CONFIG_MCSPI2";
mcspi5.inputSelect           = "0";
mcspi5.mode                  = "MULTI_MASTER";
mcspi5.SPI.$assign           = "SPI0";
mcspi5.mcspiChannel[0].$name = "CONFIG_MCSPI_CH4";

udma1.$name       = "CONFIG_UDMA0";
mcspi3.udmaDriver = udma1;
udma1.instance    = "PKTDMA_0";

debug_log.enableUartLog        = true;
debug_log.uartLog.$name        = "CONFIG_UART_CONSOLE";
debug_log.uartLog.intrEnable   = "DISABLE";
debug_log.uartLog.UART.$assign = "USART0";

mmu_armv81.size  = 0x80000000;
mmu_armv81.$name = "SOC_MEM_REGION";

mmu_armv82.vAddr     = 0x70000000;
mmu_armv82.pAddr     = 0x70000000;
mmu_armv82.size      = 0x200000;
mmu_armv82.attribute = "MAIR7";
mmu_armv82.$name     = "SHM_MEM_REGION";

mmu_armv83.vAddr     = 0x80000000;
mmu_armv83.pAddr     = 0x80000000;
mmu_armv83.size      = 0x80000000;
mmu_armv83.attribute = "MAIR7";
mmu_armv83.$name     = "DDR_REGION";

/**
 * Pinmux solution for unlocked pins/peripherals. This ensures that minor changes to the automatic solver in a future
 * version of the tool will not impact the pinmux you originally saw.  These lines can be completely deleted in order to
 * re-solve from scratch.
 */
mcspi1.MCU_SPI.$suggestSolution                 = "MCU_SPI0";
mcspi1.MCU_SPI.CLK.$suggestSolution             = "MCU_SPI0_CLK";
mcspi1.MCU_SPI.D0.$suggestSolution              = "MCU_SPI0_D0";
mcspi1.MCU_SPI.D1.$suggestSolution              = "MCU_SPI0_D1";
mcspi1.mcspiChannel[0].MCU_CSn.$suggestSolution = "MCU_SPI0_CS0";
mcspi2.mcspiChannel[0].MCU_CSn.$suggestSolution = "WKUP_UART0_CTSn";
mcspi2.MCU_SPI.CLK.$suggestSolution             = "MCU_MCAN1_RX";
mcspi2.MCU_SPI.D0.$suggestSolution              = "MCU_UART0_CTSn";
mcspi2.MCU_SPI.D1.$suggestSolution              = "MCU_UART0_RTSn";
mcspi3.SPI.CLK.$suggestSolution                 = "MMC0_DAT2";
mcspi3.SPI.D0.$suggestSolution                  = "MMC0_DAT7";
mcspi3.SPI.D1.$suggestSolution                  = "MMC0_DAT6";
mcspi3.mcspiChannel[0].CSn.$suggestSolution     = "MMC0_DAT3";
mcspi4.mcspiChannel[0].CSn.$suggestSolution     = "MMC0_DAT1";
mcspi4.SPI.CLK.$suggestSolution                 = "MMC0_DAT0";
mcspi4.SPI.D0.$suggestSolution                  = "MMC0_DAT5";
mcspi4.SPI.D1.$suggestSolution                  = "MMC0_DAT4";
mcspi5.SPI.CLK.$suggestSolution                 = "SPI0_CLK";
mcspi5.SPI.D0.$suggestSolution                  = "SPI0_D0";
mcspi5.SPI.D1.$suggestSolution                  = "SPI0_D1";
mcspi5.mcspiChannel[0].CSn.$suggestSolution     = "SPI0_CS0";
debug_log.uartLog.UART.RXD.$suggestSolution     = "UART0_RXD";
debug_log.uartLog.UART.TXD.$suggestSolution     = "UART0_TXD";
