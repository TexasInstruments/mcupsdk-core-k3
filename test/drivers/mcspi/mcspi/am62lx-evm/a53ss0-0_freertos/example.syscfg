/**
 * @cliArgs --device "AM62Lx" --part "AM62L32-G-ANB" --package "ANB" --context "a53ss0-0" --product "MCU_PLUS_SDK@07.03.01"
 * @versions {"tool":"1.23.0+4000"}
 */

/**
 * Import the modules used in this configuration.
 */
const mcspi      = scripting.addModule("/drivers/mcspi/mcspi", {}, false);
const mcspi1     = mcspi.addInstance();
const mcspi2     = mcspi.addInstance();
const mcspi3     = mcspi.addInstance();
const mcspi4     = mcspi.addInstance();
const debug_log  = scripting.addModule("/kernel/dpl/debug_log");
const mmu_armv8  = scripting.addModule("/kernel/dpl/mmu_armv8", {}, false);
const mmu_armv81 = mmu_armv8.addInstance();
const mmu_armv82 = mmu_armv8.addInstance();

/**
 * Write custom configuration values to the imported modules.
 */

mcspi1.$name                 = "CONFIG_MCSPI0";
mcspi1.inputSelect           = "0";
mcspi1.SPI.$assign           = "SPI0";
mcspi1.SPI.CLK.$assign       = "SPI0_CLK";
mcspi1.SPI.D0.$assign        = "SPI0_D0";
mcspi1.SPI.D1.$assign        = "SPI0_D1";
mcspi1.mcspiChannel[0].$name = "CONFIG_MCSPI_CH0";

mcspi2.$name                 = "CONFIG_MCSPI1";
mcspi2.SPI.$assign           = "SPI1";
mcspi2.SPI.CLK.$assign       = "MMC0_DAT2";
mcspi2.SPI.D0.$assign        = "MMC0_DAT7";
mcspi2.SPI.D1.$assign        = "MMC0_DAT6";
mcspi2.mcspiChannel[0].$name = "CONFIG_MCSPI_CH1";

mcspi3.$name                 = "CONFIG_MCSPI2";
mcspi3.mode                  = "MULTI_MASTER";
mcspi3.SPI.$assign           = "SPI2";
mcspi3.SPI.CLK.$assign       = "MMC0_DAT0";
mcspi3.SPI.D0.$assign        = "MMC0_DAT5";
mcspi3.SPI.D1.$assign        = "MMC0_DAT4";
mcspi3.mcspiChannel[0].$name = "CONFIG_MCSPI_CH2";

mcspi4.$name                 = "CONFIG_MCSPI3";
mcspi4.SPI.$assign           = "SPI3";
mcspi4.SPI.CLK.$assign       = "MMC1_CMD";
mcspi4.SPI.D0.$assign        = "MMC1_DAT3";
mcspi4.SPI.D1.$assign        = "MMC1_DAT2";
mcspi4.mcspiChannel[0].$name = "CONFIG_MCSPI_CH3";

debug_log.enableUartLog        = true;
debug_log.uartLog.$name        = "CONFIG_UART_CONSOLE";
debug_log.uartLog.intrEnable   = "DISABLE";
debug_log.uartLog.UART.$assign = "USART0";

mmu_armv81.size  = 0x80000000;
mmu_armv81.$name = "SOC_MEM_REGION";

mmu_armv82.size      = 0x80000000;
mmu_armv82.attribute = "MAIR7";
mmu_armv82.$name     = "DDR_REGION";
mmu_armv82.vAddr     = 0x80000000;
mmu_armv82.pAddr     = 0x80000000;

/**
 * Pinmux solution for unlocked pins/peripherals. This ensures that minor changes to the automatic solver in a future
 * version of the tool will not impact the pinmux you originally saw.  These lines can be completely deleted in order to
 * re-solve from scratch.
 */
mcspi1.mcspiChannel[0].CSn.$suggestSolution = "SPI0_CS0";
mcspi2.mcspiChannel[0].CSn.$suggestSolution = "MMC0_DAT3";
mcspi3.mcspiChannel[0].CSn.$suggestSolution = "MMC0_DAT1";
mcspi4.mcspiChannel[0].CSn.$suggestSolution = "MMC1_CLK";
debug_log.uartLog.UART.RXD.$suggestSolution = "UART0_RXD";
debug_log.uartLog.UART.TXD.$suggestSolution = "UART0_TXD";
