/**
 * @cliArgs --device "J722S_TDA4VEN_TDA4AEN_AM67" --package "AMW" --part "Default" --context "main-r5fss0-0" --product "MCU_PLUS_SDK@07.03.01"
 * @versions {"tool":"1.20.0+3587"}
 */

/**
 * Import the modules used in this configuration.
 */
const mcspi     = scripting.addModule("/drivers/mcspi/mcspi", {}, false);
const mcspi1    = mcspi.addInstance();
const mcspi2    = mcspi.addInstance();
const debug_log = scripting.addModule("/kernel/dpl/debug_log");

/**
 * Write custom configuration values to the imported modules.
 */
mcspi1.$name                 = "CONFIG_MCSPI0";
mcspi1.SPI.CLK.$assign       = "SPI0_CLK";
mcspi1.mcspiChannel[0].$name = "CONFIG_MCSPI_CH0";

mcspi2.$name                 = "CONFIG_MCSPI1";
mcspi2.mcspiChannel[0].$name = "CONFIG_MCSPI_CH1";

debug_log.enableUartLog = true;
debug_log.uartLog.$name = "CONFIG_UART0";

/**
 * Pinmux solution for unlocked pins/peripherals. This ensures that minor changes to the automatic solver in a future
 * version of the tool will not impact the pinmux you originally saw.  These lines can be completely deleted in order to
 * re-solve from scratch.
 */
mcspi1.SPI.$suggestSolution                      = "SPI0";
mcspi1.SPI.D0.$suggestSolution                   = "SPI0_D0";
mcspi1.SPI.D1.$suggestSolution                   = "SPI0_D1";
mcspi1.mcspiChannel[0].CSn.$suggestSolution      = "SPI0_CS0";
mcspi2.SPI.$suggestSolution                      = "SPI1";
mcspi2.SPI.CLK.$suggestSolution                  = "MMC1_CMD";
mcspi2.SPI.D0.$suggestSolution                   = "MMC1_DAT3";
mcspi2.SPI.D1.$suggestSolution                   = "MMC1_DAT2";
mcspi2.mcspiChannel[0].CSn.$suggestSolution      = "MMC1_CLK";
debug_log.uartLog.WKUP_UART.$suggestSolution     = "WKUP_USART0";
debug_log.uartLog.WKUP_UART.RXD.$suggestSolution = "WKUP_UART0_RXD";
debug_log.uartLog.WKUP_UART.TXD.$suggestSolution = "WKUP_UART0_TXD";
