/**
 * @cliArgs --device "AM62Dx" --part "AM62D24-G" --package "ANF" --context "a53ss0-0" --product "MCU_PLUS_SDK@07.03.01"
 * @versions {"tool":"1.24.2+4234"}
 */

/**
 * Import the modules used in this configuration.
 */
const ipc        = scripting.addModule("/drivers/ipc/ipc");
const mcspi      = scripting.addModule("/drivers/mcspi/mcspi", {}, false);
const mcspi1     = mcspi.addInstance();
const debug_log  = scripting.addModule("/kernel/dpl/debug_log");
const mmu_armv8  = scripting.addModule("/kernel/dpl/mmu_armv8", {}, false);
const mmu_armv81 = mmu_armv8.addInstance();
const mmu_armv82 = mmu_armv8.addInstance();
const mmu_armv83 = mmu_armv8.addInstance();
const mmu_armv84 = mmu_armv8.addInstance();

/**
 * Write custom configuration values to the imported modules.
 */
ipc.enableLinuxIpc = false;
ipc.mcu_r5fss0_0   = "notify";
ipc.r5fss0_0       = "notify";
ipc.c75ss0_0       = "notify";

mcspi1.$name                 = "CONFIG_MCSPI0";
mcspi1.mode                  = "MULTI_MASTER";
mcspi1.SPI.$assign           = "SPI0";
mcspi1.mcspiChannel[0].$name = "CONFIG_MCSPI_CH0";

debug_log.enableSharedMemLog = true;

mmu_armv81.$name = "CONFIG_MMU_REGION0";
mmu_armv81.size  = 0x80000000;

mmu_armv82.$name     = "CONFIG_MMU_REGION1";
mmu_armv82.vAddr     = 0x70000000;
mmu_armv82.pAddr     = 0x70000000;
mmu_armv82.size      = 0x200000;
mmu_armv82.attribute = "MAIR7";

mmu_armv83.$name     = "CONFIG_MMU_REGION2";
mmu_armv83.vAddr     = 0x80000000;
mmu_armv83.pAddr     = 0x80000000;
mmu_armv83.size      = 0x80000000;
mmu_armv83.attribute = "MAIR7";

mmu_armv84.$name     = "CONFIG_MMU_REGION3";
mmu_armv84.vAddr     = 0xA1000000;
mmu_armv84.pAddr     = 0xA1000000;
mmu_armv84.size      = 0x40000;
mmu_armv84.attribute = "MAIR4";

/**
 * Pinmux solution for unlocked pins/peripherals. This ensures that minor changes to the automatic solver in a future
 * version of the tool will not impact the pinmux you originally saw.  These lines can be completely deleted in order to
 * re-solve from scratch.
 */
mcspi1.SPI.CLK.$suggestSolution             = "SPI0_CLK";
mcspi1.SPI.D0.$suggestSolution              = "SPI0_D0";
mcspi1.SPI.D1.$suggestSolution              = "SPI0_D1";
mcspi1.mcspiChannel[0].CSn.$suggestSolution = "SPI0_CS0";
