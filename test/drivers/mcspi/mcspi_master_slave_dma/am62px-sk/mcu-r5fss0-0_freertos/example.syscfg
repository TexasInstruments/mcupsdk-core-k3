/**
 * @cliArgs --device "AM62Px" --package "AMH" --part "Default" --context "mcu-r5fss0-0" --product "MCU_PLUS_SDK@07.03.01"
 * @versions {"tool":"1.18.0+3266"}
 */

/**
 * Import the modules used in this configuration.
 */
const ipc        = scripting.addModule("/drivers/ipc/ipc");
const mcspi      = scripting.addModule("/drivers/mcspi/mcspi", {}, false);
const mcspi1     = mcspi.addInstance();
const udma       = scripting.addModule("/drivers/udma/udma", {}, false);
const udma1      = udma.addInstance();
const debug_log  = scripting.addModule("/kernel/dpl/debug_log");
const mpu_armv7  = scripting.addModule("/kernel/dpl/mpu_armv7", {}, false);
const mpu_armv71 = mpu_armv7.addInstance();
const mpu_armv72 = mpu_armv7.addInstance();
const mpu_armv73 = mpu_armv7.addInstance();
const mpu_armv74 = mpu_armv7.addInstance();
const mpu_armv75 = mpu_armv7.addInstance();
const mpu_armv76 = mpu_armv7.addInstance();
const mpu_armv77 = mpu_armv7.addInstance();
const mpu_armv78 = mpu_armv7.addInstance();
const mpu_armv79 = mpu_armv7.addInstance();

/**
 * Write custom configuration values to the imported modules.
 */
ipc.vringAllocationPDK         = false;
ipc.wkup_r5fss0_0              = "notify";
ipc.enableLinuxIpc             = false;

mcspi1.$name                   = "CONFIG_MCSPI0";
mcspi1.mode                    = "SLAVE";
mcspi1.intrEnable              = "DMA";
mcspi1.useMcuDomainPeripherals = false;
mcspi1.SPI.$assign             = "SPI2";
mcspi1.mcspiChannel[0].$name   = "CONFIG_MCSPI_CH0";
mcspi1.udmaDriver              = udma1;

udma1.$name    = "CONFIG_UDMA0";
udma1.instance = "PKTDMA_0";

debug_log.enableCssLog       = false;
debug_log.enableSharedMemLog = true;

mpu_armv71.$name             = "CONFIG_MPU_REGION0";
mpu_armv71.size              = 31;
mpu_armv71.attributes        = "Device";
mpu_armv71.accessPermissions = "Supervisor RD+WR, User RD";
mpu_armv71.allowExecute      = false;

mpu_armv72.$name             = "CONFIG_MPU_REGION1";
mpu_armv72.size              = 15;
mpu_armv72.accessPermissions = "Supervisor RD+WR, User RD";

mpu_armv73.$name             = "CONFIG_MPU_REGION2";
mpu_armv73.baseAddr          = 0x41010000;
mpu_armv73.size              = 15;
mpu_armv73.accessPermissions = "Supervisor RD+WR, User RD";

mpu_armv74.$name             = "CONFIG_MPU_REGION3";
mpu_armv74.accessPermissions = "Supervisor RD+WR, User RD";
mpu_armv74.baseAddr          = 0x79100000;
mpu_armv74.size              = 19;

mpu_armv75.$name             = "CONFIG_MPU_REGION4";
mpu_armv75.baseAddr          = 0x60000000;
mpu_armv75.size              = 28;
mpu_armv75.accessPermissions = "Supervisor RD, User RD";

mpu_armv76.$name    = "CONFIG_MPU_REGION5";
mpu_armv76.baseAddr = 0x80000000;
mpu_armv76.size     = 31;

mpu_armv77.attributes = "NonCached";
mpu_armv77.baseAddr   = 0x9B500000;
mpu_armv77.size       = 20;
mpu_armv77.$name      = "CONFIG_MPU_RTOS_VRING1";

mpu_armv78.allowExecute = false;
mpu_armv78.attributes   = "NonCached";
mpu_armv78.baseAddr     = 0x9B600000;
mpu_armv78.size         = 21;
mpu_armv78.$name        = "CONFIG_MPU_RTOS_VRING2";

mpu_armv79.$name      = "LOG_SHM_MEM";
mpu_armv79.baseAddr   = 0xA1000000;
mpu_armv79.attributes = "NonCached";
mpu_armv79.size       = 18;

/**
 * Pinmux solution for unlocked pins/peripherals. This ensures that minor changes to the automatic solver in a future
 * version of the tool will not impact the pinmux you originally saw.  These lines can be completely deleted in order to
 * re-solve from scratch.
 */
mcspi1.SPI.CLK.$suggestSolution             = "MMC1_SDCD";
mcspi1.SPI.D0.$suggestSolution              = "MMC1_DAT1";
mcspi1.SPI.D1.$suggestSolution              = "MMC1_DAT0";
mcspi1.mcspiChannel[0].CSn.$suggestSolution = "MMC1_CMD";
