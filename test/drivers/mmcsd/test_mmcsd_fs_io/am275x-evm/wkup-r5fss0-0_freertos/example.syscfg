/**
 * @cliArgs --device "AM275x" --part "AM2754" --package "ANJ" --context "wkup-r5fss0-0" --product "MCU_PLUS_SDK@07.03.01"
 * @versions {"tool":"1.22.0+3893"}
 */

/**
 * Import the modules used in this configuration.
 * Note: Do NOT add a standalone /drivers/mmcsd/mmcsd instance; the FreeRTOS-FAT
 *       peripheralDriver will create and own the single MMCSD instance.
 */
const freertos_fat  = scripting.addModule("/fs/freertos_fat/freertos_fat", {}, false);
const freertos_fat1 = freertos_fat.addInstance();
const debug_log     = scripting.addModule("/kernel/dpl/debug_log");
const mpu_armv7     = scripting.addModule("/kernel/dpl/mpu_armv7", {}, false);
const mpu_armv71    = mpu_armv7.addInstance();
const mpu_armv72    = mpu_armv7.addInstance();
const mpu_armv73    = mpu_armv7.addInstance();
const mpu_armv74    = mpu_armv7.addInstance();
const mpu_armv75    = mpu_armv7.addInstance();
const mpu_armv76    = mpu_armv7.addInstance();
const mpu_armv77    = mpu_armv7.addInstance();

/**
 * Write custom configuration values to the imported modules.
 */
freertos_fat1.$name                          = "CONFIG_FREERTOS_FAT0";
freertos_fat1.media                          = "EMMC";
freertos_fat1.peripheralDriver.$name         = "CONFIG_MMCSD_EMMC";  // matches C sources
freertos_fat1.peripheralDriver.cardType      = "EMMC";               // ensure driver config matches media

debug_log.enableUartLog                      = true;
debug_log.uartLog.$name                      = "CONFIG_UART0";
debug_log.uartLog.useWakeupDomainPeripherals = true;
debug_log.uartLog.WKUP_UART.$assign          = "WKUP_UART";

/* MPU regions */
mpu_armv71.size              = 31;
mpu_armv71.attributes        = "Device";
mpu_armv71.accessPermissions = "Supervisor RD+WR, User RD";
mpu_armv71.allowExecute      = false;
mpu_armv71.$name             = "CONFIG_MPU_REGISTER";

mpu_armv72.size              = 15;
mpu_armv72.accessPermissions = "Supervisor RD+WR, User RD";
mpu_armv72.$name             = "CONFIG_MPU_TCMA";

mpu_armv73.baseAddr          = 0x41010000;
mpu_armv73.size              = 15;
mpu_armv73.accessPermissions = "Supervisor RD+WR, User RD";
mpu_armv73.$name             = "CONFIG_MPU_TCMB";

mpu_armv74.$name    = "MSRAM_BANK0_TO_BANK3";
mpu_armv74.baseAddr = 0x72000000;
mpu_armv74.size     = 22;

mpu_armv75.$name    = "MSRAM_BANK4_TO_BANK5";
mpu_armv75.baseAddr = 0x72400000;
mpu_armv75.size     = 21;

mpu_armv76.$name        = "MMCSD_CTL_CFG_REGISTERS";
mpu_armv76.baseAddr     = 0x0FA00000;   // same as 0xFA00000
mpu_armv76.size         = 12;
mpu_armv76.allowExecute = false;
mpu_armv76.attributes   = "Device";

mpu_armv77.size         = 10;
mpu_armv77.$name        = "MMCSD_SS_CFG_REGISTERS";
mpu_armv77.baseAddr     = 0x0FA08000;   // same as 0xFA08000
mpu_armv77.attributes   = "Device";
mpu_armv77.allowExecute = false;

/**
 * Pinmux assignments locked for wkup build.
 * Assign on the peripheralDriver's MMC instance to avoid resource conflicts.
 */
freertos_fat1.peripheralDriver.MMC.$assign          = "MMC0";
freertos_fat1.peripheralDriver.MMC.MMC_CLK.$assign  = "MMC0_CLK";
freertos_fat1.peripheralDriver.MMC.MMC_CMD.$assign  = "MMC0_CMD";
freertos_fat1.peripheralDriver.MMC.MMC_DAT0.$assign = "MMC0_DAT0";
freertos_fat1.peripheralDriver.MMC.MMC_DAT1.$assign = "MMC0_DAT1";
freertos_fat1.peripheralDriver.MMC.MMC_DAT2.$assign = "MMC0_DAT2";
freertos_fat1.peripheralDriver.MMC.MMC_DAT3.$assign = "MMC0_DAT3";
freertos_fat1.peripheralDriver.MMC.MMC_DAT4.$assign = "MMC0_DAT4";
freertos_fat1.peripheralDriver.MMC.MMC_DAT5.$assign = "MMC0_DAT5";
freertos_fat1.peripheralDriver.MMC.MMC_DAT6.$assign = "MMC0_DAT6";
freertos_fat1.peripheralDriver.MMC.MMC_DAT7.$assign = "MMC0_DAT7";

debug_log.uartLog.WKUP_UART.RXD.$assign = "WKUP_UART0_RXD";
debug_log.uartLog.WKUP_UART.TXD.$assign = "WKUP_UART0_TXD";
