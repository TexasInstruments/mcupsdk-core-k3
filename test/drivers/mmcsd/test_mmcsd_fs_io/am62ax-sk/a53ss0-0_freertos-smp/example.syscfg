/**
 * @cliArgs --device "AM62Ax" --part "Default" --package "AMB" --context "a53ss0-0" --product "MCU_PLUS_SDK@07.03.01"
 * @versions {"tool":"1.24.0+4150"}
 */

/**
 * Import the modules used in this configuration.
 */
const freertos_fat  = scripting.addModule("/fs/freertos_fat/freertos_fat", {}, false);
const freertos_fat1 = freertos_fat.addInstance();
const freertos_fat2 = freertos_fat.addInstance();
const debug_log     = scripting.addModule("/kernel/dpl/debug_log");
const mmu_armv8     = scripting.addModule("/kernel/dpl/mmu_armv8", {}, false);
const mmu_armv81    = mmu_armv8.addInstance();
const mmu_armv82    = mmu_armv8.addInstance();
const timer         = scripting.addModule("/kernel/dpl/timer", {}, false);
const timer1        = timer.addInstance();

/**
 * Write custom configuration values to the imported modules.
 */
freertos_fat1.$name                  = "CONFIG_FREERTOS_FAT0";
freertos_fat1.peripheralDriver.$name = "CONFIG_MMCSD_SD";

freertos_fat2.$name                  = "CONFIG_FREERTOS_FAT1";
freertos_fat2.media                  = "EMMC";
freertos_fat2.peripheralDriver.$name = "CONFIG_MMCSD_EMMC";

debug_log.enableUartLog        = true;
debug_log.uartLog.$name        = "CONFIG_UART_CONSOLE";
debug_log.uartLog.intrEnable   = "DISABLE";
debug_log.uartLog.UART.$assign = "USART0";

mmu_armv81.size  = 0x80000000;
mmu_armv81.$name = "SOC_MEM_REGION";

mmu_armv82.vAddr     = 0x80000000;
mmu_armv82.pAddr     = 0x80000000;
mmu_armv82.size      = 0x80000000;
mmu_armv82.attribute = "MAIR7";
mmu_armv82.$name     = "DDR_REGION";

timer1.$name         = "CONFIG_TIMER0";
timer1.TIMER.$assign = "DMTIMER4";

/**
 * Pinmux solution for unlocked pins/peripherals. This ensures that minor changes to the automatic solver in a future
 * version of the tool will not impact the pinmux you originally saw.  These lines can be completely deleted in order to
 * re-solve from scratch.
 */
freertos_fat1.peripheralDriver.MMC1.$suggestSolution      = "MMC1";
freertos_fat1.peripheralDriver.MMC1.CLK.$suggestSolution  = "MMC1_CLK";
freertos_fat1.peripheralDriver.MMC1.CMD.$suggestSolution  = "MMC1_CMD";
freertos_fat1.peripheralDriver.MMC1.DAT0.$suggestSolution = "MMC1_DAT0";
freertos_fat1.peripheralDriver.MMC1.DAT1.$suggestSolution = "MMC1_DAT1";
freertos_fat1.peripheralDriver.MMC1.DAT2.$suggestSolution = "MMC1_DAT2";
freertos_fat1.peripheralDriver.MMC1.DAT3.$suggestSolution = "MMC1_DAT3";
freertos_fat1.peripheralDriver.MMC1.SDCD.$suggestSolution = "MMC1_SDCD";
freertos_fat2.peripheralDriver.MMC0.$suggestSolution      = "MMC0";
freertos_fat2.peripheralDriver.MMC0.CLK.$suggestSolution  = "MMC0_CLK";
freertos_fat2.peripheralDriver.MMC0.CMD.$suggestSolution  = "MMC0_CMD";
freertos_fat2.peripheralDriver.MMC0.DAT0.$suggestSolution = "MMC0_DAT0";
freertos_fat2.peripheralDriver.MMC0.DAT1.$suggestSolution = "MMC0_DAT1";
freertos_fat2.peripheralDriver.MMC0.DAT2.$suggestSolution = "MMC0_DAT2";
freertos_fat2.peripheralDriver.MMC0.DAT3.$suggestSolution = "MMC0_DAT3";
freertos_fat2.peripheralDriver.MMC0.DAT4.$suggestSolution = "MMC0_DAT4";
freertos_fat2.peripheralDriver.MMC0.DAT5.$suggestSolution = "MMC0_DAT5";
freertos_fat2.peripheralDriver.MMC0.DAT6.$suggestSolution = "MMC0_DAT6";
freertos_fat2.peripheralDriver.MMC0.DAT7.$suggestSolution = "MMC0_DAT7";
debug_log.uartLog.UART.RXD.$suggestSolution               = "UART0_RXD";
debug_log.uartLog.UART.TXD.$suggestSolution               = "UART0_TXD";
