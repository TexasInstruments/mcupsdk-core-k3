/**
 * @cliArgs --device "AM62Dx" --part "AM62D22-G" --package "ANF" --context "r5fss0-0" --product "MCU_PLUS_SDK@07.03.01"
 * @versions {"tool":"1.24.0+4150"}
 */

/**
 * Import the modules used in this configuration.
 */
const freertos_fat  = scripting.addModule("/fs/freertos_fat/freertos_fat", {}, false);
const freertos_fat1 = freertos_fat.addInstance();
const freertos_fat2 = freertos_fat.addInstance();
const clock         = scripting.addModule("/kernel/dpl/clock");
const debug_log     = scripting.addModule("/kernel/dpl/debug_log");
const mpu_armv7     = scripting.addModule("/kernel/dpl/mpu_armv7", {}, false);
const mpu_armv71    = mpu_armv7.addInstance();
const mpu_armv72    = mpu_armv7.addInstance();
const mpu_armv73    = mpu_armv7.addInstance();
const mpu_armv74    = mpu_armv7.addInstance();
const mpu_armv75    = mpu_armv7.addInstance();
const mpu_armv76    = mpu_armv7.addInstance();

/**
 * Write custom configuration values to the imported modules.
 */
freertos_fat1.$name                  = "CONFIG_FREERTOS_FAT0";
freertos_fat1.peripheralDriver.$name = "CONFIG_MMCSD_SD";

freertos_fat2.$name                  = "CONFIG_FREERTOS_FAT1";
freertos_fat2.media                  = "EMMC";
freertos_fat2.peripheralDriver.$name = "CONFIG_MMCSD_EMMC";

debug_log.enableUartLog = true;
debug_log.uartTrace     = true;
debug_log.uartLog.$name = "CONFIG_UART0";

mpu_armv71.accessPermissions = "Supervisor RD+WR, User RD";
mpu_armv71.allowExecute      = false;
mpu_armv71.size              = 31;
mpu_armv71.attributes        = "Device";
mpu_armv71.$name             = "REGISTER_REGION";

mpu_armv72.accessPermissions = "Supervisor RD+WR, User RD";
mpu_armv72.size              = 7;
mpu_armv72.$name             = "TCMA_VEC";

mpu_armv73.$name    = "DDR";
mpu_armv73.baseAddr = 0x80000000;
mpu_armv73.size     = 31;

mpu_armv74.baseAddr   = 0x41010000;
mpu_armv74.size       = 15;
mpu_armv74.attributes = "NonCached";
mpu_armv74.$name      = "TCMB";

mpu_armv75.size       = 15;
mpu_armv75.attributes = "NonCached";
mpu_armv75.$name      = "TCMA";

mpu_armv76.baseAddr = 0x43C00000;
mpu_armv76.size     = 18;
mpu_armv76.$name    = "HSM_RAM";

/**
 * Pinmux solution for unlocked pins/peripherals. This ensures that minor changes to the automatic solver in a future
 * version of the tool will not impact the pinmux you originally saw.  These lines can be completely deleted in order to
 * re-solve from scratch.
 */
freertos_fat1.peripheralDriver.MMC1.$suggestSolution      = "MMC1";
freertos_fat1.peripheralDriver.MMC1.CLK.$suggestSolution  = "MMC1_CLK";
freertos_fat1.peripheralDriver.MMC1.CMD.$suggestSolution  = "MMC1_CMD";
freertos_fat1.peripheralDriver.MMC1.DAT0.$suggestSolution = "MMC1_DAT0";
freertos_fat1.peripheralDriver.MMC1.DAT1.$suggestSolution = "MMC1_DAT1";
freertos_fat1.peripheralDriver.MMC1.DAT2.$suggestSolution = "MMC1_DAT2";
freertos_fat1.peripheralDriver.MMC1.DAT3.$suggestSolution = "MMC1_DAT3";
freertos_fat1.peripheralDriver.MMC1.SDCD.$suggestSolution = "MMC1_SDCD";
freertos_fat2.peripheralDriver.MMC0.$suggestSolution      = "MMC0";
freertos_fat2.peripheralDriver.MMC0.CLK.$suggestSolution  = "MMC0_CLK";
freertos_fat2.peripheralDriver.MMC0.CMD.$suggestSolution  = "MMC0_CMD";
freertos_fat2.peripheralDriver.MMC0.DAT0.$suggestSolution = "MMC0_DAT0";
freertos_fat2.peripheralDriver.MMC0.DAT1.$suggestSolution = "MMC0_DAT1";
freertos_fat2.peripheralDriver.MMC0.DAT2.$suggestSolution = "MMC0_DAT2";
freertos_fat2.peripheralDriver.MMC0.DAT3.$suggestSolution = "MMC0_DAT3";
freertos_fat2.peripheralDriver.MMC0.DAT4.$suggestSolution = "MMC0_DAT4";
freertos_fat2.peripheralDriver.MMC0.DAT5.$suggestSolution = "MMC0_DAT5";
freertos_fat2.peripheralDriver.MMC0.DAT6.$suggestSolution = "MMC0_DAT6";
freertos_fat2.peripheralDriver.MMC0.DAT7.$suggestSolution = "MMC0_DAT7";
debug_log.uartLog.WKUP_UART.$suggestSolution              = "WKUP_USART0";
debug_log.uartLog.WKUP_UART.RXD.$suggestSolution          = "WKUP_UART0_RXD";
debug_log.uartLog.WKUP_UART.TXD.$suggestSolution          = "WKUP_UART0_TXD";
