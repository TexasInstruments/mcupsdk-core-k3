/**
 * @cliArgs --device "AM62Px" --part "Default" --package "AMH" --context "mcu-r5fss0-0" --product "MCU_PLUS_SDK@07.03.01"
 * @versions {"tool":"1.24.0+4150"}
 */

/**
 * Import the modules used in this configuration.
 */
const mmcsd      = scripting.addModule("/drivers/mmcsd/mmcsd", {}, false);
const mmcsd1     = mmcsd.addInstance();
const mmcsd2     = mmcsd.addInstance();
const clock      = scripting.addModule("/kernel/dpl/clock");
const debug_log  = scripting.addModule("/kernel/dpl/debug_log");
const mpu_armv7  = scripting.addModule("/kernel/dpl/mpu_armv7", {}, false);
const mpu_armv71 = mpu_armv7.addInstance();
const mpu_armv72 = mpu_armv7.addInstance();
const mpu_armv73 = mpu_armv7.addInstance();
const mpu_armv74 = mpu_armv7.addInstance();
const mpu_armv75 = mpu_armv7.addInstance();
const mpu_armv76 = mpu_armv7.addInstance();

/**
 * Write custom configuration values to the imported modules.
 */
mmcsd1.$name = "CONFIG_MMCSD_EMMC";

mmcsd2.moduleSelect = "MMC1";
mmcsd2.$name        = "CONFIG_MMCSD_SD";

debug_log.enableUartLog                = true;
debug_log.uartTrace                    = true;
debug_log.uartLog.$name                = "CONFIG_UART0";
debug_log.uartLog.intrEnable           = "DISABLE";
debug_log.uartLog.MCU_UART.$assign     = "MCU_USART0";
debug_log.uartLog.MCU_UART.RXD.$assign = "MCU_UART0_RXD";
debug_log.uartLog.MCU_UART.TXD.$assign = "MCU_UART0_TXD";

mpu_armv71.size         = 31;
mpu_armv71.attributes   = "Device";
mpu_armv71.allowExecute = false;
mpu_armv71.$name        = "CONFIG_MPU_REGISTER";

mpu_armv72.size       = 15;
mpu_armv72.$name      = "CONFIG_MPU_TCMA";
mpu_armv72.attributes = "NonCached";

mpu_armv73.baseAddr   = 0x41010000;
mpu_armv73.size       = 15;
mpu_armv73.$name      = "CONFIG_MPU_TCMB";
mpu_armv73.attributes = "NonCached";

mpu_armv74.baseAddr = 0x79100000;
mpu_armv74.size     = 19;
mpu_armv74.$name    = "CONFIG_MPU_MCU_MSRAM";

mpu_armv75.baseAddr = 0x80000000;
mpu_armv75.size     = 31;
mpu_armv75.$name    = "CONFIG_MPU_DDR";

mpu_armv76.baseAddr = 0x60000000;
mpu_armv76.size     = 26;
mpu_armv76.$name    = "CONFIG_MPU_FLASH";

/**
 * Pinmux solution for unlocked pins/peripherals. This ensures that minor changes to the automatic solver in a future
 * version of the tool will not impact the pinmux you originally saw.  These lines can be completely deleted in order to
 * re-solve from scratch.
 */
mmcsd1.MMC0.$suggestSolution      = "MMC0";
mmcsd2.MMC1.$suggestSolution      = "MMC1";
mmcsd2.MMC1.CLK.$suggestSolution  = "MMC1_CLK";
mmcsd2.MMC1.CMD.$suggestSolution  = "MMC1_CMD";
mmcsd2.MMC1.DAT0.$suggestSolution = "MMC1_DAT0";
mmcsd2.MMC1.DAT1.$suggestSolution = "MMC1_DAT1";
mmcsd2.MMC1.DAT2.$suggestSolution = "MMC1_DAT2";
mmcsd2.MMC1.DAT3.$suggestSolution = "MMC1_DAT3";
mmcsd2.MMC1.SDCD.$suggestSolution = "MMC1_SDCD";
