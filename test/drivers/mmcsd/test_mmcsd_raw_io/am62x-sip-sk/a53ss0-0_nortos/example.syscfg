/**
 * @cliArgs --device "AM62SIP" --part "Default" --package "AMK" --context "a53ss0-0" --product "MCU_PLUS_SDK@07.03.01"
 * @versions {"tool":"1.24.0+4150"}
 */

/**
 * Import the modules used in this configuration.
 */
const mmcsd      = scripting.addModule("/drivers/mmcsd/mmcsd", {}, false);
const mmcsd1     = mmcsd.addInstance();
const mmcsd2     = mmcsd.addInstance();
const clock      = scripting.addModule("/kernel/dpl/clock");
const debug_log  = scripting.addModule("/kernel/dpl/debug_log");
const mmu_armv8  = scripting.addModule("/kernel/dpl/mmu_armv8", {}, false);
const mmu_armv81 = mmu_armv8.addInstance();
const mmu_armv82 = mmu_armv8.addInstance();
const mmu_armv83 = mmu_armv8.addInstance();

/**
 * Write custom configuration values to the imported modules.
 */
mmcsd1.$name = "CONFIG_MMCSD_EMMC";

mmcsd2.$name        = "CONFIG_MMCSD_SD";
mmcsd2.cardType     = "SD";
mmcsd2.moduleSelect = "MMC1";

debug_log.enableUartLog = true;
debug_log.uartLog.$name = "CONFIG_UART0";

mmu_armv81.$name = "SOC_MEM_REGION";
mmu_armv81.size  = 0x80000000;

mmu_armv82.$name             = "ATF_REGION";
mmu_armv82.vAddr             = 0x80000000;
mmu_armv82.pAddr             = 0x80000000;
mmu_armv82.size              = 0x80000;
mmu_armv82.accessPermissions = "Privilege RO, User None";
mmu_armv82.shareable         = "Non Shareable";

mmu_armv83.size      = 0x80000000;
mmu_armv83.attribute = "MAIR7";
mmu_armv83.$name     = "DDR_REGION";
mmu_armv83.vAddr     = 0x80080000;
mmu_armv83.pAddr     = 0x80080000;

/**
 * Pinmux solution for unlocked pins/peripherals. This ensures that minor changes to the automatic solver in a future
 * version of the tool will not impact the pinmux you originally saw.  These lines can be completely deleted in order to
 * re-solve from scratch.
 */
mmcsd1.MMC0.$suggestSolution                = "MMC0";
mmcsd1.MMC0.CLK.$suggestSolution            = "MMC0_CLK";
mmcsd1.MMC0.CMD.$suggestSolution            = "MMC0_CMD";
mmcsd1.MMC0.DAT0.$suggestSolution           = "MMC0_DAT0";
mmcsd1.MMC0.DAT1.$suggestSolution           = "MMC0_DAT1";
mmcsd1.MMC0.DAT2.$suggestSolution           = "MMC0_DAT2";
mmcsd1.MMC0.DAT3.$suggestSolution           = "MMC0_DAT3";
mmcsd1.MMC0.DAT4.$suggestSolution           = "MMC0_DAT4";
mmcsd1.MMC0.DAT5.$suggestSolution           = "MMC0_DAT5";
mmcsd1.MMC0.DAT6.$suggestSolution           = "MMC0_DAT6";
mmcsd1.MMC0.DAT7.$suggestSolution           = "MMC0_DAT7";
mmcsd2.MMC1.$suggestSolution                = "MMC1";
mmcsd2.MMC1.CLK.$suggestSolution            = "MMC1_CLK";
mmcsd2.MMC1.CMD.$suggestSolution            = "MMC1_CMD";
mmcsd2.MMC1.DAT0.$suggestSolution           = "MMC1_DAT0";
mmcsd2.MMC1.DAT1.$suggestSolution           = "MMC1_DAT1";
mmcsd2.MMC1.DAT2.$suggestSolution           = "MMC1_DAT2";
mmcsd2.MMC1.DAT3.$suggestSolution           = "MMC1_DAT3";
mmcsd2.MMC1.SDCD.$suggestSolution           = "MMC1_SDCD";
debug_log.uartLog.UART.$suggestSolution     = "USART0";
debug_log.uartLog.UART.RXD.$suggestSolution = "UART0_RXD";
debug_log.uartLog.UART.TXD.$suggestSolution = "UART0_TXD";
