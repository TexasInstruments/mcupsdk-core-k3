/**
 * @cliArgs --device "AM62Dx" --part "AM62D24-G" --package "ANF" --context "r5fss0-0" --product "MCU_PLUS_SDK@07.03.01"
 * @versions {"tool":"1.24.0+4150"}
 */

/**
 * Import the modules used in this configuration.
 */
const ipc           = scripting.addModule("/drivers/ipc/ipc");
const uart          = scripting.addModule("/drivers/uart/uart", {}, false);
const uart1         = uart.addInstance();
const freertos_fat  = scripting.addModule("/fs/freertos_fat/freertos_fat", {}, false);
const freertos_fat1 = freertos_fat.addInstance();
const clock         = scripting.addModule("/kernel/dpl/clock");
const debug_log     = scripting.addModule("/kernel/dpl/debug_log");
const mpu_armv7     = scripting.addModule("/kernel/dpl/mpu_armv7", {}, false);
const mpu_armv71    = mpu_armv7.addInstance();
const mpu_armv72    = mpu_armv7.addInstance();
const mpu_armv73    = mpu_armv7.addInstance();
const mpu_armv74    = mpu_armv7.addInstance();
const mpu_armv75    = mpu_armv7.addInstance();
const mpu_armv76    = mpu_armv7.addInstance();
const mpu_armv77    = mpu_armv7.addInstance();
const mpu_armv78    = mpu_armv7.addInstance();
const mpu_armv79    = mpu_armv7.addInstance();
const mpu_armv710   = mpu_armv7.addInstance();
const mpu_armv711   = mpu_armv7.addInstance();
const mpu_armv712   = mpu_armv7.addInstance();

/**
 * Write custom configuration values to the imported modules.
 */
ipc.mcu_r5fss0_0   = "notify";
ipc.enableLinuxIpc = false;
ipc.a53ss0_0       = "notify";
ipc.c75ss0_0       = "notify";

uart1.$name                      = "CONFIG_UART_SBL";
uart1.addedByBootloader          = true;
uart1.useWakeupDomainPeripherals = false;
uart1.intrEnable                 = "DISABLE";

freertos_fat1.$name                  = "CONFIG_FREERTOS_FAT1";
freertos_fat1.media                  = "EMMC";
freertos_fat1.peripheralDriver.$name = "CONFIG_MMCSD_EMMC";

debug_log.enableUartLog            = true;
debug_log.enableSharedMemLog       = true;
debug_log.enableSharedMemLogReader = true;
debug_log.enableCssLog             = false;
debug_log.uartTrace                = true;
debug_log.uartLog.$name            = "CONFIG_UART0";

mpu_armv71.accessPermissions = "Supervisor RD+WR, User RD";
mpu_armv71.allowExecute      = false;
mpu_armv71.size              = 31;
mpu_armv71.attributes        = "Device";
mpu_armv71.$name             = "REGISTER_REGION";

mpu_armv72.accessPermissions = "Supervisor RD+WR, User RD";
mpu_armv72.size              = 7;
mpu_armv72.$name             = "TCMA_VEC";

mpu_armv73.$name             = "CONFIG_MPU_REGION2";
mpu_armv73.accessPermissions = "Supervisor RD+WR, User RD";
mpu_armv73.baseAddr          = 0x41C00000;
mpu_armv73.size              = 19;

mpu_armv74.$name             = "CONFIG_MPU_REGION3";
mpu_armv74.accessPermissions = "Supervisor RD+WR, User RD";
mpu_armv74.baseAddr          = 0x70000000;
mpu_armv74.size              = 16;

mpu_armv75.$name    = "DDR";
mpu_armv75.baseAddr = 0x80000000;
mpu_armv75.size     = 31;

mpu_armv76.baseAddr   = 0x41010000;
mpu_armv76.size       = 15;
mpu_armv76.attributes = "NonCached";
mpu_armv76.$name      = "TCMB";

mpu_armv77.size       = 15;
mpu_armv77.attributes = "NonCached";
mpu_armv77.$name      = "TCMA";

mpu_armv78.baseAddr = 0x43C00000;
mpu_armv78.size     = 18;
mpu_armv78.$name    = "HSM_RAM";

mpu_armv79.$name      = "RING_BUFFER";
mpu_armv79.baseAddr   = 0x9C800000;
mpu_armv79.attributes = "NonCached";
mpu_armv79.size       = 21;

mpu_armv710.attributes   = "NonCached";
mpu_armv710.size         = 20;
mpu_armv710.allowExecute = false;
mpu_armv710.$name        = "RESOURCE_TABLE";
mpu_armv710.baseAddr     = 0x9D900000;

mpu_armv711.$name        = "RTOS_NORTOS_IPC_VRING";
mpu_armv711.baseAddr     = 0xA0000000;
mpu_armv711.size         = 23;
mpu_armv711.allowExecute = false;
mpu_armv711.attributes   = "NonCached";

mpu_armv712.$name      = "LOG_SHM_MEM";
mpu_armv712.baseAddr   = 0xA1000000;
mpu_armv712.attributes = "NonCached";
mpu_armv712.size       = 18;

/**
 * Pinmux solution for unlocked pins/peripherals. This ensures that minor changes to the automatic solver in a future
 * version of the tool will not impact the pinmux you originally saw.  These lines can be completely deleted in order to
 * re-solve from scratch.
 */
uart1.UART.$suggestSolution                               = "USART1";
uart1.UART.RXD.$suggestSolution                           = "I2C1_SCL";
uart1.UART.TXD.$suggestSolution                           = "I2C1_SDA";
freertos_fat1.peripheralDriver.MMC0.$suggestSolution      = "MMC0";
freertos_fat1.peripheralDriver.MMC0.CLK.$suggestSolution  = "MMC0_CLK";
freertos_fat1.peripheralDriver.MMC0.CMD.$suggestSolution  = "MMC0_CMD";
freertos_fat1.peripheralDriver.MMC0.DAT0.$suggestSolution = "MMC0_DAT0";
freertos_fat1.peripheralDriver.MMC0.DAT1.$suggestSolution = "MMC0_DAT1";
freertos_fat1.peripheralDriver.MMC0.DAT2.$suggestSolution = "MMC0_DAT2";
freertos_fat1.peripheralDriver.MMC0.DAT3.$suggestSolution = "MMC0_DAT3";
freertos_fat1.peripheralDriver.MMC0.DAT4.$suggestSolution = "MMC0_DAT4";
freertos_fat1.peripheralDriver.MMC0.DAT5.$suggestSolution = "MMC0_DAT5";
freertos_fat1.peripheralDriver.MMC0.DAT6.$suggestSolution = "MMC0_DAT6";
freertos_fat1.peripheralDriver.MMC0.DAT7.$suggestSolution = "MMC0_DAT7";
debug_log.uartLog.WKUP_UART.$suggestSolution              = "WKUP_USART0";
debug_log.uartLog.WKUP_UART.RXD.$suggestSolution          = "WKUP_UART0_RXD";
debug_log.uartLog.WKUP_UART.TXD.$suggestSolution          = "WKUP_UART0_TXD";
