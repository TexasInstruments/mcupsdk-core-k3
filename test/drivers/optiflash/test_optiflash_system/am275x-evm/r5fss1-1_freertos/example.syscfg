/**
 * @cliArgs --device "AM275x" --part "AM2754" --package "ANJ" --context "r5fss1-1" --product "MCU_PLUS_SDK@07.03.01"
 * @versions {"tool":"1.22.0+3893"}
 */

/**
 * Import the modules used in this configuration.
 */
const ipc        = scripting.addModule("/drivers/ipc/ipc");
const debug_log  = scripting.addModule("/kernel/dpl/debug_log");
const mpu_armv7  = scripting.addModule("/kernel/dpl/mpu_armv7", {}, false);
const mpu_armv71 = mpu_armv7.addInstance();
const mpu_armv72 = mpu_armv7.addInstance();
const mpu_armv73 = mpu_armv7.addInstance();
const mpu_armv74 = mpu_armv7.addInstance();
const mpu_armv75 = mpu_armv7.addInstance();
const mpu_armv76 = mpu_armv7.addInstance();
const mpu_armv77 = mpu_armv7.addInstance();
const flc        = scripting.addModule("/optiflash/flc/flc", {}, false);
const flc1       = flc.addInstance();
const flc2       = flc.addInstance();
const flc3       = flc.addInstance();
const flc4       = flc.addInstance();
const rl2        = scripting.addModule("/optiflash/rl2/rl2", {}, false);
const rl21       = rl2.addInstance();

/**
 * Write custom configuration values to the imported modules.
 */
ipc.r5fss0_0      = "notify";
ipc.r5fss0_1      = "notify";
ipc.r5fss1_0      = "notify";
ipc.c75ss0_0      = "NONE";
ipc.c75ss1_0      = "NONE";
ipc.wkup_r5fss0_0 = "NONE";

debug_log.enableSharedMemLog = true;

mpu_armv71.size         = 31;
mpu_armv71.attributes   = "Device";
mpu_armv71.allowExecute = false;
mpu_armv71.$name        = "REGISTERS";

mpu_armv72.size  = 15;
mpu_armv72.$name = "TCMA";

mpu_armv73.baseAddr = 0x41010000;
mpu_armv73.size     = 15;
mpu_armv73.$name    = "TCMB";

mpu_armv74.$name    = "MSRAM_BANK0_TO_BANK3";
mpu_armv74.baseAddr = 0x72000000;
mpu_armv74.size     = 22;

mpu_armv75.$name    = "MSRAM_BANK4_TO_BANK5";
mpu_armv75.baseAddr = 0x72400000;
mpu_armv75.size     = 21;

mpu_armv76.$name        = "LOG_SHM_MEM";
mpu_armv76.baseAddr     = 0x72380000;
mpu_armv76.size         = 18;
mpu_armv76.allowExecute = false;
mpu_armv76.attributes   = "NonCached";

mpu_armv77.$name      = "FLASH";
mpu_armv77.baseAddr   = 0x60000000;
mpu_armv77.size       = 27;
mpu_armv77.attributes = "NonCached";

flc1.$name = "FLC0";
flc1.sourceStartAddress      = 0x60000000;
flc1.destinationStartAddress = 0x72080000;
flc1.copySize                = 1048576;

flc2.$name = "FLC1";
flc2.sourceStartAddress      = 0x60100000;
flc2.destinationStartAddress = 0x72180000;
flc2.copySize                = 1048576;

flc3.$name = "FLC2";
flc3.sourceStartAddress      = 0x60200000;
flc3.destinationStartAddress = 0x72280000;
flc3.copySize                = 1048576;

flc4.$name = "FLC3";
flc4.sourceStartAddress      = 0x60300000;
flc4.destinationStartAddress = 0x72380000;
flc4.copySize                = 1048576;

rl21.$name      = "RL20";
rl21.rangeStart = 0x60000000;
rl21.rangeEnd_2 = 0x60400000;
rl21.cacheSize  = "RL2_CACHESIZE_128K";
