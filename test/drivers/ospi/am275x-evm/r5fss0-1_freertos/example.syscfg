/**
 * @cliArgs --device "AM275x" --part "AM2754" --package "ANJ" --context "r5fss0-1" --product "MCU_PLUS_SDK@07.03.01"
 * @versions {"tool":"1.26.2+4477"}
 */

/**
 * Import the modules used in this configuration.
 */
const flash      = scripting.addModule("/board/flash/flash", {}, false);
const flash1     = flash.addInstance();
const debug_log  = scripting.addModule("/kernel/dpl/debug_log");
const mpu_armv7  = scripting.addModule("/kernel/dpl/mpu_armv7", {}, false);
const mpu_armv71 = mpu_armv7.addInstance();
const mpu_armv72 = mpu_armv7.addInstance();
const mpu_armv73 = mpu_armv7.addInstance();
const mpu_armv74 = mpu_armv7.addInstance();
const mpu_armv75 = mpu_armv7.addInstance();
const mpu_armv76 = mpu_armv7.addInstance();

/**
 * Write custom configuration values to the imported modules.
 */
flash1.$name                                                = "CONFIG_FLASH0";
flash1.serialFlashDriver.$name                              = "board_flash_serialFlash_serialflash0";
flash1.serialFlashDriver.peripheralDriver.$name             = "CONFIG_OSPI0";
flash1.serialFlashDriver.peripheralDriver.dmaEnable         = true;
flash1.serialFlashDriver.peripheralDriver.phyEnable         = true;
flash1.serialFlashDriver.peripheralDriver.OSPI.$assign      = "OSPI0";
flash1.serialFlashDriver.peripheralDriver.OSPI.CLK.drv_str  = "fast";
flash1.serialFlashDriver.peripheralDriver.OSPI.CSn0.drv_str = "fast";
flash1.serialFlashDriver.peripheralDriver.OSPI.D7.drv_str   = "fast";
flash1.serialFlashDriver.peripheralDriver.OSPI.D6.drv_str   = "fast";
flash1.serialFlashDriver.peripheralDriver.OSPI.D5.drv_str   = "fast";
flash1.serialFlashDriver.peripheralDriver.OSPI.D4.drv_str   = "fast";
flash1.serialFlashDriver.peripheralDriver.OSPI.D3.drv_str   = "fast";
flash1.serialFlashDriver.peripheralDriver.OSPI.D2.drv_str   = "fast";
flash1.serialFlashDriver.peripheralDriver.OSPI.D1.drv_str   = "fast";
flash1.serialFlashDriver.peripheralDriver.OSPI.D0.drv_str   = "fast";

const udma                                           = scripting.addModule("/drivers/udma/udma", {}, false);
const udma1                                          = udma.addInstance({}, false);
udma1.$name                                          = "CONFIG_UDMA0";
flash1.serialFlashDriver.peripheralDriver.udmaDriver = udma1;

const udma_blkcopy_channel                                   = scripting.addModule("/drivers/udma/udma_blkcopy_channel", {}, false);
const udma_blkcopy_channel1                                  = udma_blkcopy_channel.addInstance({}, false);
udma_blkcopy_channel1.$name                                  = "CONFIG_UDMA_BLKCOPY_CH0";
flash1.serialFlashDriver.peripheralDriver.udmaBlkCopyChannel = udma_blkcopy_channel1;

debug_log.enableUartLog        = true;
debug_log.uartLog.$name        = "CONFIG_UART0";
debug_log.uartLog.UART.$assign = "UART0";

mpu_armv71.size         = 31;
mpu_armv71.attributes   = "Device";
mpu_armv71.allowExecute = false;
mpu_armv71.$name        = "REGISTERS";

mpu_armv72.size  = 15;
mpu_armv72.$name = "TCMA";

mpu_armv73.baseAddr = 0x41010000;
mpu_armv73.size     = 15;
mpu_armv73.$name    = "TCMB";

mpu_armv74.baseAddr     = 0x60000000;
mpu_armv74.size         = 26;
mpu_armv74.$name        = "FLASH";
mpu_armv74.attributes   = "Device";
mpu_armv74.allowExecute = false;

mpu_armv75.$name    = "MSRAM_BANK0_TO_BANK3";
mpu_armv75.baseAddr = 0x72000000;
mpu_armv75.size     = 22;

mpu_armv76.baseAddr = 0x72400000;
mpu_armv76.size     = 21;
mpu_armv76.$name    = "MSRAM_BANK4_TO_BANK5";

/**
 * Pinmux solution for unlocked pins/peripherals. This ensures that minor changes to the automatic solver in a future
 * version of the tool will not impact the pinmux you originally saw.  These lines can be completely deleted in order to
 * re-solve from scratch.
 */
flash1.serialFlashDriver.peripheralDriver.OSPI.CLK.$suggestSolution  = "OSPI0_CLK";
flash1.serialFlashDriver.peripheralDriver.OSPI.CSn0.$suggestSolution = "OSPI0_CSn0";
flash1.serialFlashDriver.peripheralDriver.OSPI.DQS.$suggestSolution  = "OSPI0_DQS";
flash1.serialFlashDriver.peripheralDriver.OSPI.D7.$suggestSolution   = "OSPI0_D7";
flash1.serialFlashDriver.peripheralDriver.OSPI.D6.$suggestSolution   = "OSPI0_D6";
flash1.serialFlashDriver.peripheralDriver.OSPI.D5.$suggestSolution   = "OSPI0_D5";
flash1.serialFlashDriver.peripheralDriver.OSPI.D4.$suggestSolution   = "OSPI0_D4";
flash1.serialFlashDriver.peripheralDriver.OSPI.D3.$suggestSolution   = "OSPI0_D3";
flash1.serialFlashDriver.peripheralDriver.OSPI.D2.$suggestSolution   = "OSPI0_D2";
flash1.serialFlashDriver.peripheralDriver.OSPI.D1.$suggestSolution   = "OSPI0_D1";
flash1.serialFlashDriver.peripheralDriver.OSPI.D0.$suggestSolution   = "OSPI0_D0";
debug_log.uartLog.UART.RXD.$suggestSolution                          = "MCASP4_AXR0";
debug_log.uartLog.UART.TXD.$suggestSolution                          = "MLB0_MLBCLK";
