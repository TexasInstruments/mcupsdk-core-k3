/**
 * @cliArgs --device "AM275x" --part "AM2754" --package "ANJ" --context "c75ss1-0" --product "MCU_PLUS_SDK@07.03.01"
 * @versions {"tool":"1.24.2+4234"}
 */

/**
 * Import the modules used in this configuration.
 */
const uart        = scripting.addModule("/drivers/uart/uart", {}, false);
const uart2       = uart.addInstance();
const uart3       = uart.addInstance();
const uart4       = uart.addInstance();
const uart5       = uart.addInstance();
const uart6       = uart.addInstance();
const uart7       = uart.addInstance();
const uart8       = uart.addInstance();
const debug_log   = scripting.addModule("/kernel/dpl/debug_log");
const mmu_armv8   = scripting.addModule("/kernel/dpl/mmu_armv8", {}, false);
const mmu_armv81  = mmu_armv8.addInstance();
const mmu_armv82  = mmu_armv8.addInstance();
const mmu_armv83  = mmu_armv8.addInstance();
const mmu_armv84  = mmu_armv8.addInstance();
const mmu_armv85  = mmu_armv8.addInstance();
const mmu_armv86  = mmu_armv8.addInstance();
const mmu_armv87  = mmu_armv8.addInstance();
const mmu_armv88  = mmu_armv8.addInstance();
const mmu_armv89  = mmu_armv8.addInstance();
const mmu_armv810 = mmu_armv8.addInstance();
const mmu_armv811 = mmu_armv8.addInstance();

/**
 * Write custom configuration values to the imported modules.
 */
uart2.$name        = "CONFIG_UART0";
uart2.UART.$assign = "UART0";

uart3.$name        = "CONFIG_UART1";
uart3.UART.$assign = "UART1";

uart4.$name        = "CONFIG_UART3";
uart4.UART.$assign = "UART3";

uart5.$name        = "CONFIG_UART4";
uart5.UART.$assign = "UART4";

uart6.$name        = "CONFIG_UART5";
uart6.UART.$assign = "UART5";

uart7.$name        = "CONFIG_UART6";
uart7.UART.$assign = "UART6";

uart8.$name                      = "CONFIG_UART7";
uart8.useWakeupDomainPeripherals = true;
uart8.WKUP_UART.$assign          = "WKUP_UART";

debug_log.enableSharedMemLog       = true;
debug_log.enableUartLog            = true;
debug_log.uartLog.$name            = "CONFIG_UART2";
debug_log.uartLog.UART.$assign     = "UART2";
debug_log.uartLog.UART.TXD.$assign = "SPI1_CS1";

mmu_armv81.$name = "CONFIG_MMU_REGION0";
mmu_armv81.size  = 0x20000000;

mmu_armv82.$name = "CONFIG_MMU_REGION1";
mmu_armv82.vAddr = 0x20000000;
mmu_armv82.pAddr = 0x20000000;
mmu_armv82.size  = 0x20000000;

mmu_armv83.$name = "CONFIG_MMU_REGION2";
mmu_armv83.vAddr = 0x40000000;
mmu_armv83.pAddr = 0x40000000;
mmu_armv83.size  = 0x20000000;

mmu_armv84.$name = "CONFIG_MMU_REGION3";
mmu_armv84.vAddr = 0x60000000;
mmu_armv84.pAddr = 0x60000000;
mmu_armv84.size  = 0x10000000;

mmu_armv85.vAddr = 0x7D200000;
mmu_armv85.pAddr = 0x7D200000;
mmu_armv85.$name = "CLEC";
mmu_armv85.size  = 0x100000;

mmu_armv86.$name = "DRU";
mmu_armv86.size  = 0x100000;
mmu_armv86.vAddr = 0x7D400000;
mmu_armv86.pAddr = 0x7D400000;

mmu_armv87.$name     = "L2SRAM";
mmu_armv87.vAddr     = 0x7F000000;
mmu_armv87.pAddr     = 0x7F000000;
mmu_armv87.attribute = "MAIR7";
mmu_armv87.size      = 0x200000;

mmu_armv88.$name     = "L2SRAM_AUX";
mmu_armv88.vAddr     = 0x7F200000;
mmu_armv88.pAddr     = 0x7F200000;
mmu_armv88.size      = 0x40000;
mmu_armv88.attribute = "MAIR7";

mmu_armv89.$name     = "MSRAM_BANK0_TO_BANK3";
mmu_armv89.vAddr     = 0x80000000;
mmu_armv89.pAddr     = 0x80000000;
mmu_armv89.attribute = "MAIR7";
mmu_armv89.size      = 0x400000;

mmu_armv810.$name     = "MSRAM_BANK4_TO_BANK5";
mmu_armv810.vAddr     = 0x80400000;
mmu_armv810.pAddr     = 0x80400000;
mmu_armv810.size      = 0x200000;
mmu_armv810.attribute = "MAIR7";

mmu_armv811.size      = 0x1000;
mmu_armv811.attribute = "MAIR4";
mmu_armv811.vAddr     = 0x8047F000;
mmu_armv811.pAddr     = 0x8047F000;
mmu_armv811.$name     = "CCS_DEBUG_LOG_MEM";

/**
 * Pinmux solution for unlocked pins/peripherals. This ensures that minor changes to the automatic solver in a future
 * version of the tool will not impact the pinmux you originally saw.  These lines can be completely deleted in order to
 * re-solve from scratch.
 */
uart2.UART.RXD.$suggestSolution             = "MCASP4_AXR0";
uart2.UART.TXD.$suggestSolution             = "MLB0_MLBCLK";
uart3.UART.RXD.$suggestSolution             = "I2C1_SCL";
uart3.UART.TXD.$suggestSolution             = "I2C1_SDA";
uart4.UART.RXD.$suggestSolution             = "MCASP0_AXR8";
uart4.UART.TXD.$suggestSolution             = "GPIO1_47";
uart5.UART.RXD.$suggestSolution             = "MCASP0_AXR10";
uart5.UART.TXD.$suggestSolution             = "MCASP0_AXR11";
uart6.UART.RXD.$suggestSolution             = "MCAN0_TX";
uart6.UART.TXD.$suggestSolution             = "MCAN0_RX";
uart7.UART.RXD.$suggestSolution             = "GPIO1_48";
uart7.UART.TXD.$suggestSolution             = "GPIO1_49";
uart8.WKUP_UART.RXD.$suggestSolution        = "WKUP_UART0_RXD";
uart8.WKUP_UART.TXD.$suggestSolution        = "WKUP_UART0_TXD";
debug_log.uartLog.UART.RXD.$suggestSolution = "MCASP0_AXR6";
