/**
 * @cliArgs --device "AM62Ax" --part "Default" --package "AMB" --context "c75ss0-0" --product "MCU_PLUS_SDK@07.03.01"
 * @versions {"tool":"1.24.2+4234"}
 */

/**
 * Import the modules used in this configuration.
 */
const uart        = scripting.addModule("/drivers/uart/uart", {}, false);
const uart1       = uart.addInstance();
const uart2       = uart.addInstance();
const uart3       = uart.addInstance();
const uart4       = uart.addInstance();
const uart5       = uart.addInstance();
const uart6       = uart.addInstance();
const uart7       = uart.addInstance();
const uart8       = uart.addInstance();
const udma        = scripting.addModule("/drivers/udma/udma", {}, false);
const udma1       = udma.addInstance();
const debug_log   = scripting.addModule("/kernel/dpl/debug_log");
const mmu_armv8   = scripting.addModule("/kernel/dpl/mmu_armv8", {}, false);
const mmu_armv81  = mmu_armv8.addInstance();
const mmu_armv82  = mmu_armv8.addInstance();
const mmu_armv83  = mmu_armv8.addInstance();
const mmu_armv84  = mmu_armv8.addInstance();
const mmu_armv85  = mmu_armv8.addInstance();
const mmu_armv86  = mmu_armv8.addInstance();
const mmu_armv87  = mmu_armv8.addInstance();
const mmu_armv88  = mmu_armv8.addInstance();
const mmu_armv89  = mmu_armv8.addInstance();
const mmu_armv810 = mmu_armv8.addInstance();
const mmu_armv811 = mmu_armv8.addInstance();

/**
 * Write custom configuration values to the imported modules.
 */
uart1.$name        = "CONFIG_UART1";
uart1.UART.$assign = "USART0";

uart2.$name         = "CONFIG_UART2";
uart2.hwFlowControl = true;
uart2.UART.$assign  = "USART1";
uart2.UART.TXD.rx   = true;
uart2.UART.CTSn.rx  = true;

uart3.$name        = "CONFIG_UART3";
uart3.UART.$assign = "USART2";

uart4.$name        = "CONFIG_UART4";
uart4.UART.$assign = "USART3";

uart5.$name        = "CONFIG_UART5";
uart5.UART.$assign = "USART4";

uart6.$name        = "CONFIG_UART6";
uart6.UART.$assign = "USART5";

uart7.$name        = "CONFIG_UART7";
uart7.UART.$assign = "USART6";

uart8.$name                      = "CONFIG_UART8";
uart8.useWakeupDomainPeripherals = true;
uart8.WKUP_UART.$assign          = "WKUP_USART0";

udma1.$name    = "CONFIG_UDMA0";
udma1.instance = "PKTDMA_0";

debug_log.enableCssLog                    = false;
debug_log.enableUartLog                   = true;
debug_log.uartLog.$name                   = "CONFIG_UART0";
debug_log.uartLog.useMcuDomainPeripherals = true;
debug_log.uartLog.MCU_UART.$assign        = "MCU_USART0";

mmu_armv81.size  = 0x20000000;
mmu_armv81.$name = "REGISTER_REGION_0";

mmu_armv82.vAddr = 0x20000000;
mmu_armv82.pAddr = 0x20000000;
mmu_armv82.size  = 0x20000000;
mmu_armv82.$name = "REGISTER_REGION_1";

mmu_armv83.vAddr = 0x40000000;
mmu_armv83.pAddr = 0x40000000;
mmu_armv83.size  = 0x20000000;
mmu_armv83.$name = "REGISTER_REGION_2";

mmu_armv84.vAddr = 0x60000000;
mmu_armv84.pAddr = 0x60000000;
mmu_armv84.size  = 0x10000000;
mmu_armv84.$name = "FSS0_DAT_REGION";

mmu_armv85.vAddr = 0x7C200000;
mmu_armv85.pAddr = 0x7C200000;
mmu_armv85.$name = "CLEC";
mmu_armv85.size  = 0x100000;

mmu_armv86.$name = "DRU";
mmu_armv86.vAddr = 0x7C400000;
mmu_armv86.pAddr = 0x7C400000;
mmu_armv86.size  = 0x100000;

mmu_armv87.vAddr     = 0x80000000;
mmu_armv87.pAddr     = 0x80000000;
mmu_armv87.size      = 0x20000000;
mmu_armv87.attribute = "MAIR7";
mmu_armv87.$name     = "DDR_0";

mmu_armv88.vAddr     = 0xA0000000;
mmu_armv88.pAddr     = 0xA0000000;
mmu_armv88.size      = 0x20000000;
mmu_armv88.attribute = "MAIR7";
mmu_armv88.$name     = "DDR_1";

mmu_armv89.vAddr     = 0xAA000000;
mmu_armv89.pAddr     = 0xAA000000;
mmu_armv89.size      = 0x2000000;
mmu_armv89.attribute = "MAIR4";
mmu_armv89.$name     = "DDR_2";

mmu_armv810.$name       = "MCASP";
mmu_armv810.vAddr       = 0x2B10000;
mmu_armv810.pAddr       = 0x2B10000;
mmu_armv810.size        = 0x2000000;
mmu_armv810.privExecute = false;

mmu_armv811.$name     = "CCS_DEBUG_LOG_MEM";
mmu_armv811.pAddr     = 0x99C10000;
mmu_armv811.vAddr     = 0x99C10000;
mmu_armv811.size      = 0x1000;
mmu_armv811.attribute = "MAIR4";

/**
 * Pinmux solution for unlocked pins/peripherals. This ensures that minor changes to the automatic solver in a future
 * version of the tool will not impact the pinmux you originally saw.  These lines can be completely deleted in order to
 * re-solve from scratch.
 */
uart1.UART.RXD.$suggestSolution                 = "UART0_RXD";
uart1.UART.TXD.$suggestSolution                 = "UART0_TXD";
uart2.UART.RXD.$suggestSolution                 = "I2C1_SCL";
uart2.UART.TXD.$suggestSolution                 = "I2C1_SDA";
uart2.UART.RTSn.$suggestSolution                = "MCASP0_AXR2";
uart2.UART.CTSn.$suggestSolution                = "MCASP0_AXR3";
uart3.UART.RXD.$suggestSolution                 = "GPMC0_AD8";
uart3.UART.TXD.$suggestSolution                 = "GPMC0_AD9";
uart4.UART.RXD.$suggestSolution                 = "GPMC0_AD10";
uart4.UART.TXD.$suggestSolution                 = "GPMC0_AD11";
uart5.UART.RXD.$suggestSolution                 = "GPMC0_AD12";
uart5.UART.TXD.$suggestSolution                 = "GPMC0_AD13";
uart6.UART.RXD.$suggestSolution                 = "GPMC0_AD14";
uart6.UART.TXD.$suggestSolution                 = "GPMC0_AD15";
uart7.UART.RXD.$suggestSolution                 = "GPMC0_WAIT1";
uart7.UART.TXD.$suggestSolution                 = "GPMC0_WPn";
uart8.WKUP_UART.RXD.$suggestSolution            = "WKUP_UART0_RXD";
uart8.WKUP_UART.TXD.$suggestSolution            = "WKUP_UART0_TXD";
debug_log.uartLog.MCU_UART.RXD.$suggestSolution = "MCU_UART0_RXD";
debug_log.uartLog.MCU_UART.TXD.$suggestSolution = "MCU_UART0_TXD";
