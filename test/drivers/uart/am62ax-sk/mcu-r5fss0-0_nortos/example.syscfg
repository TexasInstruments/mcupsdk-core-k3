/**
 * @cliArgs --device "AM62Ax" --part "Default" --package "AMB" --context "mcu-r5fss0-0" --product "MCU_PLUS_SDK@07.03.01"
 * @versions {"tool":"1.24.2+4234"}
 */

/**
 * Import the modules used in this configuration.
 */
const uart       = scripting.addModule("/drivers/uart/uart", {}, false);
const uart2      = uart.addInstance();
const uart3      = uart.addInstance();
const uart4      = uart.addInstance();
const uart5      = uart.addInstance();
const uart6      = uart.addInstance();
const uart7      = uart.addInstance();
const uart8      = uart.addInstance();
const uart9      = uart.addInstance();
const debug_log  = scripting.addModule("/kernel/dpl/debug_log");
const mpu_armv7  = scripting.addModule("/kernel/dpl/mpu_armv7", {}, false);
const mpu_armv71 = mpu_armv7.addInstance();
const mpu_armv72 = mpu_armv7.addInstance();
const mpu_armv73 = mpu_armv7.addInstance();
const mpu_armv74 = mpu_armv7.addInstance();
const mpu_armv75 = mpu_armv7.addInstance();
const mpu_armv76 = mpu_armv7.addInstance();

/**
 * Write custom configuration values to the imported modules.
 */
uart2.$name                   = "CONFIG_UART1";
uart2.useMcuDomainPeripherals = false;
uart2.UART.$assign            = "USART0";

uart3.$name                   = "CONFIG_UART2";
uart3.useMcuDomainPeripherals = false;
uart3.UART.$assign            = "USART1";

uart4.$name                   = "CONFIG_UART3";
uart4.useMcuDomainPeripherals = false;
uart4.UART.$assign            = "USART2";

uart5.$name                   = "CONFIG_UART4";
uart5.useMcuDomainPeripherals = false;
uart5.UART.$assign            = "USART3";

uart6.$name                   = "CONFIG_UART5";
uart6.useMcuDomainPeripherals = false;
uart6.UART.$assign            = "USART4";

uart7.$name                   = "CONFIG_UART6";
uart7.useMcuDomainPeripherals = false;
uart7.UART.$assign            = "USART5";

uart8.$name                   = "CONFIG_UART7";
uart8.useMcuDomainPeripherals = false;
uart8.UART.$assign            = "USART6";

uart9.$name                      = "CONFIG_UART8";
uart9.useMcuDomainPeripherals    = false;
uart9.useWakeupDomainPeripherals = true;
uart9.WKUP_UART.$assign          = "WKUP_USART0";

debug_log.enableCssLog  = false;
debug_log.enableUartLog = true;
debug_log.uartLog.$name = "CONFIG_UART0";

mpu_armv71.$name             = "CONFIG_MPU_REGION0";
mpu_armv71.size              = 31;
mpu_armv71.attributes        = "Device";
mpu_armv71.accessPermissions = "Supervisor RD+WR, User RD";
mpu_armv71.allowExecute      = false;

mpu_armv72.$name             = "CONFIG_MPU_REGION1";
mpu_armv72.size              = 15;
mpu_armv72.accessPermissions = "Supervisor RD+WR, User RD";

mpu_armv73.$name             = "CONFIG_MPU_REGION2";
mpu_armv73.baseAddr          = 0x41010000;
mpu_armv73.size              = 15;
mpu_armv73.accessPermissions = "Supervisor RD+WR, User RD";

mpu_armv74.$name             = "CONFIG_MPU_REGION3";
mpu_armv74.accessPermissions = "Supervisor RD+WR, User RD";
mpu_armv74.baseAddr          = 0x79100000;
mpu_armv74.size              = 19;

mpu_armv75.$name             = "CONFIG_MPU_REGION4";
mpu_armv75.baseAddr          = 0x60000000;
mpu_armv75.size              = 28;
mpu_armv75.accessPermissions = "Supervisor RD, User RD";

mpu_armv76.$name    = "CONFIG_MPU_REGION5";
mpu_armv76.baseAddr = 0x80000000;
mpu_armv76.size     = 31;

/**
 * Pinmux solution for unlocked pins/peripherals. This ensures that minor changes to the automatic solver in a future
 * version of the tool will not impact the pinmux you originally saw.  These lines can be completely deleted in order to
 * re-solve from scratch.
 */
uart2.UART.RXD.$suggestSolution                 = "UART0_RXD";
uart2.UART.TXD.$suggestSolution                 = "UART0_TXD";
uart3.UART.RXD.$suggestSolution                 = "I2C1_SCL";
uart3.UART.TXD.$suggestSolution                 = "I2C1_SDA";
uart4.UART.RXD.$suggestSolution                 = "GPMC0_AD8";
uart4.UART.TXD.$suggestSolution                 = "GPMC0_AD9";
uart5.UART.RXD.$suggestSolution                 = "GPMC0_AD10";
uart5.UART.TXD.$suggestSolution                 = "GPMC0_AD11";
uart6.UART.RXD.$suggestSolution                 = "GPMC0_AD12";
uart6.UART.TXD.$suggestSolution                 = "GPMC0_AD13";
uart7.UART.RXD.$suggestSolution                 = "GPMC0_AD14";
uart7.UART.TXD.$suggestSolution                 = "GPMC0_AD15";
uart8.UART.RXD.$suggestSolution                 = "GPMC0_WAIT1";
uart8.UART.TXD.$suggestSolution                 = "GPMC0_WPn";
uart9.WKUP_UART.RXD.$suggestSolution            = "WKUP_UART0_RXD";
uart9.WKUP_UART.TXD.$suggestSolution            = "WKUP_UART0_TXD";
debug_log.uartLog.MCU_UART.$suggestSolution     = "MCU_USART0";
debug_log.uartLog.MCU_UART.RXD.$suggestSolution = "MCU_UART0_RXD";
debug_log.uartLog.MCU_UART.TXD.$suggestSolution = "MCU_UART0_TXD";
