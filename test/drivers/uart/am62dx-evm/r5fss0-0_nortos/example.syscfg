/**
 * @cliArgs --device "AM62Dx" --part "AM62D24-G" --package "ANF" --context "r5fss0-0" --product "MCU_PLUS_SDK@07.03.01"
 * @versions {"tool":"1.24.2+4234"}
 */

/**
 * Import the modules used in this configuration.
 */
const uart       = scripting.addModule("/drivers/uart/uart", {}, false);
const uart2      = uart.addInstance();
const uart3      = uart.addInstance();
const uart4      = uart.addInstance();
const uart5      = uart.addInstance();
const uart6      = uart.addInstance();
const uart7      = uart.addInstance();
const uart8      = uart.addInstance();
const uart9      = uart.addInstance();
const clock      = scripting.addModule("/kernel/dpl/clock");
const debug_log  = scripting.addModule("/kernel/dpl/debug_log");
const mpu_armv7  = scripting.addModule("/kernel/dpl/mpu_armv7", {}, false);
const mpu_armv71 = mpu_armv7.addInstance();
const mpu_armv72 = mpu_armv7.addInstance();
const mpu_armv73 = mpu_armv7.addInstance();
const mpu_armv74 = mpu_armv7.addInstance();
const mpu_armv75 = mpu_armv7.addInstance();
const mpu_armv76 = mpu_armv7.addInstance();
const mpu_armv77 = mpu_armv7.addInstance();
const mpu_armv78 = mpu_armv7.addInstance();

/**
 * Write custom configuration values to the imported modules.
 */
uart2.$name                      = "CONFIG_UART0";
uart2.useWakeupDomainPeripherals = false;
uart2.useMcuDomainPeripherals    = true;
uart2.MCU_UART.$assign           = "MCU_USART0";

uart3.$name                      = "CONFIG_UART1";
uart3.useWakeupDomainPeripherals = false;
uart3.UART.$assign               = "USART0";

uart4.$name                      = "CONFIG_UART2";
uart4.useWakeupDomainPeripherals = false;
uart4.UART.$assign               = "USART1";

uart5.$name                      = "CONFIG_UART3";
uart5.useWakeupDomainPeripherals = false;
uart5.UART.$assign               = "USART2";

uart6.$name                      = "CONFIG_UART4";
uart6.useWakeupDomainPeripherals = false;
uart6.UART.$assign               = "USART3";

uart7.$name                      = "CONFIG_UART5";
uart7.useWakeupDomainPeripherals = false;
uart7.UART.$assign               = "USART4";

uart8.$name                      = "CONFIG_UART6";
uart8.useWakeupDomainPeripherals = false;
uart8.UART.$assign               = "USART5";

uart9.$name                      = "CONFIG_UART7";
uart9.useWakeupDomainPeripherals = false;
uart9.UART.$assign               = "USART6";

debug_log.enableCssLog  = false;
debug_log.enableUartLog = true;
debug_log.uartLog.$name = "CONFIG_UART8";

mpu_armv71.accessPermissions = "Supervisor RD+WR, User RD";
mpu_armv71.allowExecute      = false;
mpu_armv71.size              = 31;
mpu_armv71.attributes        = "Device";
mpu_armv71.$name             = "REGISTER_REGION";

mpu_armv72.accessPermissions = "Supervisor RD+WR, User RD";
mpu_armv72.size              = 7;
mpu_armv72.$name             = "TCMA_VEC";

mpu_armv73.$name             = "CONFIG_MPU_REGION2";
mpu_armv73.accessPermissions = "Supervisor RD+WR, User RD";
mpu_armv73.baseAddr          = 0x41C00000;
mpu_armv73.size              = 19;

mpu_armv74.$name             = "CONFIG_MPU_REGION3";
mpu_armv74.accessPermissions = "Supervisor RD+WR, User RD";
mpu_armv74.baseAddr          = 0x70000000;
mpu_armv74.size              = 16;

mpu_armv75.$name    = "DDR";
mpu_armv75.baseAddr = 0x90000000;
mpu_armv75.size     = 28;

mpu_armv76.baseAddr   = 0x41010000;
mpu_armv76.size       = 15;
mpu_armv76.attributes = "NonCached";
mpu_armv76.$name      = "TCMB";

mpu_armv77.size       = 15;
mpu_armv77.attributes = "NonCached";
mpu_armv77.$name      = "TCMA";

mpu_armv78.baseAddr = 0x43C00000;
mpu_armv78.size     = 18;
mpu_armv78.$name    = "HSM_RAM";

/**
 * Pinmux solution for unlocked pins/peripherals. This ensures that minor changes to the automatic solver in a future
 * version of the tool will not impact the pinmux you originally saw.  These lines can be completely deleted in order to
 * re-solve from scratch.
 */
uart2.MCU_UART.RXD.$suggestSolution              = "MCU_UART0_RXD";
uart2.MCU_UART.TXD.$suggestSolution              = "MCU_UART0_TXD";
uart3.UART.RXD.$suggestSolution                  = "UART0_RXD";
uart3.UART.TXD.$suggestSolution                  = "UART0_TXD";
uart4.UART.RXD.$suggestSolution                  = "I2C1_SCL";
uart4.UART.TXD.$suggestSolution                  = "I2C1_SDA";
uart5.UART.RXD.$suggestSolution                  = "GPIO0_45";
uart5.UART.TXD.$suggestSolution                  = "GPIO0_46";
uart6.UART.RXD.$suggestSolution                  = "GPIO0_47";
uart6.UART.TXD.$suggestSolution                  = "GPIO0_48";
uart7.UART.RXD.$suggestSolution                  = "GPIO0_49";
uart7.UART.TXD.$suggestSolution                  = "GPIO0_50";
uart8.UART.RXD.$suggestSolution                  = "GPIO0_51";
uart8.UART.TXD.$suggestSolution                  = "GPIO0_52";
uart9.UART.RXD.$suggestSolution                  = "GPIO0_53";
uart9.UART.TXD.$suggestSolution                  = "GPIO0_54";
debug_log.uartLog.WKUP_UART.$suggestSolution     = "WKUP_USART0";
debug_log.uartLog.WKUP_UART.RXD.$suggestSolution = "WKUP_UART0_RXD";
debug_log.uartLog.WKUP_UART.TXD.$suggestSolution = "WKUP_UART0_TXD";
