/**
 * @cliArgs --device "AM62x" --part "Default" --package "ALW" --context "m4fss0-0" --product "MCU_PLUS_SDK@07.03.01"
 * @versions {"tool":"1.26.2+4477"}
 */

/**
 * Import the modules used in this configuration.
 */
const uart            = scripting.addModule("/drivers/uart/uart", {}, false);
const uart1           = uart.addInstance();
const uart2           = uart.addInstance();
const uart3           = uart.addInstance();
const uart4           = uart.addInstance();
const uart5           = uart.addInstance();
const uart6           = uart.addInstance();
const uart7           = uart.addInstance();
const uart8           = uart.addInstance();
const addr_translate  = scripting.addModule("/kernel/dpl/addr_translate", {}, false);
const addr_translate1 = addr_translate.addInstance();
const addr_translate2 = addr_translate.addInstance();
const addr_translate3 = addr_translate.addInstance();
const addr_translate4 = addr_translate.addInstance();
const clock           = scripting.addModule("/kernel/dpl/clock");
const debug_log       = scripting.addModule("/kernel/dpl/debug_log");
const mpu_armv7       = scripting.addModule("/kernel/dpl/mpu_armv7", {}, false);
const mpu_armv71      = mpu_armv7.addInstance();
const mpu_armv72      = mpu_armv7.addInstance();

/**
 * Write custom configuration values to the imported modules.
 */
uart1.$name                   = "CONFIG_UART1";
uart1.useMcuDomainPeripherals = false;
uart1.intrEnable              = "DISABLE";
uart1.UART.$assign            = "USART0";

uart2.$name                   = "CONFIG_UART2";
uart2.useMcuDomainPeripherals = false;
uart2.intrEnable              = "DISABLE";
uart2.UART.$assign            = "USART1";

uart3.$name                   = "CONFIG_UART3";
uart3.useMcuDomainPeripherals = false;
uart3.intrEnable              = "DISABLE";
uart3.UART.$assign            = "USART2";

uart4.$name                   = "CONFIG_UART4";
uart4.useMcuDomainPeripherals = false;
uart4.intrEnable              = "DISABLE";
uart4.UART.$assign            = "USART3";

uart5.$name                   = "CONFIG_UART5";
uart5.useMcuDomainPeripherals = false;
uart5.intrEnable              = "DISABLE";
uart5.UART.$assign            = "USART4";

uart6.$name                   = "CONFIG_UART6";
uart6.useMcuDomainPeripherals = false;
uart6.intrEnable              = "DISABLE";
uart6.UART.$assign            = "USART5";

uart7.$name                   = "CONFIG_UART7";
uart7.useMcuDomainPeripherals = false;
uart7.intrEnable              = "DISABLE";
uart7.UART.$assign            = "USART6";

uart8.$name                      = "CONFIG_UART8";
uart8.useMcuDomainPeripherals    = false;
uart8.useWakeupDomainPeripherals = true;
uart8.intrEnable                 = "DISABLE";
uart8.WKUP_UART.$assign          = "WKUP_USART0";

addr_translate1.$name     = "CONFIG_ADDR_TRANSLATE_REGION0";
addr_translate1.localAddr = 0x80000000;

addr_translate2.$name      = "CONFIG_ADDR_TRANSLATE_REGION1";
addr_translate2.systemAddr = 0x20000000;
addr_translate2.localAddr  = 0xA0000000;

addr_translate3.$name      = "CONFIG_ADDR_TRANSLATE_REGION2";
addr_translate3.systemAddr = 0x40000000;
addr_translate3.localAddr  = 0xC0000000;

addr_translate4.$name      = "CONFIG_ADDR_TRANSLATE_REGION3";
addr_translate4.systemAddr = 0x60000000;
addr_translate4.localAddr  = 0x60000000;

debug_log.enableUartLog = true;
debug_log.uartLog.$name = "CONFIG_UART0";

mpu_armv71.$name        = "CONFIG_MPU_REGION0";
mpu_armv71.attributes   = "Device";
mpu_armv71.allowExecute = false;

mpu_armv72.$name = "CONFIG_MPU_REGION1";
mpu_armv72.size  = 18;

/**
 * Pinmux solution for unlocked pins/peripherals. This ensures that minor changes to the automatic solver in a future
 * version of the tool will not impact the pinmux you originally saw.  These lines can be completely deleted in order to
 * re-solve from scratch.
 */
uart1.UART.RXD.$suggestSolution                 = "UART0_RXD";
uart1.UART.TXD.$suggestSolution                 = "UART0_TXD";
uart2.UART.RXD.$suggestSolution                 = "I2C1_SCL";
uart2.UART.TXD.$suggestSolution                 = "I2C1_SDA";
uart3.UART.RXD.$suggestSolution                 = "GPMC0_AD8";
uart3.UART.TXD.$suggestSolution                 = "GPMC0_AD9";
uart4.UART.RXD.$suggestSolution                 = "GPMC0_AD10";
uart4.UART.TXD.$suggestSolution                 = "GPMC0_AD11";
uart5.UART.RXD.$suggestSolution                 = "GPMC0_AD12";
uart5.UART.TXD.$suggestSolution                 = "GPMC0_AD13";
uart6.UART.RXD.$suggestSolution                 = "GPMC0_AD14";
uart6.UART.TXD.$suggestSolution                 = "GPMC0_AD15";
uart7.UART.RXD.$suggestSolution                 = "GPMC0_WAIT1";
uart7.UART.TXD.$suggestSolution                 = "GPMC0_WPn";
uart8.WKUP_UART.RXD.$suggestSolution            = "WKUP_UART0_RXD";
uart8.WKUP_UART.TXD.$suggestSolution            = "WKUP_UART0_TXD";
debug_log.uartLog.MCU_UART.$suggestSolution     = "MCU_USART0";
debug_log.uartLog.MCU_UART.RXD.$suggestSolution = "MCU_UART0_RXD";
debug_log.uartLog.MCU_UART.TXD.$suggestSolution = "MCU_UART0_TXD";
