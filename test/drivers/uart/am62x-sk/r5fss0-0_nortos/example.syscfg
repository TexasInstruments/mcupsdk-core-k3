/**
 * @cliArgs --device "AM62x" --part "Default" --package "ALW" --context "r5fss0-0" --product "MCU_PLUS_SDK@07.03.01"
 * @versions {"tool":"1.21.0+3721"}
 */

/**
 * Import the modules used in this configuration.
 */
const i2c        = scripting.addModule("/drivers/i2c/i2c", {}, false);
const i2c1       = i2c.addInstance();
const uart       = scripting.addModule("/drivers/uart/uart", {}, false);
const uart1      = uart.addInstance();
const uart2      = uart.addInstance();
const uart3      = uart.addInstance();
const uart4      = uart.addInstance();
const uart5      = uart.addInstance();
const uart6      = uart.addInstance();
const uart7      = uart.addInstance();
const uart8      = uart.addInstance();
const clock      = scripting.addModule("/kernel/dpl/clock");
const debug_log  = scripting.addModule("/kernel/dpl/debug_log");
const mpu_armv7  = scripting.addModule("/kernel/dpl/mpu_armv7", {}, false);
const mpu_armv71 = mpu_armv7.addInstance();
const mpu_armv72 = mpu_armv7.addInstance();
const mpu_armv73 = mpu_armv7.addInstance();
const mpu_armv74 = mpu_armv7.addInstance();
const mpu_armv75 = mpu_armv7.addInstance();
const mpu_armv76 = mpu_armv7.addInstance();

/**
 * Write custom configuration values to the imported modules.
 */
clock.instance = "TIMER1";

i2c1.$name                      = "CONFIG_I2C0";
i2c1.useWakeupDomainPeripherals = false;
i2c1.I2C_child.$name            = "drivers_i2c_v0_i2c_v0_template0";
i2c1.I2C.$assign                = "I2C1";

uart1.$name                   = "CONFIG_UART0";
uart1.useMcuDomainPeripherals = true;
uart1.hwFlowControl           = false;
uart1.MCU_UART.$assign        = "MCU_USART0";

uart2.$name                      = "CONFIG_UART1";
uart2.useWakeupDomainPeripherals = false;
uart2.UART.$assign               = "USART0";

uart3.$name                      = "CONFIG_UART2";
uart3.useWakeupDomainPeripherals = false;
uart3.hwFlowControl              = false;
uart3.UART.$assign               = "USART1";

uart4.$name                      = "CONFIG_UART3";
uart4.useWakeupDomainPeripherals = false;
uart4.UART.$assign               = "USART2";

uart5.$name                      = "CONFIG_UART4";
uart5.useWakeupDomainPeripherals = false;
uart5.UART.$assign               = "USART3";

uart6.$name                      = "CONFIG_UART5";
uart6.useWakeupDomainPeripherals = false;
uart6.UART.$assign               = "USART4";

uart7.$name                      = "CONFIG_UART6";
uart7.useWakeupDomainPeripherals = false;
uart7.UART.$assign               = "USART5";

uart8.$name                      = "CONFIG_UART7";
uart8.useWakeupDomainPeripherals = false;
uart8.UART.$assign               = "USART6";

debug_log.enableUartLog             = true;
debug_log.enableCssLog              = false;
debug_log.uartLog.$name             = "CONFIG_UART8";
debug_log.uartLog.WKUP_UART.$assign = "WKUP_USART0";

mpu_armv71.allowExecute = false;
mpu_armv71.size         = 31;
mpu_armv71.attributes   = "Device";
mpu_armv71.$name        = "REGISTER_REGION";

mpu_armv72.accessPermissions = "Supervisor RD+WR, User RD";
mpu_armv72.size              = 7;
mpu_armv72.$name             = "TCMA_VEC";

mpu_armv73.baseAddr = 0x80000000;
mpu_armv73.size     = 31;
mpu_armv73.$name    = "DDR";

mpu_armv74.baseAddr   = 0x41010000;
mpu_armv74.size       = 15;
mpu_armv74.attributes = "NonCached";
mpu_armv74.$name      = "TCMB";

mpu_armv75.size       = 15;
mpu_armv75.attributes = "NonCached";
mpu_armv75.$name      = "TCMA";

mpu_armv76.baseAddr = 0x43C00000;
mpu_armv76.size     = 18;
mpu_armv76.$name    = "HSM_RAM";

/**
 * Pinmux solution for unlocked pins/peripherals.
 */
i2c1.I2C.SCL.$suggestSolution                    = "I2C1_SCL";
i2c1.I2C.SDA.$suggestSolution                    = "I2C1_SDA";
uart1.MCU_UART.RXD.$suggestSolution              = "MCU_UART0_RXD";
uart1.MCU_UART.TXD.$suggestSolution              = "MCU_UART0_TXD";
uart2.UART.RXD.$suggestSolution                  = "UART0_RXD";
uart2.UART.TXD.$suggestSolution                  = "UART0_TXD";
uart3.UART.RXD.$suggestSolution                  = "MCASP0_AFSR";
uart3.UART.TXD.$suggestSolution                  = "MCASP0_ACLKR";
uart4.UART.RXD.$suggestSolution                  = "GPMC0_AD8";
uart4.UART.TXD.$suggestSolution                  = "GPMC0_AD9";
uart5.UART.RXD.$suggestSolution                  = "GPMC0_AD10";
uart5.UART.TXD.$suggestSolution                  = "GPMC0_AD11";
uart6.UART.RXD.$suggestSolution                  = "GPMC0_AD12";
uart6.UART.TXD.$suggestSolution                  = "GPMC0_AD13";
uart7.UART.RXD.$suggestSolution                  = "GPMC0_AD14";
uart7.UART.TXD.$suggestSolution                  = "GPMC0_AD15";
uart8.UART.RXD.$suggestSolution                  = "GPMC0_WAIT1";
uart8.UART.TXD.$suggestSolution                  = "GPMC0_WPn";
debug_log.uartLog.WKUP_UART.RXD.$suggestSolution = "WKUP_UART0_RXD";
debug_log.uartLog.WKUP_UART.TXD.$suggestSolution = "WKUP_UART0_TXD";
