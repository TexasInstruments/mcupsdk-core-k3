/**
 * @cliArgs --device "AM62Ax" --part "Default" --package "AMB" --context "a53ss0-0" --product "MCU_PLUS_SDK@07.03.01"
 * @versions {"tool":"1.24.2+4234"}
 */

/**
 * Import the modules used in this configuration.
 */
const uart       = scripting.addModule("/drivers/uart/uart", {}, false);
const uart2      = uart.addInstance();
const uart3      = uart.addInstance();
const uart4      = uart.addInstance();
const uart5      = uart.addInstance();
const uart6      = uart.addInstance();
const uart7      = uart.addInstance();
const uart8      = uart.addInstance();
const uart9      = uart.addInstance();
const udma       = scripting.addModule("/drivers/udma/udma", {}, false);
const udma1      = udma.addInstance();
const debug_log  = scripting.addModule("/kernel/dpl/debug_log");
const mmu_armv8  = scripting.addModule("/kernel/dpl/mmu_armv8", {}, false);
const mmu_armv81 = mmu_armv8.addInstance();
const mmu_armv82 = mmu_armv8.addInstance();

/**
 * Write custom configuration values to the imported modules.
 */
uart2.$name                   = "CONFIG_UART0";
uart2.useMcuDomainPeripherals = true;
uart2.MCU_UART.$assign        = "MCU_USART0";

uart3.$name        = "CONFIG_UART2";
uart3.intrEnable   = "DMA";
uart3.UART.$assign = "USART1";

uart4.$name        = "CONFIG_UART3";
uart4.UART.$assign = "USART2";

uart5.$name        = "CONFIG_UART4";
uart5.UART.$assign = "USART3";

uart6.$name        = "CONFIG_UART5";
uart6.UART.$assign = "USART4";

uart7.$name        = "CONFIG_UART6";
uart7.UART.$assign = "USART5";

uart8.$name        = "CONFIG_UART7";
uart8.UART.$assign = "USART6";

uart9.$name                      = "CONFIG_UART8";
uart9.useWakeupDomainPeripherals = true;
uart9.WKUP_UART.$assign          = "WKUP_USART0";

udma1.$name      = "CONFIG_UDMA0";
uart3.udmaDriver = udma1;
udma1.instance   = "PKTDMA_0";

debug_log.enableUartLog        = true;
debug_log.uartLog.$name        = "CONFIG_UART1";
debug_log.uartLog.UART.$assign = "USART0";

mmu_armv81.size  = 0x80000000;
mmu_armv81.$name = "SOC_MEM_REGION";

mmu_armv82.vAddr     = 0x80000000;
mmu_armv82.pAddr     = 0x80000000;
mmu_armv82.size      = 0x80000000;
mmu_armv82.attribute = "MAIR7";
mmu_armv82.$name     = "DDR_REGION";

/**
 * Pinmux solution for unlocked pins/peripherals. This ensures that minor changes to the automatic solver in a future
 * version of the tool will not impact the pinmux you originally saw.  These lines can be completely deleted in order to
 * re-solve from scratch.
 */
uart2.MCU_UART.RXD.$suggestSolution         = "MCU_UART0_RXD";
uart2.MCU_UART.TXD.$suggestSolution         = "MCU_UART0_TXD";
uart3.UART.RXD.$suggestSolution             = "I2C1_SCL";
uart3.UART.TXD.$suggestSolution             = "I2C1_SDA";
uart4.UART.RXD.$suggestSolution             = "GPMC0_AD8";
uart4.UART.TXD.$suggestSolution             = "GPMC0_AD9";
uart5.UART.RXD.$suggestSolution             = "GPMC0_AD10";
uart5.UART.TXD.$suggestSolution             = "GPMC0_AD11";
uart6.UART.RXD.$suggestSolution             = "GPMC0_AD12";
uart6.UART.TXD.$suggestSolution             = "GPMC0_AD13";
uart7.UART.RXD.$suggestSolution             = "GPMC0_AD14";
uart7.UART.TXD.$suggestSolution             = "GPMC0_AD15";
uart8.UART.RXD.$suggestSolution             = "GPMC0_WAIT1";
uart8.UART.TXD.$suggestSolution             = "GPMC0_WPn";
uart9.WKUP_UART.RXD.$suggestSolution        = "WKUP_UART0_RXD";
uart9.WKUP_UART.TXD.$suggestSolution        = "WKUP_UART0_TXD";
debug_log.uartLog.UART.RXD.$suggestSolution = "UART0_RXD";
debug_log.uartLog.UART.TXD.$suggestSolution = "UART0_TXD";
