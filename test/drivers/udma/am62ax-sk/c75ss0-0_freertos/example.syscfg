/**
 * @cliArgs --device "AM62Ax" --part "Default" --package "AMB" --context "c75ss0-0" --product "MCU_PLUS_SDK@07.03.01"
 * @versions {"tool":"1.24.2+4234"}
 */

/**
 * Import the modules used in this configuration.
 */
const udma       = scripting.addModule("/drivers/udma/udma", {}, false);
const udma1      = udma.addInstance();
const debug_log  = scripting.addModule("/kernel/dpl/debug_log");
const mmu_armv8  = scripting.addModule("/kernel/dpl/mmu_armv8", {}, false);
const mmu_armv81 = mmu_armv8.addInstance();
const mmu_armv82 = mmu_armv8.addInstance();
const mmu_armv85 = mmu_armv8.addInstance();
const mmu_armv86 = mmu_armv8.addInstance();

/**
 * Write custom configuration values to the imported modules.
 */
udma1.$name                       = "CONFIG_UDMA0";
udma1.udmaBlkCopyChannel.create(1);
udma1.udmaBlkCopyChannel[0].$name = "CONFIG_UDMA_BLKCOPY_CH0";

debug_log.enableUartLog                   = true;
debug_log.enableCssLog                    = false;
debug_log.uartLog.$name                   = "CONFIG_UART0";
debug_log.uartLog.useMcuDomainPeripherals = true;

mmu_armv81.$name = "SOC_MEM_MAP";
mmu_armv81.size  = 0x80000000;

mmu_armv82.$name     = "DDR_MEM_MAP";
mmu_armv82.vAddr     = 0x80000000;
mmu_armv82.pAddr     = 0x80000000;
mmu_armv82.size      = 0x80000000;
mmu_armv82.attribute = "MAIR7";

/**
 * Pinmux solution for unlocked pins/peripherals. This ensures that minor changes to the automatic solver in a future
 * version of the tool will not impact the pinmux you originally saw.  These lines can be completely deleted in order to
 * re-solve from scratch.
 */
debug_log.uartLog.MCU_UART.$suggestSolution     = "MCU_USART0";
debug_log.uartLog.MCU_UART.RXD.$suggestSolution = "MCU_UART0_RXD";
debug_log.uartLog.MCU_UART.TXD.$suggestSolution = "MCU_UART0_TXD";
mmu_armv85.$name = "CLEC";
mmu_armv85.vAddr = 0x7C200000;
mmu_armv85.pAddr = 0x7C200000;
mmu_armv85.size  = 0x100000;
mmu_armv85.attribute = "MAIR4";

mmu_armv86.$name     = "DRU";
mmu_armv86.vAddr     = 0x7C400000;
mmu_armv86.pAddr     = 0x7C400000;
mmu_armv86.size      = 0x100000;
mmu_armv86.attribute = "MAIR4";
