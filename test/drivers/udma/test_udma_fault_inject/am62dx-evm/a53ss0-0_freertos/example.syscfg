/**
 * @cliArgs --device "AM62Dx" --package "AMB" --part "Default" --context "a53ss0-0" --product "MCU_PLUS_SDK@07.03.01"
 * @versions {"tool":"1.16.1+2960"}
 */

/**
 * Import the modules used in this configuration.
 */
const udma       = scripting.addModule("/drivers/udma/udma", {}, false);
const udma1      = udma.addInstance();
const debug_log  = scripting.addModule("/kernel/dpl/debug_log");
const mmu_armv8  = scripting.addModule("/kernel/dpl/mmu_armv8", {}, false);
const mmu_armv81 = mmu_armv8.addInstance();
const mmu_armv82 = mmu_armv8.addInstance();

/**
 * Write custom configuration values to the imported modules.
 */
udma1.$name                       = "CONFIG_UDMA0";
udma1.udmaBlkCopyChannel.create(1);
udma1.udmaBlkCopyChannel[0].$name = "CONFIG_UDMA_BLKCOPY_CH0";

debug_log.enableUartLog            = true;
debug_log.enableCssLog             = false;
debug_log.uartLog.$name            = "CONFIG_UART0";
debug_log.uartLog.UART.$assign     = "USART0";
debug_log.uartLog.UART.RXD.$assign = "UART0_RXD";
debug_log.uartLog.UART.TXD.$assign = "UART0_TXD";

mmu_armv81.$name = "SOC_MEM_MAP";
mmu_armv81.size  = 0x80000000;

mmu_armv82.$name     = "DDR_MEM_MAP";
mmu_armv82.vAddr     = 0x80000000;
mmu_armv82.pAddr     = 0x80000000;
mmu_armv82.size      = 0x80000000;
mmu_armv82.attribute = "MAIR7";

const mmu_armv83 = mmu_armv8.addInstance();
mmu_armv83.$name     = "OCRAM_MAP";
mmu_armv83.vAddr     = 0x70000000;
mmu_armv83.pAddr     = 0x70000000;
mmu_armv83.size      = 0x00010000;
mmu_armv83.attribute = "MAIR7"; // or an attribute matching non-cache or WB as required

/* Dedicated non-cached region for UDMA buffers to avoid cache coherency issues on A53 */
const mmu_armv84 = mmu_armv8.addInstance();
mmu_armv84.$name     = "DDR_UDMA_NONCACHED";
mmu_armv84.vAddr     = 0x88000000;
mmu_armv84.pAddr     = 0x88000000;
mmu_armv84.size      = 0x20000000; /* MATCH linker.cmd DDR_UDMA length (512MB) */
mmu_armv84.attribute = "MAIR7";    /* Normal Non-cacheable */
mmu_armv84.accessPermissions = "Privilege RW, User RW";
mmu_armv84.shareable = "Outer Shareable";
