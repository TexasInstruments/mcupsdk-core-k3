/**
 * @cliArgs --device "AM62x" --part "Default" --package "ALW" --context "a53ss0-0" --product "MCU_PLUS_SDK@07.03.01"
 * @versions {"tool":"1.26.2+4477"}
 */

/**
 * Import the modules used in this configuration.
 */
const ipc        = scripting.addModule("/drivers/ipc/ipc");
const watchdog   = scripting.addModule("/drivers/watchdog/watchdog", {}, false);
const watchdog1  = watchdog.addInstance();
const watchdog2  = watchdog.addInstance();
const watchdog3  = watchdog.addInstance();
const watchdog4  = watchdog.addInstance();
const debug_log  = scripting.addModule("/kernel/dpl/debug_log");
const mmu_armv8  = scripting.addModule("/kernel/dpl/mmu_armv8", {}, false);
const mmu_armv81 = mmu_armv8.addInstance();
const mmu_armv82 = mmu_armv8.addInstance();

/**
 * Write custom configuration values to the imported modules.
 */
ipc.enableLinuxIpc = false;
ipc.r5fss0_0       = "notify";
ipc.m4fss0_0       = "NONE";
ipc.a53ss0_1       = "NONE";

watchdog1.$name     = "CONFIG_WDT0";
watchdog1.resetMode = "Watchdog_RESET_OFF";

watchdog2.$name          = "CONFIG_WDT1";
watchdog2.instance       = "WDT1";
watchdog2.expirationTime = 60000;
watchdog2.resetMode      = "Watchdog_RESET_OFF";

watchdog3.$name          = "CONFIG_WDT2";
watchdog3.instance       = "WDT2";
watchdog3.resetMode      = "Watchdog_RESET_OFF";
watchdog3.expirationTime = 500;

watchdog4.$name          = "CONFIG_WDT3";
watchdog4.instance       = "WDT3";
watchdog4.resetMode      = "Watchdog_RESET_OFF";
watchdog4.expirationTime = 10000;

debug_log.enableUartLog            = true;
debug_log.uartLog.$name            = "CONFIG_UART_CONSOLE";
debug_log.uartLog.UART.$assign     = "USART0";
debug_log.uartLog.UART.RXD.$assign = "UART0_RXD";
debug_log.uartLog.UART.TXD.$assign = "UART0_TXD";

mmu_armv81.size  = 0x80000000;
mmu_armv81.$name = "REGISTER_REGION";

mmu_armv82.vAddr     = 0x80000000;
mmu_armv82.pAddr     = 0x80000000;
mmu_armv82.size      = 0x80000000;
mmu_armv82.attribute = "MAIR7";
mmu_armv82.$name     = "DDR";
