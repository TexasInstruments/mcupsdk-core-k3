/**
 * @cliArgs --device "AM275x" --part "AM2754" --package "ANJ" --context "c75ss0-0" --product "MCU_PLUS_SDK@07.03.01"
 * @versions {"tool":"1.24.0+4150"}
 */

/**
 * Import the modules used in this configuration.
 */
const debug_log   = scripting.addModule("/kernel/dpl/debug_log");
const mmu_armv8   = scripting.addModule("/kernel/dpl/mmu_armv8", {}, false);
const mmu_armv81  = mmu_armv8.addInstance();
const mmu_armv82  = mmu_armv8.addInstance();
const mmu_armv83  = mmu_armv8.addInstance();
const mmu_armv84  = mmu_armv8.addInstance();
const mmu_armv85  = mmu_armv8.addInstance();
const mmu_armv86  = mmu_armv8.addInstance();
const mmu_armv87  = mmu_armv8.addInstance();
const mmu_armv88  = mmu_armv8.addInstance();
const mmu_armv89  = mmu_armv8.addInstance();

/**
 * Write custom configuration values to the imported modules.
 */
debug_log.enableUartLog            = true;
debug_log.uartLog.$name            = "CONFIG_UART0";
debug_log.uartLog.UART.$assign     = "UART2";
debug_log.uartLog.UART.RXD.$assign = "MCASP0_AXR6";
debug_log.uartLog.UART.TXD.$assign = "SPI1_CS1";

mmu_armv81.size  = 0x20000000;
mmu_armv81.$name = "REGISTERS_REGION0";

mmu_armv82.vAddr = 0x20000000;
mmu_armv82.pAddr = 0x20000000;
mmu_armv82.size  = 0x20000000;
mmu_armv82.$name = "REGISTERS_REGION1";

mmu_armv83.vAddr = 0x40000000;
mmu_armv83.pAddr = 0x40000000;
mmu_armv83.size  = 0x20000000;
mmu_armv83.$name = "REGISTERS_REGION2";

mmu_armv84.vAddr = 0x7D200000;
mmu_armv84.pAddr = 0x7D200000;
mmu_armv84.$name = "CLEC";
mmu_armv84.size  = 0x100000;

mmu_armv85.$name = "DRU";
mmu_armv85.vAddr = 0x7D400000;
mmu_armv85.pAddr = 0x7D400000;
mmu_armv85.size  = 0x300000;

mmu_armv86.$name     = "L2SRAM";
mmu_armv86.vAddr     = 0x7F000000;
mmu_armv86.pAddr     = 0x7F000000;
mmu_armv86.attribute = "MAIR7";
mmu_armv86.size      = 0x200000;

mmu_armv87.$name     = "L2SRAM_AUX";
mmu_armv87.vAddr     = 0x7F200000;
mmu_armv87.pAddr     = 0x7F200000;
mmu_armv87.size      = 0x40000;
mmu_armv87.attribute = "MAIR7";

mmu_armv88.attribute = "MAIR7";
mmu_armv88.$name     = "MSRAM_BANK0_TO_BANK3";
mmu_armv88.vAddr     = 0x80000000;
mmu_armv88.pAddr     = 0x80000000;
mmu_armv88.size      = 0x400000;

mmu_armv89.$name     = "MSRAM_BANK4_TO_BANK5";
mmu_armv89.size      = 0x200000;
mmu_armv89.attribute = "MAIR7";
mmu_armv89.vAddr     = 0x80400000;
mmu_armv89.pAddr     = 0x80400000;
