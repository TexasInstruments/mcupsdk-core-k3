/**
 * @cliArgs --device "AM62Ax" --part "Default" --package "AMB" --context "mcu-r5fss0-0" --product "MCU_PLUS_SDK@07.03.01"
 * @versions {"tool":"1.26.2+4477"}
 */

/**
 * Import the modules used in this configuration.
 */
const debug_log = scripting.addModule("/kernel/dpl/debug_log");

/**
 * Write custom configuration values to the imported modules.
 */
debug_log.enableUartLog                = true;
debug_log.uartLog.$name                = "CONFIG_UART0";
debug_log.uartLog.MCU_UART.$assign     = "MCU_USART0";
debug_log.uartLog.MCU_UART.RXD.$assign = "MCU_UART0_RXD";
debug_log.uartLog.MCU_UART.TXD.$assign = "MCU_UART0_TXD";
