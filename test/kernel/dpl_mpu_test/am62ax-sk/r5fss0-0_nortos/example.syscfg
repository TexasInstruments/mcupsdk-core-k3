/**
 * @cliArgs --device "AM62Ax" --part "Default" --package "AMB" --context "r5fss0-0" --product "MCU_PLUS_SDK@07.03.01"
 * @versions {"tool":"1.26.2+4477"}
 */

/**
 * Import the modules used in this configuration.
 */
const debug_log = scripting.addModule("/kernel/dpl/debug_log");

/**
 * Write custom configuration values to the imported modules.
 */
debug_log.enableUartLog                 = true;
debug_log.uartLog.$name                 = "CONFIG_UART0";
debug_log.uartLog.WKUP_UART.$assign     = "WKUP_USART0";
debug_log.uartLog.WKUP_UART.RXD.$assign = "WKUP_UART0_RXD";
debug_log.uartLog.WKUP_UART.TXD.$assign = "WKUP_UART0_TXD";
